## .axioenvs/application.modbus_tcp_slave/build/gcc-riscv32.release/gen/Kconfig/Kconfig.component.aw_3rdparty_unity
```kconfig
menuconfig AW_3RDPARTY_UNITY
    bool "Unity"
    libsafe 
    select AW_STDIO
    default n
    help
        Version: 0.0.0

        
if AW_3RDPARTY_UNITY

source "D:/aworks_lp_hpm6450_general_sdk-0.9.1/frameworks/64cf32e2-aworks_lp/app/applications/Unity/Kconfig.opts"

endif #AW_3RDPARTY_UNITY
```

## .axioenvs/application.modbus_tcp_slave/build/gcc-riscv32.release/gen/Kconfig/Kconfig.component.aw_api_if
```kconfig
menuconfig AW_API_IF
    bool "AWorks API of network interface like posix"
    libsafe 
    select AWB_INET_IF
    default n
    help
        Version: 0.0.0

        
```

## .axioenvs/application.modbus_tcp_slave/build/gcc-riscv32.release/gen/Kconfig/Kconfig.component.aw_api_netdb
```kconfig
menuconfig AW_API_NETDB
    bool "AWorks API of netdb"
    libsafe 
    select AW_API_INET_HEADER
    select AW_API_INET_LOCAL
    select AWB_INET_NETDB
    default n
    help
        Version: 0.0.0

        
```

## .axioenvs/application.modbus_tcp_slave/build/gcc-riscv32.release/gen/Kconfig/Kconfig.component.aw_api_pm
```kconfig
menuconfig AW_API_PM
    bool "AWorks API of suspend,power down,and reboot"
    libsafe 
    select AW_SUBSYS_PM_WAKEUP_TIMER
    select AW_SUBSYS_SYSTEM_SYSDEBUG
    select AWB_PM_NOTIFY
    default n
    help
        Version: 0.0.0

        
if AW_API_PM

source "D:/aworks_lp_hpm6450_general_sdk-0.9.1/frameworks/64cf32e2-aworks_lp/components/kernel/aw_api_pm/Kconfig.opts"

endif #AW_API_PM
```

## .axioenvs/application.modbus_tcp_slave/build/gcc-riscv32.release/gen/Kconfig/Kconfig.component.aw_api_time
```kconfig
menuconfig AW_API_TIME
    bool "AWorks API of time"
    libsafe 
    select AW_API_TIME_SYS
    select AW_API_TIMETRANS_LOCAL
    default n
    help
        Version: 0.0.0

        
```

## .axioenvs/application.modbus_tcp_slave/build/gcc-riscv32.release/gen/Kconfig/Kconfig.component.aw_api_time_sys
```kconfig
menuconfig AW_API_TIME_SYS
    bool "AWorks time apis implement in kernel"
    libsafe 
    select AW_SUBSYS_TIME
    default n
    help
        Version: 0.0.0

        
```

## .axioenvs/application.modbus_tcp_slave/build/gcc-riscv32.release/gen/Kconfig/Kconfig.component.aw_api_timezone
```kconfig
menuconfig AW_API_TIMEZONE
    bool "AWorks API of timezone"
    libsafe 
    select AW_INTERFACE
    default n
    help
        Version: 0.0.0

        
```

## .axioenvs/application.modbus_tcp_slave/build/gcc-riscv32.release/gen/Kconfig/Kconfig.component.aw_app_aw_shell_clk_tree
```kconfig
menuconfig AW_APP_AW_SHELL_CLK_TREE
    bool "AWorks Shell supports clk_tree commands to show clock tree on system"
    libsafe 
    select AW_APP_SHELL
    select AW_API_CLK
    default n
    help
        Version: 0.0.0

        
```

## .axioenvs/application.modbus_tcp_slave/build/gcc-riscv32.release/gen/Kconfig/Kconfig.component.aw_app_aw_shell_dns_server
```kconfig
menuconfig AW_APP_AW_SHELL_DNS_SERVER
    bool "AWorks Shell supports dns server set/get commands"
    libsafe 
    select AW_APP_SHELL
    select AW_STDLIB
    select AW_API_NETDB
    select AW_API_INET_HEADER
    default n
    help
        Version: 0.0.0

        
```

## .axioenvs/application.modbus_tcp_slave/build/gcc-riscv32.release/gen/Kconfig/Kconfig.component.aw_app_aw_shell_ethloopback
```kconfig
menuconfig AW_APP_AW_SHELL_ETHLOOPBACK
    bool "AWorks Shell supports ethloopback commands"
    libsafe 
    select AW_APP_SHELL
    select AW_DEV_API
    select AW_STDLIB
    select AWB_NETIF_USER_INTERFACE
    select AWB_NETIF_SEND_RAW_PACKETS
    select AWB_NETIF_RECV_RAW_PACKETS
    default n
    help
        Version: 0.0.0

        
```

## .axioenvs/application.modbus_tcp_slave/build/gcc-riscv32.release/gen/Kconfig/Kconfig.component.aw_app_aw_shell_hexdump
```kconfig
menuconfig AW_APP_AW_SHELL_HEXDUMP
    bool "AWorks Shell supports hexdump commands"
    libsafe 
    select AW_APP_SHELL
    select AW_INTERFACE
    select AW_STDLIB
    select AW_STDIO_PRINTF_FLAGS_MINUS_EN
    select COMPILER_SUPPORT_LIBC_MALLOC_FREE
    default n
    help
        Version: 0.0.0

        
```

## .axioenvs/application.modbus_tcp_slave/build/gcc-riscv32.release/gen/Kconfig/Kconfig.component.aw_app_aw_shell_io
```kconfig
menuconfig AW_APP_AW_SHELL_IO
    bool "AWorks Shell support io commands (ls ll)"
    libsafe 
    select AW_APP_SHELL
    select AW_API_TIMETRANS_LOCAL
    default y
    help
        Version: 0.0.0

        
```

## .axioenvs/application.modbus_tcp_slave/build/gcc-riscv32.release/gen/Kconfig/Kconfig.component.aw_app_aw_shell_iperf
```kconfig
menuconfig AW_APP_AW_SHELL_IPERF
    bool "AWorks Shell supports iperf commands"
    libsafe 
    select AW_APP_SHELL
    select AW_API_INET_LOCAL
    select AWB_SUBSYS_NETIF
    select AWB_NETIF_USER_INTERFACE
    select COMPILER_SUPPORT_POSIX_SOCKET
    select COMPILER_SUPPORT_LIBC_TIME
    default n
    help
        Version: 0.0.0

        
if AW_APP_AW_SHELL_IPERF

source "D:/aworks_lp_hpm6450_general_sdk-0.9.1/frameworks/64cf32e2-aworks_lp/app/applications/aw_shell_iperf/Kconfig.opts"

endif #AW_APP_AW_SHELL_IPERF
```

## .axioenvs/application.modbus_tcp_slave/build/gcc-riscv32.release/gen/Kconfig/Kconfig.component.aw_app_aw_shell_mnt
```kconfig
menuconfig AW_APP_AW_SHELL_MNT
    bool "AWorks Shell supports mount/umount/mkfs commands"
    libsafe 
    select AW_APP_SHELL
    default n
    help
        Version: 0.0.0

        
```

## .axioenvs/application.modbus_tcp_slave/build/gcc-riscv32.release/gen/Kconfig/Kconfig.component.aw_app_aw_shell_mtd
```kconfig
menuconfig AW_APP_AW_SHELL_MTD
    bool "AWorks Shell supports MTD commands"
    libsafe 
    select AW_APP_SHELL
    select AW_INTERFACE
    select AW_STDLIB
    select AW_DEV_API
    select AW_STDIO_PRINTF_FLAGS_MINUS_EN
    select AW_STDIO_PRINTF_TYPES_LONG_LONG_EN
    default n
    help
        Version: 0.0.0

        
```

## .axioenvs/application.modbus_tcp_slave/build/gcc-riscv32.release/gen/Kconfig/Kconfig.component.aw_app_aw_shell_ping
```kconfig
menuconfig AW_APP_AW_SHELL_PING
    bool "AWorks Shell supports ping commands"
    libsafe 
    select AW_APP_SHELL
    select COMPILER_SUPPORT_POSIX_SOCKET
    default n
    help
        Version: 0.0.0

        
```

## .axioenvs/application.modbus_tcp_slave/build/gcc-riscv32.release/gen/Kconfig/Kconfig.component.aw_app_aw_shell_shutdown
```kconfig
menuconfig AW_APP_AW_SHELL_SHUTDOWN
    bool "AWorks Shell supports shutdown commands"
    libsafe 
    select AW_APP_SHELL
    select AW_API_PM
    default n
    help
        Version: 0.0.0

        
```

## .axioenvs/application.modbus_tcp_slave/build/gcc-riscv32.release/gen/Kconfig/Kconfig.component.aw_app_aw_shell_simple_fdisk
```kconfig
menuconfig AW_APP_AW_SHELL_SIMPLE_FDISK
    bool "AWorks Shell supports simple fdisk commands"
    libsafe 
    select AW_APP_SHELL
    select AW_SUBSYS_STORAGE_BLOCKDEV
    default n
    help
        Version: 0.0.0

        
```

## .axioenvs/application.modbus_tcp_slave/build/gcc-riscv32.release/gen/Kconfig/Kconfig.component.aw_app_aw_shell_wifi
```kconfig
menuconfig AW_APP_AW_SHELL_WIFI
    bool "AWorks Shell supports wifi commands"
    libsafe 
    select AW_APP_SHELL
    select AW_INTERFACE
    select AW_DEV_API
    select AW_WIFI_UTILS
    select AW_STDLIB
    select AW_STDIO_PRINTF_FLAGS_MINUS_EN
    select COMPILER_SUPPORT_LIBC_MALLOC_FREE
    default n
    help
        Version: 0.0.0

        
if AW_APP_AW_SHELL_WIFI

source "D:/aworks_lp_hpm6450_general_sdk-0.9.1/frameworks/64cf32e2-aworks_lp/app/applications/aw_shell_wifi/Kconfig.opts"

endif #AW_APP_AW_SHELL_WIFI
```
