## .axioenvs/application.modbus_tcp_slave/build/gcc-riscv32.release/gen/Kconfig/Kconfig.component.EPC6450-AWI.device.hpm_wdt_3
```kconfig
menuconfig DEV_WDT3
    bool "wdt3"
    default n
    visible if y
    select DRV_HPM_WDT
    select DEV_PLIC0
    select DEV_PLIC0_INTERRUPT_RES_55
    select DEV_PLIC0_AWBL_INTCTLR_SERVICE

    help
      Filename: "/dev/wdt3"

      dts_dev_prop:
          name(unit): "hpm_wdt" (3)
          compatible: ['riscv,hpm-wdt']
          dts_path: /soc/wdt@F009C000
          binding: D:\aworks_lp_hpm6450_general_sdk-0.9.1\platforms\platform-hpm-aworks-lp\components\aw_cpu_driver_hpm\dts\bindings\wdt\riscv,hpm-wdt.yaml


if DEV_WDT3

config DEV_WDT3_IS_INTERNAL_CLK
    bool "if setlect use Peripheral clk ,or use wdt external clk"
    default n

endif #DEV_WDT3
```

## .axioenvs/application.modbus_tcp_slave/build/gcc-riscv32.release/gen/Kconfig/Kconfig.component.EPC6450-AWI.device.jedec_jesd216_nor_flash_spi_0
```kconfig
menuconfig DEV_W25Q64FW
    bool "w25q64fw @ spi0 #CS0"
    default n
    visible if y
    select DRV_JEDEC_JESD216_NOR_FLASH_SPI
    select DEV_SPI0
    select DEV_SPI0_CHIPSELECT_0

    help
      Filename: "/dev/w25q64fw"

      dts_dev_prop:
          name(unit): "jedec_jesd216_nor_flash_spi" (0)
          compatible: ['jedec,jesd216_nor_flash_spi']
          dts_path: /soc/spi@0xF0030000/w25q64fw@0
          binding: D:\aworks_lp_hpm6450_general_sdk-0.9.1\frameworks\64cf32e2-aworks_lp\subsys\awb_common_driver\dts\bindings\nor_flash\jedec,jesd216_nor_flash_spi.yaml


if DEV_W25Q64FW
config DEV_W25Q64FW_W25_NOR0
    bool "w25_nor0"
    default y



    help
       Filename:"/dev/w25_nor0"

if DEV_W25Q64FW_W25_NOR0

endif #DEV_W25Q64FW_W25_NOR0
config DEV_W25Q64FW_W25_NOR1
    bool "w25_nor1"
    default y



    help
       Filename:"/dev/w25_nor1"

if DEV_W25Q64FW_W25_NOR1

endif #DEV_W25Q64FW_W25_NOR1
config DEV_W25Q64FW_W25_NOR2
    bool "w25_nor2"
    default y



    help
       Filename:"/dev/w25_nor2"

if DEV_W25Q64FW_W25_NOR2

endif #DEV_W25Q64FW_W25_NOR2
endif #DEV_W25Q64FW
```

## .axioenvs/application.modbus_tcp_slave/build/gcc-riscv32.release/gen/Kconfig/Kconfig.component.EPC6450-AWI.device.ov7725_camera_0
```kconfig
menuconfig DEV_OV7725
    bool "ov7725 @ cam0"
    default n
    visible if y
    select DRV_OV7725_CAMERA
    select DEV_CAM0
    select DEV_PIN_1
    select DEV_PIN_1_PIN_RES_158
    select DEV_PIN_1_AWB_PIN_SERVICE
    select DEV_PIN_1_PIN_RES_116

    help
      Filename: "/dev/ov7725"

      dts_dev_prop:
          name(unit): "ov7725,camera" (0)
          compatible: ['OV,7725']
          dts_path: /soc/camera@0xF1008000/ov7725@0x21
          binding: D:\aworks_lp_hpm6450_general_sdk-0.9.1\frameworks\64cf32e2-aworks_lp\subsys\awb_common_driver\dts\bindings\cam\OV,7725.yaml


if DEV_OV7725
if DEV_OV7725
   config __I2C_PHANDLE
       def_bool y
       select DEV_I2C3
endif

endif #DEV_OV7725
```

## .axioenvs/application.modbus_tcp_slave/build/gcc-riscv32.release/gen/Kconfig/Kconfig.component.EPC6450-AWI.device.yt8512h_phy_0
```kconfig
menuconfig DEV_YT8512H_0
    bool "yt8512h_0 @ eth1"
    default n
    visible if y
    select DRV_YT8512H_PHY
    select DEV_ETH1
    select DEV_PIN_1
    select DEV_PIN_1_PIN_RES_205
    select DEV_PIN_1_AWB_PIN_SERVICE

    help
      Filename: "/dev/yt8512h_0"

      dts_dev_prop:
          name(unit): "yt8512h_phy" (0)
          compatible: ['motorcomm,yt8512h']
          dts_path: /soc/eth@0xF2004000/yt8512h_phy@0x02
          binding: D:\aworks_lp_hpm6450_general_sdk-0.9.1\frameworks\64cf32e2-aworks_lp\subsys\awb_common_driver\dts\bindings\phy\motorcomm,yt8512h.yaml


if DEV_YT8512H_0

config DEV_YT8512H_0_LINK_LED
    string "Link LED"
    default "YT8512H_LED0"
    help 
        The LED which will on when enet link up.
    enum
        "YT8512H_LED0"
        "YT8512H_LED1"


config DEV_YT8512H_0_LINK_LED_INVERT
    bool "Link LED invert"
    default n
    help 
        The LED will invert


config DEV_YT8512H_0_ACTIVE_LED
    string "Active LED"
    default "YT8512H_LED1"
    help 
        The LED which will blink when enet trans active.
    enum
        "YT8512H_LED0"
        "YT8512H_LED1"


config DEV_YT8512H_0_ACTIVE_LED_INVERT
    bool "Active LED invert"
    default n
    help 
        The LED will invert

endif #DEV_YT8512H_0
```

## .axioenvs/application.modbus_tcp_slave/build/gcc-riscv32.release/gen/Kconfig/Kconfig.component.EPC6450-AWI.device.zlg_tft_monitor_gpio_0
```kconfig
menuconfig DEV_ZLG_480_272
    bool "zlg_480_272 @ lcdc0"
    default n
    visible if y
    select DRV_ZLG_TFT_MONITOR_GPIO
    select DEV_LCDC0
    select DEV_PIN_1
    select DEV_PIN_1_PIN_RES_166
    select DEV_PIN_1_AWB_PIN_SERVICE
    select DEV_PIN_1_PIN_RES_131

    help
      Filename: "/dev/zlg_480_272"

      dts_dev_prop:
          name(unit): "zlg_tft_monitor_gpio" (0)
          compatible: ['zlg_tft,monitor-gpio']
          dts_path: /soc/lcdc@0xF1000000/monitor_zlg_480_272
          binding: D:\aworks_lp_hpm6450_general_sdk-0.9.1\frameworks\64cf32e2-aworks_lp\subsys\awb_common_driver\dts\bindings\monitor\zlg_tft,monitor-gpio.yaml
```
