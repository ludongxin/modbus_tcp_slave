## .axioenvs/application.modbus_tcp_slave/build/gcc-riscv32.release/gen/Kconfig/Kconfig.component.EPC6450-AWI.device.hpm_gtmr_systmr_0
```kconfig
menuconfig DEV_SYSTMR
    bool "systmr"
    default y
    visible if y
    select DRV_HPM_GTMR_SYSTMR
    select DEV_PLIC0
    select DEV_PLIC0_INTERRUPT_RES_62
    select DEV_PLIC0_AWBL_INTCTLR_SERVICE

    help
      Filename: "/dev/systmr"

      dts_dev_prop:
          name(unit): "hpm_gtmr_systmr" (0)
          compatible: ['riscv,hpm_gtmr_systmr']
          dts_path: /soc/systmr@F3008000
          binding: D:\aworks_lp_hpm6450_general_sdk-0.9.1\platforms\platform-hpm-aworks-lp\components\aw_cpu_driver_hpm\dts\bindings\gtmr\riscv,hpm_gtmr_systmr.yaml
```

## .axioenvs/application.modbus_tcp_slave/build/gcc-riscv32.release/gen/Kconfig/Kconfig.component.EPC6450-AWI.device.hpm_i2c_0
```kconfig
menuconfig DEV_I2C0
    bool "i2c0"
    default n
    visible if y
    select DRV_HPM_I2C
    select DEV_PLIC0
    select DEV_PIN_1
    select DEV_PLIC0_INTERRUPT_RES_68
    select DEV_PLIC0_AWBL_INTCTLR_SERVICE
    select DEV_PIN_1_PIN_RES_43
    select DEV_PIN_1_AWB_PIN_SERVICE
    select DEV_PIN_1_PIN_RES_42

    help
      Filename: "/dev/i2c0"

      dts_dev_prop:
          name(unit): "hpm_i2c" (0)
          compatible: ['riscv,hpm_i2c']
          dts_path: /soc/i2c@0xF3020000
          binding: D:\aworks_lp_hpm6450_general_sdk-0.9.1\platforms\platform-hpm-aworks-lp\components\aw_cpu_driver_hpm\dts\bindings\i2c\riscv,hpm-i2c.yaml


if DEV_I2C0

config DEV_I2C0_TIMEOUT
    int "the bus timeout(us, step: 1000us) for i2c"
    default 5000


config DEV_I2C0_BUS_SPEED
    int "the bus speed for i2c"
    default 100000

endif #DEV_I2C0
```

## .axioenvs/application.modbus_tcp_slave/build/gcc-riscv32.release/gen/Kconfig/Kconfig.component.EPC6450-AWI.device.hpm_i2c_1
```kconfig
menuconfig DEV_I2C1
    bool "i2c1"
    default n
    visible if y
    select DRV_HPM_I2C
    select DEV_PLIC0
    select DEV_PIN_1
    select DEV_PLIC0_INTERRUPT_RES_69
    select DEV_PLIC0_AWBL_INTCTLR_SERVICE
    select DEV_PIN_1_PIN_RES_11
    select DEV_PIN_1_AWB_PIN_SERVICE
    select DEV_PIN_1_PIN_RES_10

    help
      Filename: "/dev/i2c1"

      dts_dev_prop:
          name(unit): "hpm_i2c" (1)
          compatible: ['riscv,hpm_i2c']
          dts_path: /soc/i2c@0xF3024000
          binding: D:\aworks_lp_hpm6450_general_sdk-0.9.1\platforms\platform-hpm-aworks-lp\components\aw_cpu_driver_hpm\dts\bindings\i2c\riscv,hpm-i2c.yaml


if DEV_I2C1

config DEV_I2C1_TIMEOUT
    int "the bus timeout(us, step: 1000us) for i2c"
    default 5000


config DEV_I2C1_BUS_SPEED
    int "the bus speed for i2c"
    default 100000

endif #DEV_I2C1
```

## .axioenvs/application.modbus_tcp_slave/build/gcc-riscv32.release/gen/Kconfig/Kconfig.component.EPC6450-AWI.device.hpm_i2c_2
```kconfig
menuconfig DEV_I2C2
    bool "i2c2"
    default n
    visible if y
    select DRV_HPM_I2C
    select DEV_PLIC0
    select DEV_PIN_1
    select DEV_PLIC0_INTERRUPT_RES_70
    select DEV_PLIC0_AWBL_INTCTLR_SERVICE
    select DEV_PIN_1_PIN_RES_15
    select DEV_PIN_1_AWB_PIN_SERVICE
    select DEV_PIN_1_PIN_RES_14

    help
      Filename: "/dev/i2c2"

      dts_dev_prop:
          name(unit): "hpm_i2c" (2)
          compatible: ['riscv,hpm_i2c']
          dts_path: /soc/i2c@0xF3028000
          binding: D:\aworks_lp_hpm6450_general_sdk-0.9.1\platforms\platform-hpm-aworks-lp\components\aw_cpu_driver_hpm\dts\bindings\i2c\riscv,hpm-i2c.yaml


if DEV_I2C2

config DEV_I2C2_TIMEOUT
    int "the bus timeout(us, step: 1000us) for i2c"
    default 5000


config DEV_I2C2_BUS_SPEED
    int "the bus speed for i2c"
    default 100000

endif #DEV_I2C2
```

## .axioenvs/application.modbus_tcp_slave/build/gcc-riscv32.release/gen/Kconfig/Kconfig.component.EPC6450-AWI.device.hpm_i2s_0
```kconfig
menuconfig DEV_I2S1
    bool "i2s1"
    default n
    visible if y
    select DRV_HPM_I2S
    select DEV_PLIC0
    select DEV_PLIC0_INTERRUPT_RES_92
    select DEV_PLIC0_AWBL_INTCTLR_SERVICE

    help
      Filename: "/dev/i2s1"

      dts_dev_prop:
          name(unit): "hpm_i2s" (0)
          compatible: ['riscv,hpm-i2s']
          dts_path: /soc/i2s@0xF0104000
          binding: D:\aworks_lp_hpm6450_general_sdk-0.9.1\platforms\platform-hpm-aworks-lp\components\aw_cpu_driver_hpm\dts\bindings\i2s\riscv,hpm-i2s.yaml
```

## .axioenvs/application.modbus_tcp_slave/build/gcc-riscv32.release/gen/Kconfig/Kconfig.component.EPC6450-AWI.device.hpm_lcdc_0
```kconfig
menuconfig DEV_LCDC0
    bool "lcdc0"
    default n
    visible if y
    select DRV_HPM_LCDC
    select DEV_PLIC0
    select DEV_PIN_1
    select DEV_PLIC0_INTERRUPT_RES_99
    select DEV_PLIC0_AWBL_INTCTLR_SERVICE
    select DEV_PIN_1_PIN_RES_35
    select DEV_PIN_1_AWB_PIN_SERVICE
    select DEV_PIN_1_PIN_RES_36
    select DEV_PIN_1_PIN_RES_32
    select DEV_PIN_1_PIN_RES_31
    select DEV_PIN_1_PIN_RES_26
    select DEV_PIN_1_PIN_RES_21
    select DEV_PIN_1_PIN_RES_27
    select DEV_PIN_1_PIN_RES_28
    select DEV_PIN_1_PIN_RES_38
    select DEV_PIN_1_PIN_RES_33
    select DEV_PIN_1_PIN_RES_22
    select DEV_PIN_1_PIN_RES_23
    select DEV_PIN_1_PIN_RES_29
    select DEV_PIN_1_PIN_RES_24
    select DEV_PIN_1_PIN_RES_30
    select DEV_PIN_1_PIN_RES_25
    select DEV_PIN_1_PIN_RES_37
    select DEV_PIN_1_PIN_RES_39
    select DEV_PIN_1_PIN_RES_34
    select DEV_PIN_1_PIN_RES_16
    select DEV_PIN_1_PIN_RES_12
    select DEV_PIN_1_PIN_RES_17
    select DEV_PIN_1_PIN_RES_13
    select DEV_PIN_1_PIN_RES_18
    select DEV_PIN_1_PIN_RES_20
    select DEV_PIN_1_PIN_RES_15
    select DEV_PIN_1_PIN_RES_19
    select DEV_PIN_1_PIN_RES_14

    help
      Filename: "/dev/lcdc0"

      dts_dev_prop:
          name(unit): "hpm_lcdc" (0)
          compatible: ['riscv,hpm-lcdc']
          dts_path: /soc/lcdc@0xF1000000
          binding: D:\aworks_lp_hpm6450_general_sdk-0.9.1\platforms\platform-hpm-aworks-lp\components\aw_cpu_driver_hpm\dts\bindings\lcdc\riscv,hpm-lcdc.yaml


if DEV_LCDC0

config DEV_LCDC0_BUFFER_MODE
    string "Number of frame buffers"
    default "AW_FB_DOUBLE_BUFFER"
    enum
        "AW_FB_SINGLE_BUFFER"
        "AW_FB_DOUBLE_BUFFER"
        "AW_FB_TRIPLE_BUFFER"


config DEV_LCDC0_FRAME_BUFFER_FIXEL_FMT
    string "Frame Buffer Pixel format"
    default "AW_FB_FIXEL_FMT_RGB565"
    enum
        "AW_FB_FIXEL_FMT_RGB565"
        "AW_FB_FIXEL_FMT_RGB888"

endif #DEV_LCDC0
```

## .axioenvs/application.modbus_tcp_slave/build/gcc-riscv32.release/gen/Kconfig/Kconfig.component.EPC6450-AWI.device.hpm_mbx_3
```kconfig
menuconfig DEV_MBX1B
    bool "mbx1b"
    default n
    visible if y
    select DRV_HPM_MBX
    select DEV_PLIC0
    select DEV_PLIC0_INTERRUPT_RES_59
    select DEV_PLIC0_AWBL_INTCTLR_SERVICE

    help
      Filename: "/dev/mbx1b"

      dts_dev_prop:
          name(unit): "hpm_mbx" (3)
          compatible: ['riscv,hpm_mbx']
          dts_path: /soc/mbx@0xF00AC000
          binding: D:\aworks_lp_hpm6450_general_sdk-0.9.1\platforms\platform-hpm-aworks-lp\components\aw_cpu_driver_hpm\dts\bindings\mbx\riscv,hpm_mbx.yaml
```

## .axioenvs/application.modbus_tcp_slave/build/gcc-riscv32.release/gen/Kconfig/Kconfig.component.EPC6450-AWI.device.hpm_nor_xpi_0
```kconfig
menuconfig DEV_XPI0
    bool "xpi0"
    default y
    visible if y
    select DRV_HPM_NOR_XPI

    help
      Filename: "/dev/xpi0"

      dts_dev_prop:
          name(unit): "hpm_nor_xpi" (0)
          compatible: ['riscv,hpm-nor-xpi']
          dts_path: /soc/nor_xpi@0xf3040000
          binding: D:\aworks_lp_hpm6450_general_sdk-0.9.1\platforms\platform-hpm-aworks-lp\components\aw_cpu_driver_hpm\dts\bindings\nor_api\riscv,hpm-nor-xpi.yaml


if DEV_XPI0

config DEV_XPI0_DEVICE_TYPE
    string "device type"
    default "MTD_device"
    help 

        if select MTD_device
            Flash will register 2 partition devices({dev_name}_code,{dev_name}_data) to kernel,default;
            when code running in Flash, the size of {dev_name}_data determined by ld file;
            when code running in SDRAM or SRAM, size of {dev_name}_data is total of flash chip, the size of {dev_name}_code is 0;
            Application can operate "/dev/{dev_name}_data" by MTD APIs(examples:peripheral/flash/flash_lffs,peripheral/flash/flash_mtd);
            And also {dev_name}_data partition can split into multiple partitions for different application. For details, please refer to HPM_Driver_Using_Note
        
        if select User_device
           Flash will register 1 flash device to kernal;
           Application can operte "/dev/{dev_name}" by Flash APIs (examples:peripheral/flash/spiflash).
    enum
        "MTD_device"
        "User_device"

endif #DEV_XPI0
```

## .axioenvs/application.modbus_tcp_slave/build/gcc-riscv32.release/gen/Kconfig/Kconfig.component.EPC6450-AWI.device.hpm_ptpc_timestamp_0
```kconfig
menuconfig DEV_PTPC
    bool "ptpc"
    default y
    visible if y
    select DRV_HPM_PTPC_TIMESTAMP
    select DEV_PLIC0
    select DEV_PLIC0_INTERRUPT_RES_51
    select DEV_PLIC0_AWBL_INTCTLR_SERVICE

    help
      Filename: "/dev/ptpc"

      dts_dev_prop:
          name(unit): "hpm_ptpc_timestamp" (0)
          compatible: ['riscv,hpm_ptpc']
          dts_path: /soc/ptpc@0xF00B0000
          binding: D:\aworks_lp_hpm6450_general_sdk-0.9.1\platforms\platform-hpm-aworks-lp\components\aw_cpu_driver_hpm\dts\bindings\ptpc\riscv,hpm_ptpc_timestamp.yaml
```

## .axioenvs/application.modbus_tcp_slave/build/gcc-riscv32.release/gen/Kconfig/Kconfig.component.EPC6450-AWI.device.hpm_pwm_12
```kconfig
menuconfig DEV_PWM3_CHAN4
    bool "pwm3_chan4 @ pwm3"
    default n
    visible if y
    select DRV_HPM_PWM
    select DEV_PIN_1
    select DEV_PIN_1_PIN_RES_133
    select DEV_PIN_1_AWB_PIN_SERVICE

    help
      Filename: "/dev/pwm3_chan4"

      dts_dev_prop:
          name(unit): "hpm_pwm" (12)
          compatible: ['riscv,hpm-pwm']
          dts_path: /soc/pwm@0xF0230000/pwm3_chan4@4
          binding: D:\aworks_lp_hpm6450_general_sdk-0.9.1\platforms\platform-hpm-aworks-lp\components\aw_cpu_driver_hpm\dts\bindings\pwm\riscv,hpm-pwm.yaml


if DEV_PWM3_CHAN4

config DEV_PWM3_CHAN4_PWM_DEFAULT_PERIOD_NS
    int "Default PWM period (ns)"
    default 2000000


config DEV_PWM3_CHAN4_PWM_DEFAULT_DUTY_NS
    int "Default PWM duty (ns)"
    default 1000000


config DEV_PWM3_CHAN4_PWM_PAIR_ENABLE
    bool "pwm_pair_enable"
    default n
    help 
        When this option is enabled only as a complementary PWM device, the following configuration will take effect.


if DEV_PWM3_CHAN4_PWM_PAIR_ENABLE

config DEV_PWM3_CHAN4_PWM_PAIR_DEADTIME1
    int "Default pwm_pair deadtime1 (ns)"
    default 2
    range 0 1000000
    help 
        Default pwm_pair main deadtime (ns)


config DEV_PWM3_CHAN4_PWM_PAIR_DEADTIME2
    int "Default pwm_pair deadtime2 (ns)"
    default 2
    range 0 1000000
    help 
        Default pwm_pair complementary deadtime (ns)

endif #DEV_PWM3_CHAN4_PWM_PAIR_ENABLE

endif #DEV_PWM3_CHAN4
```

## .axioenvs/application.modbus_tcp_slave/build/gcc-riscv32.release/gen/Kconfig/Kconfig.component.EPC6450-AWI.device.hpm_pwm_timer_1
```kconfig
menuconfig DEV_PWM3
    bool "pwm3"
    default n
    visible if y
    select DRV_HPM_PWM_TIMER
    select DEV_PLIC0
    select DEV_PLIC0_INTERRUPT_RES_81
    select DEV_PLIC0_AWBL_INTCTLR_SERVICE

    help
      Filename: "/dev/pwm3"

      dts_dev_prop:
          name(unit): "hpm_pwm_timer" (1)
          compatible: ['riscv,hpm-pwm-ctrl']
          dts_path: /soc/pwm@0xF0230000
          binding: D:\aworks_lp_hpm6450_general_sdk-0.9.1\platforms\platform-hpm-aworks-lp\components\aw_cpu_driver_hpm\dts\bindings\pwm\riscv,hpm-pwm-ctrl.yaml




if DEV_PWM3
osource "D:/aworks_lp_hpm6450_general_sdk-0.9.1/demos/component/modbus/modbus_tcp_slave/.axioenvs/application.modbus_tcp_slave/build/gcc-riscv32.release/gen/Kconfig/Kconfig.component.EPC6450-AWI.device.hpm_pwm_8"
if !DEV_PWM3_CHAN0_PWM_PAIR_ENABLE
osource "D:/aworks_lp_hpm6450_general_sdk-0.9.1/demos/component/modbus/modbus_tcp_slave/.axioenvs/application.modbus_tcp_slave/build/gcc-riscv32.release/gen/Kconfig/Kconfig.component.EPC6450-AWI.device.hpm_pwm_9"
endif #DEV_PWM3_CHAN0_PWM_PAIR_ENABLE
osource "D:/aworks_lp_hpm6450_general_sdk-0.9.1/demos/component/modbus/modbus_tcp_slave/.axioenvs/application.modbus_tcp_slave/build/gcc-riscv32.release/gen/Kconfig/Kconfig.component.EPC6450-AWI.device.hpm_pwm_10"
if !DEV_PWM3_CHAN2_PWM_PAIR_ENABLE
osource "D:/aworks_lp_hpm6450_general_sdk-0.9.1/demos/component/modbus/modbus_tcp_slave/.axioenvs/application.modbus_tcp_slave/build/gcc-riscv32.release/gen/Kconfig/Kconfig.component.EPC6450-AWI.device.hpm_pwm_11"
endif #DEV_PWM3_CHAN2_PWM_PAIR_ENABLE
osource "D:/aworks_lp_hpm6450_general_sdk-0.9.1/demos/component/modbus/modbus_tcp_slave/.axioenvs/application.modbus_tcp_slave/build/gcc-riscv32.release/gen/Kconfig/Kconfig.component.EPC6450-AWI.device.hpm_pwm_12"
if !DEV_PWM3_CHAN4_PWM_PAIR_ENABLE
osource "D:/aworks_lp_hpm6450_general_sdk-0.9.1/demos/component/modbus/modbus_tcp_slave/.axioenvs/application.modbus_tcp_slave/build/gcc-riscv32.release/gen/Kconfig/Kconfig.component.EPC6450-AWI.device.hpm_pwm_13"
endif #DEV_PWM3_CHAN4_PWM_PAIR_ENABLE
osource "D:/aworks_lp_hpm6450_general_sdk-0.9.1/demos/component/modbus/modbus_tcp_slave/.axioenvs/application.modbus_tcp_slave/build/gcc-riscv32.release/gen/Kconfig/Kconfig.component.EPC6450-AWI.device.hpm_pwm_14"
if !DEV_PWM3_CHAN6_PWM_PAIR_ENABLE
osource "D:/aworks_lp_hpm6450_general_sdk-0.9.1/demos/component/modbus/modbus_tcp_slave/.axioenvs/application.modbus_tcp_slave/build/gcc-riscv32.release/gen/Kconfig/Kconfig.component.EPC6450-AWI.device.hpm_pwm_15"
endif #DEV_PWM3_CHAN6_PWM_PAIR_ENABLE

endif #DEV_PWM3
```
