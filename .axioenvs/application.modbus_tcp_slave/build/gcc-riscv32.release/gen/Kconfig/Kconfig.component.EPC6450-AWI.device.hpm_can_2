## .axioenvs/application.modbus_tcp_slave/build/gcc-riscv32.release/gen/Kconfig/Kconfig.component.EPC6450-AWI.device.hpm_can_2
```kconfig
menuconfig DEV_CAN2
    bool "can2"
    default n
    visible if y
    select DRV_HPM_CAN
    select DEV_PLIC0
    select DEV_PIN_1
    select DEV_PLIC0_INTERRUPT_RES_49
    select DEV_PLIC0_AWBL_INTCTLR_SERVICE
    select DEV_PIN_1_PIN_RES_193
    select DEV_PIN_1_AWB_PIN_SERVICE
    select DEV_PIN_1_PIN_RES_194

    help
      Filename: "/dev/can2"

      dts_dev_prop:
          name(unit): "hpm_can" (2)
          compatible: ['riscv,hpm_can']
          dts_path: /soc/can@F0088000
          binding: D:\aworks_lp_hpm6450_general_sdk-0.9.1\platforms\platform-hpm-aworks-lp\components\aw_cpu_driver_hpm\dts\bindings\can\riscv,hpm_can.yaml


if DEV_CAN2

config DEV_CAN2_DEFAULT_BAUDRATE
    int "the default baudrate (Kbps) for can,or arbitration field baudrate for canfd"
    default 500


config DEV_CAN2_RX_BUF_MSG_COUNT
    int "number of msg count that the rx buffer contain"
    default 256


config DEV_CAN2_ERR_BUF_MSG_COUNT
    int "number of msg count that the err buffer contain"
    default 16


config DEV_CAN2_ENABLE_TIMESTAMP
    bool "CAN msg add timestamp info"
    default y
    select DEV_PTPC 


config DEV_CAN2_IS_LISTEN_ONLY
    bool "CAN work in listen only mode"
    default n


config DEV_CAN2_RECV_SELF_SEND
    bool "CAN recv frames which is sent by himself"
    default n


config DEV_CAN2_IS_LOOPBACK
    bool "CAN work in loopback mode"
    default n


config DEV_CAN2_IS_CANFD_DEV
    bool "register CANFD device"
    default y


if DEV_CAN2_IS_CANFD_DEV

config DEV_CAN2_DATA_BAUDRATE
    int "data field baudrate (Kbps)"
    default 1000

endif #DEV_CAN2_IS_CANFD_DEV

endif #DEV_CAN2
```

## .axioenvs/application.modbus_tcp_slave/build/gcc-riscv32.release/gen/Kconfig/Kconfig.component.EPC6450-AWI.device.hpm_dao_0
```kconfig
menuconfig DEV_DAO
    bool "dao"
    default n
    visible if y
    select DRV_HPM_DAO

    help
      Filename: "/dev/dao"

      dts_dev_prop:
          name(unit): "hpm_dao" (0)
          compatible: ['riscv,hpm-dao']
          dts_path: /soc/dao@0xF0110000
          binding: D:\aworks_lp_hpm6450_general_sdk-0.9.1\platforms\platform-hpm-aworks-lp\components\aw_cpu_driver_hpm\dts\bindings\dao\riscv,hpm-dao.yaml


if DEV_DAO

config DEV_DAO_MONO_OUTPUT
    bool "mono_output"
    default n


config DEV_DAO_DEFAULT_OUTPUT_LEVEL
    string "default output level"
    default "DAO_DEFAULT_OUTPUT_ALL_LOW"
    enum
        "DAO_DEFAULT_OUTPUT_ALL_LOW"
        "DAO_DEFAULT_OUTPUT_ALL_HIGH"
        "DAO_DEFAULT_OUTPUT_P_HIGH_N_LOW"
        "DAO_DEFAULT_OUTPUT_DISABLED"


config DEV_DAO_CARD_ID
    int "Sound Card ID"
    default 0

endif #DEV_DAO
```

## .axioenvs/application.modbus_tcp_slave/build/gcc-riscv32.release/gen/Kconfig/Kconfig.component.EPC6450-AWI.device.hpm_dma_0
```kconfig
menuconfig DEV_HDMA
    bool "hdma"
    default n
    visible if y
    select DRV_HPM_DMA
    select DEV_PLIC0
    select DEV_PLIC0_INTERRUPT_RES_88
    select DEV_PLIC0_AWBL_INTCTLR_SERVICE

    help
      Filename: "/dev/hdma"

      dts_dev_prop:
          name(unit): "hpm_dma" (0)
          compatible: ['riscv,hpm-dma']
          dts_path: /soc/dma@0xF00C4000
          binding: D:\aworks_lp_hpm6450_general_sdk-0.9.1\platforms\platform-hpm-aworks-lp\components\aw_cpu_driver_hpm\dts\bindings\dma\riscv,hpm-dma.yaml


if DEV_HDMA

config DEV_HDMA_DAEMON_TASK_NAME
    string "daemon task name"
    default "dma_daemon_task"


config DEV_HDMA_DAEMON_TASK_PRIORITY
    int "daemon task priority"
    default 1
    range 0 7

endif #DEV_HDMA
```

## .axioenvs/application.modbus_tcp_slave/build/gcc-riscv32.release/gen/Kconfig/Kconfig.component.EPC6450-AWI.device.hpm_dma_1
```kconfig
menuconfig DEV_XDMA
    bool "xdma"
    default n
    visible if y
    select DRV_HPM_DMA
    select DEV_PLIC0
    select DEV_PLIC0_INTERRUPT_RES_87
    select DEV_PLIC0_AWBL_INTCTLR_SERVICE

    help
      Filename: "/dev/xdma"

      dts_dev_prop:
          name(unit): "hpm_dma" (1)
          compatible: ['riscv,hpm-dma']
          dts_path: /soc/dma@0xF3048000UL
          binding: D:\aworks_lp_hpm6450_general_sdk-0.9.1\platforms\platform-hpm-aworks-lp\components\aw_cpu_driver_hpm\dts\bindings\dma\riscv,hpm-dma.yaml


if DEV_XDMA

config DEV_XDMA_DAEMON_TASK_NAME
    string "daemon task name"
    default "dma_daemon_task"


config DEV_XDMA_DAEMON_TASK_PRIORITY
    int "daemon task priority"
    default 1
    range 0 7

endif #DEV_XDMA
```
