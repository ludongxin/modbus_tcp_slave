## .axioenvs/application.modbus_tcp_slave/build/gcc-riscv32.release/gen/Kconfig/Kconfig.component.EPC6450-AWI.device.hpm_sdio_1
```kconfig
menuconfig DEV_SDIO1
    bool "sdio1"
    default n
    visible if y
    select DRV_HPM_SDIO
    select DEV_PLIC0
    select DEV_PIN_1
    select DEV_PLIC0_INTERRUPT_RES_111
    select DEV_PLIC0_AWBL_INTCTLR_SERVICE
    select DEV_PIN_1_PIN_RES_124
    select DEV_PIN_1_AWB_PIN_SERVICE
    select DEV_PIN_1_PIN_RES_117
    select DEV_PIN_1_PIN_RES_118
    select DEV_PIN_1_PIN_RES_114
    select DEV_PIN_1_PIN_RES_113
    select DEV_PIN_1_PIN_RES_123
    select DEV_PIN_1_PIN_RES_122

    select DRV_SDIO_MEM_CARD
    help
      DTS_device_prop:
          name(unit): "hpm_sdio" (1)
          compatible: ['riscv,hpm-sdio']
          dts_path: /soc/sdio@0xF2034000
          binding: D:\aworks_lp_hpm6450_general_sdk-0.9.1\platforms\platform-hpm-aworks-lp\components\aw_cpu_driver_hpm\dts\bindings\sdio\riscv,hpm-sdio.yaml


if DEV_SDIO1

config DEV_SDIO1_WORKING_MODE
    string "use which working mode to transmit"
    default "AWB_SDIO_SD_4B_M"
    enum
        "AWB_SDIO_SD_1B_M"
        "AWB_SDIO_SD_4B_M"
        "AWB_SDIO_SD_8B_M"


config DEV_SDIO1_DMA_BUFF_SIZE
    int "dma buffer size"
    default 4096


config DEV_SDIO1_1V8_OPERATION_MODE_ENABLE
    bool "board hardware circuit support 1v8 sdcard operation mode"
    default n


config DEV_SDIO1_MMC_HIGHSPEEDE
    bool "MMC high-speed timing is supported"
    default n


config DEV_SDIO1_MMC_DDR_1_8V
    bool "eMMC high-speed DDR mode(1.8V I/O) is supported"
    default n


config DEV_SDIO1_MMC_DDR_1_2V
    bool "eMMC high-speed DDR mode(1.2V I/O) is supported"
    default n


config DEV_SDIO1_MMC_HS200_1_8V
    bool "eMMC HS200 mode(1.8V I/O) is supported"
    default n


config DEV_SDIO1_MMC_HS200_1_2V
    bool "eMMC HS200 mode(1.2V I/O) is supported"
    default n


config DEV_SDIO1_MMC_HS400_1_8V
    bool "eMMC HS400 mode(1.8V I/O) is supported"
    default n


config DEV_SDIO1_MMC_HS400_1_2V
    bool "eMMC HS400 mode(1.2V I/O) is supported"
    default n


config DEV_SDIO1_BOARD_VCCQ_VOLTAGE
    string "emmc card vccq voltage"
    default "SD_OPERATION_VOLTAGE_3V3"
    enum
        "SD_OPERATION_VOLTAGE_3V3"
        "SD_OPERATION_VOLTAGE_1V8"
        "SD_OPERATION_VOLTAGE_1V2"


config DEV_SDIO1_BOARD_VCC_VOLTAGE
    string "emmc card vcc voltage"
    default "SD_OPERATION_VOLTAGE_3V3"
    enum
        "SD_OPERATION_VOLTAGE_3V3"
        "SD_OPERATION_VOLTAGE_1V8"
        "SD_OPERATION_VOLTAGE_1V2"

endif #DEV_SDIO1
```

## .axioenvs/application.modbus_tcp_slave/build/gcc-riscv32.release/gen/Kconfig/Kconfig.component.EPC6450-AWI.device.hpm_spi_int_2
```kconfig
menuconfig DEV_SPI2
    bool "spi2"
    default n
    visible if y
    select DRV_HPM_SPI_INT
    select DEV_PLIC0
    select DEV_PIN_1
    select DEV_PLIC0_INTERRUPT_RES_29
    select DEV_PLIC0_AWBL_INTCTLR_SERVICE
    select DEV_PIN_1_PIN_RES_155
    select DEV_PIN_1_AWB_PIN_SERVICE
    select DEV_PIN_1_PIN_RES_158
    select DEV_PIN_1_PIN_RES_156
    select DEV_PIN_1_PIN_RES_159

    help
      Filename: "/dev/spi2"

      dts_dev_prop:
          name(unit): "hpm_spi_int" (2)
          compatible: ['riscv,hpm-spi_int']
          dts_path: /soc/spi@0xF0038000
          binding: D:\aworks_lp_hpm6450_general_sdk-0.9.1\platforms\platform-hpm-aworks-lp\components\aw_cpu_driver_hpm\dts\bindings\spi\riscv,hpm-spi_int.yaml


if DEV_SPI2

config DEV_SPI2_DEFAULT_SPI_CLK_RATE
    int "the rate of SPI's CLK signal"
    default 1000000
    enum
        500000
        1000000
        2000000
        4000000
        5000000
        10000000


config DEV_SPI2_CSHT
    string "The minimum time that cs should stay high"
    default "spi_csht_half_sclk_12"
    enum
        "spi_csht_half_sclk_1"
        "spi_csht_half_sclk_2"
        "spi_csht_half_sclk_3"
        "spi_csht_half_sclk_4"
        "spi_csht_half_sclk_5"
        "spi_csht_half_sclk_6"
        "spi_csht_half_sclk_7"
        "spi_csht_half_sclk_8"
        "spi_csht_half_sclk_9"
        "spi_csht_half_sclk_10"
        "spi_csht_half_sclk_11"
        "spi_csht_half_sclk_12"
        "spi_csht_half_sclk_13"
        "spi_csht_half_sclk_14"
        "spi_csht_half_sclk_15"
        "spi_csht_half_sclk_16"


config DEV_SPI2_CS2SCLK
    string "The time from cs becoming valid to the first sck edge"
    default "spi_cs2sclk_half_sclk_4"
    enum
        "spi_cs2sclk_half_sclk_1"
        "spi_cs2sclk_half_sclk_2"
        "spi_cs2sclk_half_sclk_3"
        "spi_cs2sclk_half_sclk_4"

config DEV_SPI2_CHIPSELECT_0
    bool "CS 0"
    default n
    help
      spi2 Chip Select 0
endif #DEV_SPI2
```

## .axioenvs/application.modbus_tcp_slave/build/gcc-riscv32.release/gen/Kconfig/Kconfig.component.EPC6450-AWI.device.hpm_spi_int_3
```kconfig
menuconfig DEV_SPI3
    bool "spi3"
    default n
    visible if y
    select DRV_HPM_SPI_INT
    select DEV_PLIC0
    select DEV_PIN_1
    select DEV_PLIC0_INTERRUPT_RES_30
    select DEV_PLIC0_AWBL_INTCTLR_SERVICE
    select DEV_PIN_1_PIN_RES_164
    select DEV_PIN_1_AWB_PIN_SERVICE
    select DEV_PIN_1_PIN_RES_167
    select DEV_PIN_1_PIN_RES_166
    select DEV_PIN_1_PIN_RES_163

    help
      Filename: "/dev/spi3"

      dts_dev_prop:
          name(unit): "hpm_spi_int" (3)
          compatible: ['riscv,hpm-spi_int']
          dts_path: /soc/spi@0xF003C000
          binding: D:\aworks_lp_hpm6450_general_sdk-0.9.1\platforms\platform-hpm-aworks-lp\components\aw_cpu_driver_hpm\dts\bindings\spi\riscv,hpm-spi_int.yaml


if DEV_SPI3

config DEV_SPI3_DEFAULT_SPI_CLK_RATE
    int "the rate of SPI's CLK signal"
    default 1000000
    enum
        500000
        1000000
        2000000
        4000000
        5000000
        10000000


config DEV_SPI3_CSHT
    string "The minimum time that cs should stay high"
    default "spi_csht_half_sclk_12"
    enum
        "spi_csht_half_sclk_1"
        "spi_csht_half_sclk_2"
        "spi_csht_half_sclk_3"
        "spi_csht_half_sclk_4"
        "spi_csht_half_sclk_5"
        "spi_csht_half_sclk_6"
        "spi_csht_half_sclk_7"
        "spi_csht_half_sclk_8"
        "spi_csht_half_sclk_9"
        "spi_csht_half_sclk_10"
        "spi_csht_half_sclk_11"
        "spi_csht_half_sclk_12"
        "spi_csht_half_sclk_13"
        "spi_csht_half_sclk_14"
        "spi_csht_half_sclk_15"
        "spi_csht_half_sclk_16"


config DEV_SPI3_CS2SCLK
    string "The time from cs becoming valid to the first sck edge"
    default "spi_cs2sclk_half_sclk_4"
    enum
        "spi_cs2sclk_half_sclk_1"
        "spi_cs2sclk_half_sclk_2"
        "spi_cs2sclk_half_sclk_3"
        "spi_cs2sclk_half_sclk_4"

config DEV_SPI3_CHIPSELECT_0
    bool "CS 0"
    default n
    help
      spi3 Chip Select 0
endif #DEV_SPI3
```

## .axioenvs/application.modbus_tcp_slave/build/gcc-riscv32.release/gen/Kconfig/Kconfig.component.EPC6450-AWI.device.hpm_timer_1
```kconfig
menuconfig DEV_TIMER1
    bool "timer1"
    default n
    visible if y
    select DRV_HPM_TIMER
    select DEV_PLIC0
    select DEV_PLIC0_INTERRUPT_RES_61
    select DEV_PLIC0_AWBL_INTCTLR_SERVICE

    help
      Filename: "/dev/timer1"

      dts_dev_prop:
          name(unit): "hpm_timer" (1)
          compatible: ['riscv,hpm-timer']
          dts_path: /soc/timer@0xF3004000
          binding: D:\aworks_lp_hpm6450_general_sdk-0.9.1\platforms\platform-hpm-aworks-lp\components\aw_cpu_driver_hpm\dts\bindings\timer\riscv,hpm-timer.yaml




if DEV_TIMER1
osource "D:/aworks_lp_hpm6450_general_sdk-0.9.1/demos/component/modbus/modbus_tcp_slave/.axioenvs/application.modbus_tcp_slave/build/gcc-riscv32.release/gen/Kconfig/Kconfig.component.EPC6450-AWI.device.hpm_timer_chan_4"
osource "D:/aworks_lp_hpm6450_general_sdk-0.9.1/demos/component/modbus/modbus_tcp_slave/.axioenvs/application.modbus_tcp_slave/build/gcc-riscv32.release/gen/Kconfig/Kconfig.component.EPC6450-AWI.device.hpm_timer_chan_5"
osource "D:/aworks_lp_hpm6450_general_sdk-0.9.1/demos/component/modbus/modbus_tcp_slave/.axioenvs/application.modbus_tcp_slave/build/gcc-riscv32.release/gen/Kconfig/Kconfig.component.EPC6450-AWI.device.hpm_timer_chan_6"
osource "D:/aworks_lp_hpm6450_general_sdk-0.9.1/demos/component/modbus/modbus_tcp_slave/.axioenvs/application.modbus_tcp_slave/build/gcc-riscv32.release/gen/Kconfig/Kconfig.component.EPC6450-AWI.device.hpm_timer_chan_7"

endif #DEV_TIMER1
```

## .axioenvs/application.modbus_tcp_slave/build/gcc-riscv32.release/gen/Kconfig/Kconfig.component.EPC6450-AWI.device.hpm_timer_2
```kconfig
menuconfig DEV_TIMER3
    bool "timer3"
    default n
    visible if y
    select DRV_HPM_TIMER
    select DEV_PLIC0
    select DEV_PLIC0_INTERRUPT_RES_63
    select DEV_PLIC0_AWBL_INTCTLR_SERVICE

    help
      Filename: "/dev/timer3"

      dts_dev_prop:
          name(unit): "hpm_timer" (2)
          compatible: ['riscv,hpm-timer']
          dts_path: /soc/timer@0xF300C000
          binding: D:\aworks_lp_hpm6450_general_sdk-0.9.1\platforms\platform-hpm-aworks-lp\components\aw_cpu_driver_hpm\dts\bindings\timer\riscv,hpm-timer.yaml




if DEV_TIMER3
osource "D:/aworks_lp_hpm6450_general_sdk-0.9.1/demos/component/modbus/modbus_tcp_slave/.axioenvs/application.modbus_tcp_slave/build/gcc-riscv32.release/gen/Kconfig/Kconfig.component.EPC6450-AWI.device.hpm_timer_chan_8"
osource "D:/aworks_lp_hpm6450_general_sdk-0.9.1/demos/component/modbus/modbus_tcp_slave/.axioenvs/application.modbus_tcp_slave/build/gcc-riscv32.release/gen/Kconfig/Kconfig.component.EPC6450-AWI.device.hpm_timer_chan_9"
osource "D:/aworks_lp_hpm6450_general_sdk-0.9.1/demos/component/modbus/modbus_tcp_slave/.axioenvs/application.modbus_tcp_slave/build/gcc-riscv32.release/gen/Kconfig/Kconfig.component.EPC6450-AWI.device.hpm_timer_chan_10"
osource "D:/aworks_lp_hpm6450_general_sdk-0.9.1/demos/component/modbus/modbus_tcp_slave/.axioenvs/application.modbus_tcp_slave/build/gcc-riscv32.release/gen/Kconfig/Kconfig.component.EPC6450-AWI.device.hpm_timer_chan_11"

endif #DEV_TIMER3
```

## .axioenvs/application.modbus_tcp_slave/build/gcc-riscv32.release/gen/Kconfig/Kconfig.component.EPC6450-AWI.device.hpm_timer_4
```kconfig
menuconfig DEV_TIMER5
    bool "timer5"
    default n
    visible if y
    select DRV_HPM_TIMER
    select DEV_PLIC0
    select DEV_PLIC0_INTERRUPT_RES_65
    select DEV_PLIC0_AWBL_INTCTLR_SERVICE

    help
      Filename: "/dev/timer5"

      dts_dev_prop:
          name(unit): "hpm_timer" (4)
          compatible: ['riscv,hpm-timer']
          dts_path: /soc/timer@0xF3014000
          binding: D:\aworks_lp_hpm6450_general_sdk-0.9.1\platforms\platform-hpm-aworks-lp\components\aw_cpu_driver_hpm\dts\bindings\timer\riscv,hpm-timer.yaml




if DEV_TIMER5
osource "D:/aworks_lp_hpm6450_general_sdk-0.9.1/demos/component/modbus/modbus_tcp_slave/.axioenvs/application.modbus_tcp_slave/build/gcc-riscv32.release/gen/Kconfig/Kconfig.component.EPC6450-AWI.device.hpm_timer_chan_16"
osource "D:/aworks_lp_hpm6450_general_sdk-0.9.1/demos/component/modbus/modbus_tcp_slave/.axioenvs/application.modbus_tcp_slave/build/gcc-riscv32.release/gen/Kconfig/Kconfig.component.EPC6450-AWI.device.hpm_timer_chan_17"
osource "D:/aworks_lp_hpm6450_general_sdk-0.9.1/demos/component/modbus/modbus_tcp_slave/.axioenvs/application.modbus_tcp_slave/build/gcc-riscv32.release/gen/Kconfig/Kconfig.component.EPC6450-AWI.device.hpm_timer_chan_18"
osource "D:/aworks_lp_hpm6450_general_sdk-0.9.1/demos/component/modbus/modbus_tcp_slave/.axioenvs/application.modbus_tcp_slave/build/gcc-riscv32.release/gen/Kconfig/Kconfig.component.EPC6450-AWI.device.hpm_timer_chan_19"

endif #DEV_TIMER5
```

## .axioenvs/application.modbus_tcp_slave/build/gcc-riscv32.release/gen/Kconfig/Kconfig.component.EPC6450-AWI.device.hpm_uart_3
```kconfig
menuconfig DEV_UART4
    bool "uart4"
    default n
    visible if y
    select DRV_HPM_UART
    select DEV_PLIC0
    select DEV_PLIC0_INTERRUPT_RES_35
    select DEV_PLIC0_AWBL_INTCTLR_SERVICE

    help
      Filename: "/dev/uart4"

      dts_dev_prop:
          name(unit): "hpm_uart" (3)
          compatible: ['riscv,hpm_uart']
          dts_path: /soc/uart@F0050000
          binding: D:\aworks_lp_hpm6450_general_sdk-0.9.1\platforms\platform-hpm-aworks-lp\components\aw_cpu_driver_hpm\dts\bindings\uart\riscv,hpm_uart.yaml


if DEV_UART4

config DEV_UART4_DEFAULT_BAUDRATE
    int "the default Baudrate for uart"
    default 115200


config DEV_UART4_RX_BUF_SIZE
    int "Size of receive buffer"
    default 128


config DEV_UART4_TX_BUF_SIZE
    int "Size of transmit buffer"
    default 0


config DEV_UART4_EN_RS485
    bool "Enable RS-485 or not"
    default n


if DEV_UART4_EN_RS485

config DEV_UART4_RS485_TX_LEVEL_HIGH
    bool "If Enable, Pin is high when RS-485 is in TX mode"
    default n
    help 
        Default: Pin is low when RS-485 is in TX mode. If Enable, Pin is high when RS-485 is in TX mode


config DEV_UART4_RS485_CUT_TIME
    int "Delay time for switching to receive mode after transmit in ms"
    default 1
    range 0 5000
    help 
        Delay time for switching to receive mode after transmit, Uint: ms. It takes effect after rs485 is enabled

endif #DEV_UART4_EN_RS485

endif #DEV_UART4
```

## .axioenvs/application.modbus_tcp_slave/build/gcc-riscv32.release/gen/Kconfig/Kconfig.component.EPC6450-AWI.device.hpm_uart_debug_0
```kconfig
menuconfig DEV_UART0
    bool "uart0"
    default y
    visible if y
    select DRV_HPM_UART_DEBUG
    select DEV_PLIC0
    select DEV_PIN_1
    select DEV_PLIC0_INTERRUPT_RES_31
    select DEV_PLIC0_AWBL_INTCTLR_SERVICE
    select DEV_PIN_1_PIN_RES_190
    select DEV_PIN_1_AWB_PIN_SERVICE
    select DEV_PIN_1_PIN_RES_189

    help
      Filename: "/dev/uart0"

      dts_dev_prop:
          name(unit): "hpm_uart_debug" (0)
          compatible: ['riscv,hpm_uart_dbg']
          dts_path: /soc/uart@F0040000
          binding: D:\aworks_lp_hpm6450_general_sdk-0.9.1\platforms\platform-hpm-aworks-lp\components\aw_cpu_driver_hpm\dts\bindings\uart\riscv,hpm_uart_dbg.yaml


if DEV_UART0

config DEV_UART0_DEFAULT_BAUDRATE
    int "the default Baudrate for uart"
    default 115200


config DEV_UART0_RX_BUF_SIZE
    int "Size of receive buffer"
    default 128


config DEV_UART0_TX_BUF_SIZE
    int "Size of transmit buffer"
    default 128

endif #DEV_UART0
```

## .axioenvs/application.modbus_tcp_slave/build/gcc-riscv32.release/gen/Kconfig/Kconfig.component.EPC6450-AWI.device.hpm_wdt_0
```kconfig
menuconfig DEV_WDT0
    bool "wdt0"
    default n
    visible if y
    select DRV_HPM_WDT
    select DEV_PLIC0
    select DEV_PLIC0_INTERRUPT_RES_52
    select DEV_PLIC0_AWBL_INTCTLR_SERVICE

    help
      Filename: "/dev/wdt0"

      dts_dev_prop:
          name(unit): "hpm_wdt" (0)
          compatible: ['riscv,hpm-wdt']
          dts_path: /soc/wdt@F0090000
          binding: D:\aworks_lp_hpm6450_general_sdk-0.9.1\platforms\platform-hpm-aworks-lp\components\aw_cpu_driver_hpm\dts\bindings\wdt\riscv,hpm-wdt.yaml


if DEV_WDT0

config DEV_WDT0_IS_INTERNAL_CLK
    bool "if setlect use Peripheral clk ,or use wdt external clk"
    default n

endif #DEV_WDT0
```
