## .axioenvs/application.modbus_tcp_slave/build/gcc-riscv32.release/gen/Kconfig/Kconfig.component.aw_cpu_driver_hpm.driver.hpm_rtc
```kconfig
menuconfig DRV_HPM_RTC
    bool "hpm_rtc ['riscv,hpm-rtc']"
    select AW_SUBSYS_TIME
    select AW_SUBSYS_PM_WAKEUP_TIMER
    select AW_DEV_API
    default n
```

## .axioenvs/application.modbus_tcp_slave/build/gcc-riscv32.release/gen/Kconfig/Kconfig.component.aw_cpu_driver_hpm.driver.hpm_sdio
```kconfig
menuconfig DRV_HPM_SDIO
    bool "hpm_sdio ['riscv,hpm-sdio']"
    select AW_SUBSYS_DRIVER_SDIO
    select AW_SUBSYS_SYSTEM_PM_PIN
    default n
```

## .axioenvs/application.modbus_tcp_slave/build/gcc-riscv32.release/gen/Kconfig/Kconfig.component.aw_cpu_driver_hpm.driver.hpm_spi_polling
```kconfig
menuconfig DRV_HPM_SPI_POLLING
    bool "hpm_spi_polling ['riscv,hpm-spi_polling']"
    select AW_SUBSYS_DRIVER_SPI
    select AW_SUBSYS_SYSTEM_PM_PIN
    default n
```

## .axioenvs/application.modbus_tcp_slave/build/gcc-riscv32.release/gen/Kconfig/Kconfig.component.aw_cpu_driver_hpm.driver.hpm_spi_slave
```kconfig
menuconfig DRV_HPM_SPI_SLAVE
    bool "hpm_spi_slave ['riscv,hpm-spi,slave']"
    select AW_SUBSYS_DRIVER_SPI
    select AW_SUBSYS_SYSTEM_PM_PIN
    default n
    help
        Example of adding device to board.dts:

        To use spi_slave you can config pin in pins.dts as follow: 
        &spi2{
            pins = <&pin1 PIN_PC25  (IOC_PC25_FUNC_CTL_SPI2_SCLK|HPM_PIN_LOOP_BACK(_HPM_PIN_LOOP_BACK_ON))
                                    (IOC_PC25_FUNC_CTL_SPI2_SCLK|HPM_PIN_LOOP_BACK(_HPM_PIN_LOOP_BACK_ON))
                                    (IOC_PC25_FUNC_CTL_SPI2_SCLK|HPM_PIN_LOOP_BACK(_HPM_PIN_LOOP_BACK_ON))
                    &pin1 PIN_PC23  (IOC_PC23_FUNC_CTL_SPI2_MOSI)
                                    (IOC_PC23_FUNC_CTL_SPI2_MOSI)
                                    (IOC_PC23_FUNC_CTL_SPI2_MOSI)
                    &pin1 PIN_PC24  (IOC_PC24_FUNC_CTL_SPI2_MISO)
                                    (IOC_PC24_FUNC_CTL_SPI2_MISO)
                                    (IOC_PC24_FUNC_CTL_SPI2_MISO)>;
            cs-pins = <&pin1 PIN_PC22 (IOC_PC22_FUNC_CTL_SPI2_CSN)
                                      (IOC_PC22_FUNC_CTL_SPI2_CSN)
                                      (IOC_PC22_FUNC_CTL_SPI2_CSN)>;
        };

        Parameters:

           dev_clk:  the clk for lpspi
```

## .axioenvs/application.modbus_tcp_slave/build/gcc-riscv32.release/gen/Kconfig/Kconfig.component.aw_cpu_driver_hpm.driver.hpm_timer
```kconfig
menuconfig DRV_HPM_TIMER
    bool "hpm_timer ['riscv,hpm-timer']"
    select AW_SUBSYS_DRIVER_HWTIMER
    default n
```

## .axioenvs/application.modbus_tcp_slave/build/gcc-riscv32.release/gen/Kconfig/Kconfig.component.aw_cpu_driver_hpm.driver.hpm_timer_chan
```kconfig
menuconfig DRV_HPM_TIMER_CHAN
    bool "hpm_timer_chan ['riscv,hpm-timer-chan']"
    select AW_MATH
    select AW_SUBSYS_DRIVER_HWTIMER
    select AW_SUBSYS_DRIVER_HWTIMER_DELAY
    select AW_SUBSYS_DRIVER_HWTIMER_COUNT
    select AW_SUBSYS_DRIVER_HWTIMER_CAP
    select AW_SUBSYS_DRIVER_PWM
    select AW_SUBSYS_DRIVER_HWTIMER_PERIOD
    select AW_SUBSYS_SYSTEM_PM_PIN
    select AWBUS_DEV_SHUTDOWN_EN
    default n

if DRV_HPM_TIMER_CHAN

source "D:/aworks_lp_hpm6450_general_sdk-0.9.1/platforms/platform-hpm-aworks-lp/components/aw_cpu_driver_hpm/dts/bindings/timer/riscv,hpm-timer-chan.Kconfig.opts"

endif #DRV_HPM_TIMER_CHAN
```

## .axioenvs/application.modbus_tcp_slave/build/gcc-riscv32.release/gen/Kconfig/Kconfig.component.aw_cpu_driver_hpm.driver.hpm_uart_lin
```kconfig
menuconfig DRV_HPM_UART_LIN
    bool "hpm_uart_lin ['riscv,hpm_uart_lin']"
    select AW_SUBSYS_DRIVER_SERIAL
    select AW_SUBSYS_SYSTEM_PM_PIN
    default n
```

## .axioenvs/application.modbus_tcp_slave/build/gcc-riscv32.release/gen/Kconfig/Kconfig.component.aw_cpu_driver_hpm.driver.hpm_usb
```kconfig
menuconfig DRV_HPM_USB
    bool "hpm_usb ['riscv,hpm-usb']"
    select AW_SUBSYS_USB
    default n
```

## .axioenvs/application.modbus_tcp_slave/build/gcc-riscv32.release/gen/Kconfig/Kconfig.component.aw_cpu_driver_hpm.driver.hpm_wdt
```kconfig
menuconfig DRV_HPM_WDT
    bool "hpm_wdt ['riscv,hpm-wdt']"
    select AW_SUBSYS_DRIVER_HWWDOG
    select AWBUS_DEV_SHUTDOWN_EN
    default n
```

## .axioenvs/application.modbus_tcp_slave/build/gcc-riscv32.release/gen/Kconfig/Kconfig.component.aw_ctype
```kconfig
menuconfig AW_CTYPE
    bool "component aw_ctype"
    libsafe 
    select AW_INTERFACE
    default n
    help
        Version: 0.0.0

        
```

## .axioenvs/application.modbus_tcp_slave/build/gcc-riscv32.release/gen/Kconfig/Kconfig.component.aw_dev_api
```kconfig
menuconfig AW_DEV_API
    bool "AWorks API of devices"
    libsafe 
    select AW_COMMON_IOCTL_CODE
    select AW_API_TIMETRANS_LOCAL
    select AW_MEM_MANAGER_RINGBUFFER
    default y
    help
        Version: 0.0.0

        
```

## .axioenvs/application.modbus_tcp_slave/build/gcc-riscv32.release/gen/Kconfig/Kconfig.component.aw_dump_stack
```kconfig
menuconfig AW_DUMP_STACK
    bool "AWorks dump stack"
    libsafe 
    select AW_INTERFACE
    default n
    help
        Version: 0.0.0

        
if AW_DUMP_STACK

source "D:/aworks_lp_hpm6450_general_sdk-0.9.1/frameworks/64cf32e2-aworks_lp/components/kernel/aw_dump_stack/Kconfig.opts"

endif #AW_DUMP_STACK
```

## .axioenvs/application.modbus_tcp_slave/build/gcc-riscv32.release/gen/Kconfig/Kconfig.component.aw_err_to_errno
```kconfig
menuconfig AW_ERR_TO_ERRNO
    bool "AWorks err to errno convert"
    libsafe 
    select AW_INTERFACE
    default n
    help
        Version: 0.0.0

        
```

## .axioenvs/application.modbus_tcp_slave/build/gcc-riscv32.release/gen/Kconfig/Kconfig.component.aw_fs_littlefs
```kconfig
menuconfig AW_FS_LITTLEFS
    bool "Littlefs"
    libsafe 
    select AW_IO_BASE
    select AW_STDIO
    select AW_SUBSYS_DRIVER_MTD
    select AW_MEM_MANAGE_MEM_POOL
    select AWB_VFS_MOUNT_EN
    default n
    help
        Version: 0.0.0

        
if AW_FS_LITTLEFS

source "D:/aworks_lp_hpm6450_general_sdk-0.9.1/frameworks/64cf32e2-aworks_lp/components/kernel/aw_fs_littlefs/Kconfig.opts"

endif #AW_FS_LITTLEFS
```

## .axioenvs/application.modbus_tcp_slave/build/gcc-riscv32.release/gen/Kconfig/Kconfig.component.aw_fs_romfs
```kconfig
menuconfig AW_FS_ROMFS
    bool "Romfs"
    libsafe 
    select AW_SUBSYS_DRIVER_MTD
    select AW_SUBSYS_STORAGE_BLOCKDEV
    select AW_MEM_MANAGE_MEM_POOL
    select AW_IO_BASE
    select AWB_VFS_MOUNT_EN
    default n
    help
        Version: 0.0.0

        
if AW_FS_ROMFS

source "D:/aworks_lp_hpm6450_general_sdk-0.9.1/frameworks/64cf32e2-aworks_lp/components/kernel/aw_fs_romfs/Kconfig.opts"

endif #AW_FS_ROMFS
```

## .axioenvs/application.modbus_tcp_slave/build/gcc-riscv32.release/gen/Kconfig/Kconfig.component.aw_fs_txfs
```kconfig
menuconfig AW_FS_TXFS
    bool "TXFS"
    libsafe 
    select AW_API_TIME
    select AWORKS_BASE
    select AW_IO_BASE
    select AW_MEM_MANAGE_MEM_POOL
    select AW_OS_DEFER
    select AWB_PM_NOTIFY
    select AW_SUBSYS_STORAGE_BLOCKDEV
    select AWB_VFS_MOUNT_EN
    default n
    help
        Version: 0.0.0

        Detail:This file system may have some lock usage errors,don's use it if no necessary.
if AW_FS_TXFS

source "D:/aworks_lp_hpm6450_general_sdk-0.9.1/frameworks/64cf32e2-aworks_lp/components/kernel/aw_fs_txfs/Kconfig.opts"

endif #AW_FS_TXFS
```

## .axioenvs/application.modbus_tcp_slave/build/gcc-riscv32.release/gen/Kconfig/Kconfig.component.aw_ftpd
```kconfig
menuconfig AW_FTPD
    bool "FTPD"
    libsafe 
    select AW_API_NETDB
    select AW_API_TIME
    select AW_STDLIB
    select AW_DEV_API
    select AW_IO_DIR
    select RTK_OBJECT_CREATE_EN
    select COMPILER_SUPPORT_LIBC_MALLOC_FREE
    select COMPILER_SUPPORT_POSIX_SOCKET
    select COMPILER_SUPPORT_LIBC_TIME
    select COMPILER_SUPPORT_STDIO
    select AW_INFOF_ENABLE
    select AW_ERRF_ENABLE
    default n
    help
        Version: 1.0.11

        Detail:Mini-ftpd
if AW_FTPD

source "D:/aworks_lp_hpm6450_general_sdk-0.9.1/components/aw_ftpd/Kconfig.opts"

endif #AW_FTPD
```

## .axioenvs/application.modbus_tcp_slave/build/gcc-riscv32.release/gen/Kconfig/Kconfig.component.aw_gnss
```kconfig
menuconfig AW_GNSS
    bool "AWorks GNSS"
    libsafe 
    default n
    help
        Version: 0.3.0

        
if AW_GNSS

source "D:/aworks_lp_hpm6450_general_sdk-0.9.1/components/aw_gnss/Kconfig.opts"

endif #AW_GNSS
```

## .axioenvs/application.modbus_tcp_slave/build/gcc-riscv32.release/gen/Kconfig/Kconfig.component.aw_goahead_adapter
```kconfig
menuconfig AW_GOAHEAD_ADAPTER
    bool "GoAhead adaptation layer of AWorks"
    libsafe 
    select COMPILER_SUPPORT_POSIX_SOCKET
    select COMPILER_SUPPORT_POSIX_FILE
    select COMPILER_SUPPORT_LIBC_TIME
    select COMPILER_SUPPORT_STDIO
    default n
    help
        Version: 1.0.5

        
if AW_GOAHEAD_ADAPTER

source "D:/aworks_lp_hpm6450_general_sdk-0.9.1/components/aw_goahead_adapter/Kconfig.opts"

endif #AW_GOAHEAD_ADAPTER
```

## .axioenvs/application.modbus_tcp_slave/build/gcc-riscv32.release/gen/Kconfig/Kconfig.component.aw_gprs
```kconfig
menuconfig AW_GPRS
    bool "GPRS"
    libsafe 
    select PPP_SUPPORT
    default n
    help
        Version: 1.0.16

        Detail:This component provide 4G/GPRS module base command and attach LWIP by PPP connect.
if AW_GPRS


osource  "$(ax_imp_paths,gprs_adapter_inteface,,False)"

endif #AW_GPRS
```

## .axioenvs/application.modbus_tcp_slave/build/gcc-riscv32.release/gen/Kconfig/Kconfig.component.aw_gprs_adapter
```kconfig
menuconfig AW_GPRS_ADAPTER
    bool "AWorks GPRS Adapter"
    libsafe 
    select AWB_INET_LWIP_TOP
    select AW_INTERFACE
    select COMPILER_SUPPORT_LIBC_MALLOC_FREE
    default n
    help
        Version: 0.0.0

        
```

## .axioenvs/application.modbus_tcp_slave/build/gcc-riscv32.release/gen/Kconfig/Kconfig.component.aw_io_dir
```kconfig
menuconfig AW_IO_DIR
    bool "AWorks IO Dir support"
    libsafe 
    select AW_INTERFACE
    default n
    help
        Version: 0.0.0

        Detail:This component provide base IO dirs APIs(such as,aw_opendir,aw_closedir,aw_readdir) in AWorks
```

## .axioenvs/application.modbus_tcp_slave/build/gcc-riscv32.release/gen/Kconfig/Kconfig.component.aw_kallsyms
```kconfig
menuconfig AW_KALLSYMS
    bool "AWorks kernel all symbols"
    libsafe 
    select AW_INTERFACE
    select AW_STDIO
    default n
    help
        Version: 0.0.0

        
if AW_KALLSYMS

source "D:/aworks_lp_hpm6450_general_sdk-0.9.1/frameworks/64cf32e2-aworks_lp/components/kernel/aw_kallsyms/Kconfig.opts"

endif #AW_KALLSYMS
```

## .axioenvs/application.modbus_tcp_slave/build/gcc-riscv32.release/gen/Kconfig/Kconfig.component.aw_libjpeg_turbo_adapter
```kconfig
menuconfig AW_LIBJPEG_TURBO_ADAPTER
    bool "libjpeg-turbo adaptation layer of AWorks"
    libsafe 
    select COMPILER_SUPPORT_POSIX_FILE
    select COMPILER_SUPPORT_STDIO
    default n
    help
        Version: 0.1.0

        
if AW_LIBJPEG_TURBO_ADAPTER

source "D:/aworks_lp_hpm6450_general_sdk-0.9.1/components/aw_libjpeg_turbo_adapter/Kconfig.opts"

endif #AW_LIBJPEG_TURBO_ADAPTER
```

## .axioenvs/application.modbus_tcp_slave/build/gcc-riscv32.release/gen/Kconfig/Kconfig.component.aw_log
```kconfig
menuconfig AW_LOG
    bool "AWorks Logger"
    libsafe 
    select AW_INTERFACE
    select AW_API_TIME
    select AW_COMMON_IOCTL_CODE
    select AW_OS_DELAYED_WORK
    select AW_OS_SYS_DEFER
    default n
    help
        Version: 1.0.4

        
if AW_LOG

source "D:/aworks_lp_hpm6450_general_sdk-0.9.1/components/aw_log/Kconfig.opts"

endif #AW_LOG
```
