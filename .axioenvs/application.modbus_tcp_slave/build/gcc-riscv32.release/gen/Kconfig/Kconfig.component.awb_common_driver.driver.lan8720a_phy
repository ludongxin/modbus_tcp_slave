## .axioenvs/application.modbus_tcp_slave/build/gcc-riscv32.release/gen/Kconfig/Kconfig.component.awb_common_driver.driver.lan8720a_phy
```kconfig
menuconfig DRV_LAN8720A_PHY
    bool "lan8720a_phy ['microchip,lan8720a']"
    select AW_SUBSYS_SYSTEM_PM_PIN
    select AW_SUBSYS_DRIVER_PHY_POLL
    default n
    help
        Example of adding device to board.dts:

        &eth1 {
           phy-handle = <&lan8720a_0>;
            lan8720a_0:lan8720a_phy@0x01{
                compatible = "microchip,lan8720a";
                status = "disabled";
                label = "lan8720a_0";
                reg = <0x01>;
                rst-pins = <&pin1 PIN_PF09   (IOC_PF07_FUNC_CTL_GPIO_F_07|AW_PIN_CFG_GPIO_OUTPUT_HIGH)
                                             (IOC_PF07_FUNC_CTL_GPIO_F_07|AW_PIN_CFG_GPIO_OUTPUT_HIGH)
                                             (IOC_PF07_FUNC_CTL_GPIO_F_07|AW_PIN_CFG_GPIO_OUTPUT_HIGH)>;
            };
        };
        And also, you can config pin in pins.dts as follow:
        

        &lan8720a_1 {
             rst-pins = <&pin1 PIN_PF09  (IOC_PF07_FUNC_CTL_GPIO_F_07|AW_PIN_CFG_GPIO_OUTPUT_HIGH)
                                         (IOC_PF07_FUNC_CTL_GPIO_F_07|AW_PIN_CFG_GPIO_OUTPUT_HIGH)
                                         (IOC_PF07_FUNC_CTL_GPIO_F_07|AW_PIN_CFG_GPIO_OUTPUT_HIGH)>;
        };

        Parameters:

           dev_clk:  if use MCU internal clk output for PHY work, must set it correct; otherwise, this item can be omitted.
```

## .axioenvs/application.modbus_tcp_slave/build/gcc-riscv32.release/gen/Kconfig/Kconfig.component.awb_common_driver.driver.lis2dw12tr
```kconfig
menuconfig DRV_LIS2DW12TR
    bool "lis2dw12tr ['ST,lis2dw12tr']"
    select AW_SUBSYS_DRIVER_SENSOR
    select AW_OS_ISR_DEFER
    default n
    help
        Example of adding device to board.dts:

        &i2c2{
            lis2dw12tr:lis2dw12tr@0x19 {
                compatible = "ST,lis2dw12tr";
                status = "disabled";
                label = "LIS2DW12TR";
                reg = <0x19>;
                data-pins  = <&pin1 PIN_PB08 IOC_PB08_FUNC_CTL_GPIO_B_08 (IOC_PB08_FUNC_CTL_GPIO_B_08|AW_PIN_CFG_GPIO_INPUT) IOC_PB08_FUNC_CTL_GPIO_B_08>;
                event-pins = <&pin1 PIN_PB09 IOC_PB09_FUNC_CTL_GPIO_B_09 (IOC_PB09_FUNC_CTL_GPIO_B_09|AW_PIN_CFG_GPIO_INPUT) IOC_PB09_FUNC_CTL_GPIO_B_09>;
            };
        };
        

        And also, you can config pin in pins.dts as follow:
        

        &lis2dw12tr{
            data-pins  = <&pin1 PIN_PB08 IOC_PB08_FUNC_CTL_GPIO_B_08 (IOC_PB08_FUNC_CTL_GPIO_B_08|AW_PIN_CFG_GPIO_INPUT) IOC_PB08_FUNC_CTL_GPIO_B_08>;
            event-pins = <&pin1 PIN_PB09 IOC_PB09_FUNC_CTL_GPIO_B_09 (IOC_PB09_FUNC_CTL_GPIO_B_09|AW_PIN_CFG_GPIO_INPUT) IOC_PB09_FUNC_CTL_GPIO_B_09>;
        };
```

## .axioenvs/application.modbus_tcp_slave/build/gcc-riscv32.release/gen/Kconfig/Kconfig.component.awb_common_driver.driver.lis3mdl
```kconfig
menuconfig DRV_LIS3MDL
    bool "lis3mdl ['ST,lis3mdl']"
    select AW_SUBSYS_DRIVER_SENSOR
    select AW_OS_ISR_DEFER
    default n
    help
        Example of adding device to board.dts:

        &i2c1{
            lis3mdl:lis3mdl@1c {
                compatible = "ST,lis3mdl";
                label = "LIS3MDL";
                status = "disabled";
                reg = <0x1c>;
                event-pins = <&pin1 GPIO1_28 GPIO1_28_GPIO (GPIO1_28_GPIO|AW_PIN_CFG_GPIO_INPUT) GPIO1_28_GPIO>;
                data-pins  = <&pin1 GPIO1_30 GPIO1_30_GPIO (GPIO1_30_GPIO|AW_PIN_CFG_GPIO_INPUT) GPIO1_30_GPIO>;
            };
        };
        

        And also, you can config pin in pins.dts as follow:
        

        &lis3mdl{
            event-pins = <&pin1 GPIO1_28 GPIO1_28_GPIO (GPIO1_28_GPIO|AW_PIN_CFG_GPIO_INPUT) GPIO1_28_GPIO>;
            data-pins  = <&pin1 GPIO1_30 GPIO1_30_GPIO (GPIO1_30_GPIO|AW_PIN_CFG_GPIO_INPUT) GPIO1_30_GPIO>;
        };
```

## .axioenvs/application.modbus_tcp_slave/build/gcc-riscv32.release/gen/Kconfig/Kconfig.component.awb_common_driver.driver.lsm6dsl
```kconfig
menuconfig DRV_LSM6DSL
    bool "lsm6dsl ['ST,lsm6dsl']"
    select AW_SUBSYS_DRIVER_SENSOR
    select AW_OS_ISR_DEFER
    default n
    help
        Example of adding device to board.dts:

        &i2c1{
            lsm6dsl:lsm6dsl@6b {
                compatible = "ST,lsm6dsl";
                label = "LSM6DSL";
                status = "disabled";
                reg = <0x6b>;
                event-pins = <&pin1 GPIO1_14 GPIO1_14_GPIO (GPIO1_14_GPIO|AW_PIN_CFG_GPIO_INPUT) GPIO1_14_GPIO>;
                data-pins  = <&pin1 GPIO1_15 GPIO1_15_GPIO (GPIO1_15_GPIO|AW_PIN_CFG_GPIO_INPUT) GPIO1_15_GPIO>;
            };
        };
        

        And also, you can config pin in pins.dts as follow:
        

        &lsm6dsl{
            event-pins = <&pin1 GPIO1_14 GPIO1_14_GPIO (GPIO1_14_GPIO|AW_PIN_CFG_GPIO_INPUT) GPIO1_14_GPIO>;
            data-pins  = <&pin1 GPIO1_15 GPIO1_15_GPIO (GPIO1_15_GPIO|AW_PIN_CFG_GPIO_INPUT) GPIO1_15_GPIO>;
        };
```

## .axioenvs/application.modbus_tcp_slave/build/gcc-riscv32.release/gen/Kconfig/Kconfig.component.awb_common_driver.driver.mcp2515
```kconfig
menuconfig DRV_MCP2515
    bool "mcp2515 ['mcp,mcp2515']"
    select AW_SUBSYS_DRIVER_SPI
    select AW_SUBSYS_DRIVER_CAN
    select AW_SUBSYS_SYSTEM_PM_PIN
    select AW_OS_ISR_DEFER
    default n
    help
        Example of adding device to board.dts:

        &spi2 {
            mcp2515:mcp2515@0{
                compatible = "mcp,mcp2515";
                label = "MCP2515";
                reg = <0>; /* cs index, chipselects from the spi host */
                status = "disabled";
                isr-pins = <&pin1 PIN_GPIO_19 PIN_GPIO_19_DEFAULT PIN_GPIO_19_DEFAULT PIN_GPIO_19_DEFAULT>;
           };
        };
        

        And also, you can config pin in pins.dts as follow:
        

        &mcp2517fd{
            isr-pins = <&pin1 PIN_GPIO_19 PIN_GPIO_19_DEFAULT PIN_GPIO_19_DEFAULT PIN_GPIO_19_DEFAULT>;
        };

if DRV_MCP2515

source "D:/aworks_lp_hpm6450_general_sdk-0.9.1/frameworks/64cf32e2-aworks_lp/subsys/awb_common_driver/dts/bindings/mcp2515/mcp,mcp2515.Kconfig.opts"

endif #DRV_MCP2515
```

## .axioenvs/application.modbus_tcp_slave/build/gcc-riscv32.release/gen/Kconfig/Kconfig.component.awb_common_driver.driver.mcp2517fd
```kconfig
menuconfig DRV_MCP2517FD
    bool "mcp2517fd ['mcp,mcp2517fd']"
    select AW_SUBSYS_DRIVER_SPI
    select AW_SUBSYS_DRIVER_CAN
    select AW_SUBSYS_SYSTEM_PM_PIN
    select AW_OS_ISR_DEFER
    default n
    help
        Example of adding device to board.dts:

        &spi2 {
            mcp2517fd:mcp2517fd@0{
                compatible = "mcp,mcp2517fd";
                label = "MCP2517FD";
                reg = <0>; /* cs index, chipselects from the spi host */
                status = "disabled";
                isr-pins = <&pin1 PIN_SDMMC1_CMD PIN_SDMMC1_CMD_GPIO_24 PIN_SDMMC1_CMD_GPIO_24 PIN_SDMMC1_CMD_GPIO_24>; 
           };
        };
        

        And also, you can config pin in pins.dts as follow:
        

        &mcp2517fd{
            isr-pins = <&pin1 PIN_SDMMC1_CMD PIN_SDMMC1_CMD_GPIO_24 PIN_SDMMC1_CMD_GPIO_24 PIN_SDMMC1_CMD_GPIO_24>; 
        };

if DRV_MCP2517FD

source "D:/aworks_lp_hpm6450_general_sdk-0.9.1/frameworks/64cf32e2-aworks_lp/subsys/awb_common_driver/dts/bindings/mcp2517fd/mcp,mcp2517fd.Kconfig.opts"

endif #DRV_MCP2517FD
```

## .axioenvs/application.modbus_tcp_slave/build/gcc-riscv32.release/gen/Kconfig/Kconfig.component.awb_common_driver.driver.pcf85063
```kconfig
menuconfig DRV_PCF85063
    bool "pcf85063 ['nxp,pcf85063']"
    select AW_SUBSYS_TIME
    default n
    help
        Example of adding device to board.dts:

        &i2c0{
            pcf85063:pcf85063@0x51{
                compatible = "nxp,pcf85063";
                status = "disabled";
                label = "pcf85063";
                reg = <0x51>;
            };
        };
```

## .axioenvs/application.modbus_tcp_slave/build/gcc-riscv32.release/gen/Kconfig/Kconfig.component.awb_common_driver.driver.pwm_buzzer
```kconfig
menuconfig DRV_PWM_BUZZER
    bool "pwm-buzzer ['pwm-buzzer']"
    select AW_SUBSYS_DRIVER_PWM
    select AWBUS
    default n
    help
        Example of adding device to board.dts:

        / {
            buzzer{
                compatible = "pwm-buzzer";
                label = "Buzzer";
                status = "disabled";
                beep_level = <50>;
                pwm_freq = <2731>;
            };
        };

        Parameters:

           beep_level:  PWM duty cycle(0%-100%).

           pwm_freq:  PWM input frequency(unit:Hz)


if DRV_PWM_BUZZER

source "D:/aworks_lp_hpm6450_general_sdk-0.9.1/frameworks/64cf32e2-aworks_lp/subsys/awb_common_driver/dts/bindings/buzzer/awb_pwm_buzzer.Kconfig.opts"

endif #DRV_PWM_BUZZER
```

## .axioenvs/application.modbus_tcp_slave/build/gcc-riscv32.release/gen/Kconfig/Kconfig.component.awb_common_driver.driver.ramdisk
```kconfig
menuconfig DRV_RAMDISK
    bool "ramdisk ['general,ramdisk']"
    select AWBUS
    select AW_SUBSYS_STORAGE_BLOCKDEV
    default n
    help
        Example of adding device to board.dts:

        / {
            ramdisk@0{
                compatible = "general,ramdisk";
                label = "ramdisk";
                reg = <0 4>;
                status = "disabled";
            };
        };

if DRV_RAMDISK

source "D:/aworks_lp_hpm6450_general_sdk-0.9.1/frameworks/64cf32e2-aworks_lp/subsys/awb_common_driver/dts/bindings/ramdisk/general,ramdisk.Kconfig.opts"

endif #DRV_RAMDISK
```

## .axioenvs/application.modbus_tcp_slave/build/gcc-riscv32.release/gen/Kconfig/Kconfig.component.awb_common_driver.driver.riscv_mcycle
```kconfig
menuconfig DRV_RISCV_MCYCLE
    bool "riscv_mcycle ['riscv,mcycle']"
    select AWBUS
    default n

if DRV_RISCV_MCYCLE

source "D:/aworks_lp_hpm6450_general_sdk-0.9.1/frameworks/64cf32e2-aworks_lp/subsys/awb_common_driver/dts/bindings/riscv_mcycle/riscv,mcycle.Kconfig.opts"

endif #DRV_RISCV_MCYCLE
```

## .axioenvs/application.modbus_tcp_slave/build/gcc-riscv32.release/gen/Kconfig/Kconfig.component.awb_common_driver.driver.rtl9010_phy
```kconfig
menuconfig DRV_RTL9010_PHY
    bool "rtl9010_phy ['realtek,rtl9010']"
    select AW_SUBSYS_SYSTEM_PM_PIN
    select AW_SUBSYS_DRIVER_PHY_POLL
    default n
    help
        Example of adding device to board.dts:

         &eth1 { 
            phy-handle = <&rtl9010>;
            rtl9010:rtl9010_phy@0x02{
                compatible = "motorcomm,rtl9010";
                status = "disabled";
                dev_clk = <HPM_CLK_TOP_AHB0>;
                label = "rtl9010";
                reg = <0x02>;
                rst-pins = <&pin1 PIN_PE14   (IOC_PE14_FUNC_CTL_GPIO_E_14|AW_PIN_CFG_GPIO_OUTPUT_HIGH)
                                             (IOC_PE14_FUNC_CTL_GPIO_E_14|AW_PIN_CFG_GPIO_OUTPUT_HIGH)
                                             (IOC_PE14_FUNC_CTL_GPIO_E_14|AW_PIN_CFG_GPIO_OUTPUT_HIGH)>;
                int-pins = <&pin1 PIN_PE15   (IOC_PE15_FUNC_CTL_GPIO_E_15|AW_PIN_CFG_GPIO_INPUT|AW_PIN_CFG_PULL_UP)
                                             (IOC_PE15_FUNC_CTL_GPIO_E_15|AW_PIN_CFG_GPIO_INPUT|AW_PIN_CFG_PULL_UP)
                                             (IOC_PE15_FUNC_CTL_GPIO_E_15|AW_PIN_CFG_GPIO_INPUT|AW_PIN_CFG_PULL_UP)>;
        };
        

        And also, you can config pin in pins.dts as follow:
        

        &rtl9010{  
                rst-pins = <&pin1 PIN_PE14   (IOC_PE14_FUNC_CTL_GPIO_E_14|AW_PIN_CFG_GPIO_OUTPUT_HIGH)
                                             (IOC_PE14_FUNC_CTL_GPIO_E_14|AW_PIN_CFG_GPIO_OUTPUT_HIGH)
                                             (IOC_PE14_FUNC_CTL_GPIO_E_14|AW_PIN_CFG_GPIO_OUTPUT_HIGH)>;
                int-pins = <&pin1 PIN_PE15   (IOC_PE15_FUNC_CTL_GPIO_E_15|AW_PIN_CFG_GPIO_INPUT|AW_PIN_CFG_PULL_UP)
                                             (IOC_PE15_FUNC_CTL_GPIO_E_15|AW_PIN_CFG_GPIO_INPUT|AW_PIN_CFG_PULL_UP)
                                             (IOC_PE15_FUNC_CTL_GPIO_E_15|AW_PIN_CFG_GPIO_INPUT|AW_PIN_CFG_PULL_UP)>;
        };

        Parameters:

           dev_clk:  the ref pll clk for rtl9010,if rtl9010 has osc ,this must be -1
```

## .axioenvs/application.modbus_tcp_slave/build/gcc-riscv32.release/gen/Kconfig/Kconfig.component.awb_common_driver.driver.rx8025sa
```kconfig
menuconfig DRV_RX8025SA
    bool "rx8025sa ['epson,rx8025sa']"
    select AW_SUBSYS_TIME
    default n
    help
        Example of adding device to board.dts:

        &i2c0{
            rx8025sa:rx8025sa@0x32{
                compatible = "epson,rx8025sa";
                status = "disabled";
                label = "rx8025sa";
                reg = <0x32>;
                int_a-pins = <&pin1 PIN_PZ08 (AW_PIN_CFG_GPIO_INPUT|AW_PIN_CFG_PULL_UP) 
                                             (AW_PIN_CFG_GPIO_INPUT|AW_PIN_CFG_PULL_UP) 
                                             (AW_PIN_CFG_GPIO_INPUT|AW_PIN_CFG_PULL_UP)>;
            };
        };
        

        And also, you can config pin in pins.dts as follow:
        

        &rx8025sa {
         int_a-pins = <&pin1 PIN_PE28 (IOC_PE28_FUNC_CTL_GPIO_E_28|AW_PIN_CFG_GPIO_INPUT|AW_PIN_CFG_PULL_UP)
                                      (IOC_PE28_FUNC_CTL_GPIO_E_28|AW_PIN_CFG_GPIO_INPUT|AW_PIN_CFG_PULL_UP)
                                      (IOC_PE28_FUNC_CTL_GPIO_E_28|AW_PIN_CFG_GPIO_INPUT|AW_PIN_CFG_PULL_UP)>;
        };
```

## .axioenvs/application.modbus_tcp_slave/build/gcc-riscv32.release/gen/Kconfig/Kconfig.component.awb_common_driver.driver.rx8025t
```kconfig
menuconfig DRV_RX8025T
    bool "rx8025t ['epson,rx8025t']"
    select AW_SUBSYS_TIME
    default n
    help
        Example of adding device to board.dts:

        &i2c0{
            rx8025t:rx8025t@0x32{
                compatible = "epson,rx8025t";
                status = "disabled";
                label = "rx8025t";
                reg = <0x32>;
                int-pins = <&pin1 PIN_PZ08 (AW_PIN_CFG_GPIO_INPUT|AW_PIN_CFG_PULL_UP) 
                                           (AW_PIN_CFG_GPIO_INPUT|AW_PIN_CFG_PULL_UP) 
                                           (AW_PIN_CFG_GPIO_INPUT|AW_PIN_CFG_PULL_UP)>;
            };
        };
        

        And also, you can config pin in pins.dts as follow:
        

        &rx8025t{
                int-pins = <&pin1 PIN_PZ08 (AW_PIN_CFG_GPIO_INPUT|AW_PIN_CFG_PULL_UP) 
                                           (AW_PIN_CFG_GPIO_INPUT|AW_PIN_CFG_PULL_UP) 
                                           (AW_PIN_CFG_GPIO_INPUT|AW_PIN_CFG_PULL_UP)>;
        };
```

## .axioenvs/application.modbus_tcp_slave/build/gcc-riscv32.release/gen/Kconfig/Kconfig.component.awb_common_driver.driver.sdio_mem_card
```kconfig
menuconfig DRV_SDIO_MEM_CARD
    bool "sdio_mem_card ['general,sdio_mem_card']"
    select AW_SUBSYS_DRIVER_SDIO
    select AW_SUBSYS_STORAGE_BLOCKDEV
    default n
    help
        Example of adding device to board.dts:

        &sdio1 {
            sdio_mem_card0@0{
                compatible = "general,sdio_mem_card";
                label = "sdcardA";
                reg = <0 4>;
                status = "disabled";
            };
        };
```

## .axioenvs/application.modbus_tcp_slave/build/gcc-riscv32.release/gen/Kconfig/Kconfig.component.awb_common_driver.driver.shtc1
```kconfig
menuconfig DRV_SHTC1
    bool "shtc1 ['SENSIRION,shtc1']"
    select AW_SUBSYS_DRIVER_SENSOR
    select AW_OS_ISR_DEFER
    default n
    help
        Example of adding device to board.dts:

        &i2c1{
            shtc1:shtc1@70 {
                compatible = "SENSIRION,shtc1";
                label = "SHTC1";
                status = "disabled";
                reg = <0x70>;
            };
        };
```
