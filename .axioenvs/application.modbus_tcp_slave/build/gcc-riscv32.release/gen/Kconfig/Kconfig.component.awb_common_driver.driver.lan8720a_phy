## .axioenvs/application.modbus_tcp_slave/build/gcc-riscv32.release/gen/Kconfig/Kconfig.component.awb_common_driver.driver.spi_flash
```kconfig
menuconfig DRV_SPI_FLASH
    bool "spi_flash ['spi,flash']"
    default n
    help
        Example of adding device to board.dts:

        &lpspi3 {
            spi_flash@0{
                compatible = "spi,flash";
                label = "spiflash";
                reg = <0>; /* cs index, chipselects from the spi host */
                status = "disabled";
            };
        };
```

## .axioenvs/application.modbus_tcp_slave/build/gcc-riscv32.release/gen/Kconfig/Kconfig.component.awb_common_driver.driver.spicard
```kconfig
menuconfig DRV_SPICARD
    bool "spicard ['general,spicard']"
    default n
    help
        Example of adding device to board.dts:

        &spi0 {
            spicard{
                compatible = "general,spicard";
                label = "spi_mem_card";
                status = "disabled";
                /* cs-pins must be configured */
                cs-pins = <&pin1 PIN_PZ02   (IOC_PZ02_FUNC_CTL_GPIO_Z_02|AW_PIN_CFG_GPIO_OUTPUT_HIGH)
                                            (IOC_PZ02_FUNC_CTL_GPIO_Z_02|AW_PIN_CFG_GPIO_OUTPUT_HIGH)
                                            (IOC_PZ02_FUNC_CTL_GPIO_Z_02|AW_PIN_CFG_GPIO_OUTPUT_HIGH)>;
                /* you can configure the int-pins when you device supports hot swap */
                int-pins = <&pin1 PIN_PZ11   (IOC_PZ11_FUNC_CTL_GPIO_Z_11|AW_PIN_CFG_GPIO_OUTPUT_HIGH)
                                             (IOC_PZ11_FUNC_CTL_GPIO_Z_11|AW_PIN_CFG_GPIO_OUTPUT_HIGH)
                                             (IOC_PZ11_FUNC_CTL_GPIO_Z_11|AW_PIN_CFG_GPIO_OUTPUT_HIGH)>;
            };
        };
```

## .axioenvs/application.modbus_tcp_slave/build/gcc-riscv32.release/gen/Kconfig/Kconfig.component.awb_common_driver.driver.yt8512h_phy
```kconfig
menuconfig DRV_YT8512H_PHY
    bool "yt8512h_phy ['motorcomm,yt8512h']"
    select AW_SUBSYS_SYSTEM_PM_PIN
    select AW_SUBSYS_DRIVER_PHY_POLL
    default n
    help
        Example of adding device to board.dts:

         &eth1 { 
            phy-handle = <&yt8512h_0>;
            yt8512h_0:yt8512h_phy@0x02{
                compatible = "motorcomm,yt8512h";
                status = "disabled";
                dev_clk = <HPM_CLK_ETH1>;
                label = "yt8512h_0";
                reg = <0x02>;
                rst-pins = <&pin1 PIN_PZ10   (IOC_PZ10_FUNC_CTL_GPIO_Z_10|AW_PIN_CFG_GPIO_OUTPUT_HIGH)
                                             (IOC_PZ10_FUNC_CTL_GPIO_Z_10|AW_PIN_CFG_GPIO_OUTPUT_HIGH)
                                             (IOC_PZ10_FUNC_CTL_GPIO_Z_10|AW_PIN_CFG_GPIO_OUTPUT_HIGH)>;
        };
        

        And also, you can config pin in pins.dts as follow:
        

        &yt8512h_0{  
            rst-pins = <&pin1 PIN_PZ10   (IOC_PZ10_FUNC_CTL_GPIO_Z_10|AW_PIN_CFG_GPIO_OUTPUT_HIGH)
                                         (IOC_PZ10_FUNC_CTL_GPIO_Z_10|AW_PIN_CFG_GPIO_OUTPUT_HIGH)
                                         (IOC_PZ10_FUNC_CTL_GPIO_Z_10|AW_PIN_CFG_GPIO_OUTPUT_HIGH)>;
        };

        Parameters:

           dev_clk:  the ref pll clk for yt8512h,if yt8512h has osc ,this must be -1
```

## .axioenvs/application.modbus_tcp_slave/build/gcc-riscv32.release/gen/Kconfig/Kconfig.component.awb_fs_devfs
```kconfig
menuconfig AWB_FS_DEVFS
    bool "AWorks Device filsystem"
    libsafe 
    select AW_IO_BASE
    default n
    help
        Version: 0.0.0

        
```

## .axioenvs/application.modbus_tcp_slave/build/gcc-riscv32.release/gen/Kconfig/Kconfig.component.awb_ftl
```kconfig
menuconfig AWB_FTL
    bool "AWorks Flash Translation Layers"
    libsafe 
    select AW_SUBSYS_STORAGE_BLOCKDEV
    select AW_OS_SYS_DEFER
    select AW_OS_DELAYED_WORK
    select AW_MEM_MANAGE_MEM_POOL
    select AW_MATH
    default n
    help
        Version: 0.0.0

        
if AWB_FTL

source "D:/aworks_lp_hpm6450_general_sdk-0.9.1/frameworks/64cf32e2-aworks_lp/components/kernel/awb_ftl/Kconfig.opts"

endif #AWB_FTL
```

## .axioenvs/application.modbus_tcp_slave/build/gcc-riscv32.release/gen/Kconfig/Kconfig.component.awb_inet_if
```kconfig
menuconfig AWB_INET_IF
    bool "AWorks implementation for network interface api like posix"
    libsafe 
    select AWB_INET_LWIP_TOP
    default n
    help
        Version: 0.0.0

        
```

## .axioenvs/application.modbus_tcp_slave/build/gcc-riscv32.release/gen/Kconfig/Kconfig.component.awb_inet_lwip_top
```kconfig
menuconfig AWB_INET_LWIP_TOP
    bool "AWorks common abstract for lwip"
    libsafe 
    select LWIP2_X_ADAPTER
    default n
    help
        Version: 0.0.0

        
if AWB_INET_LWIP_TOP

source "D:/aworks_lp_hpm6450_general_sdk-0.9.1/frameworks/64cf32e2-aworks_lp/net/awb_inet_lwip_top/Kconfig.opts"

endif #AWB_INET_LWIP_TOP
```

## .axioenvs/application.modbus_tcp_slave/build/gcc-riscv32.release/gen/Kconfig/Kconfig.component.awb_inet_netdb
```kconfig
menuconfig AWB_INET_NETDB
    bool "AWorks implementation for internet netdb"
    libsafe 
    select AW_COMMON_IOCTL_CODE
    select AW_CTYPE
    select AW_STDLIB
    select AWB_INET_LWIP_TOP
    default n
    help
        Version: 0.0.0

        
```

## .axioenvs/application.modbus_tcp_slave/build/gcc-riscv32.release/gen/Kconfig/Kconfig.component.awb_packet_socket
```kconfig
menuconfig AWB_PACKET_SOCKET
    bool "AWorks implementation for packet socket"
    libsafe 
    select AW_MEM_MANAGE_MEM_POOL
    select AW_COMMON_IOCTL_CODE
    select AW_CTYPE
    select AW_STDLIB
    select AW_SOCKET_IODEV
    default n
    help
        Version: 0.0.0

        
if AWB_PACKET_SOCKET

source "D:/aworks_lp_hpm6450_general_sdk-0.9.1/frameworks/64cf32e2-aworks_lp/net/awb_packet_socket/Kconfig.opts"

endif #AWB_PACKET_SOCKET
```

## .axioenvs/application.modbus_tcp_slave/build/gcc-riscv32.release/gen/Kconfig/Kconfig.component.awb_subsys_netif
```kconfig
menuconfig AWB_SUBSYS_NETIF
    bool "Subsys for network interface"
    libsafe 
    select AW_MEM_MANAGE_MEM_POOL
    select AW_COMMON_IOCTL_CODE
    select AWB_FS_DEVFS
    select AW_MEM_MANAGER_RINGBUFFER
    select AW_API_INET_HEADER
    default n
    help
        Version: 0.0.0

        
if AWB_SUBSYS_NETIF

source "D:/aworks_lp_hpm6450_general_sdk-0.9.1/frameworks/64cf32e2-aworks_lp/net/awb_subsys_netif/Kconfig.opts"

endif #AWB_SUBSYS_NETIF
```
