## .axioenvs/application.modbus_tcp_slave/build/gcc-riscv32.release/gen/Kconfig/Kconfig.component.aw_math
```kconfig
menuconfig AW_MATH
    bool "AWorks Math functions"
    libsafe 
    select AW_INTERFACE
    default n
    help
        Version: 0.0.0

        
if AW_MATH

source "D:/aworks_lp_hpm6450_general_sdk-0.9.1/frameworks/64cf32e2-aworks_lp/components/kernel_user_common/aw_math/Kconfig.opts"

endif #AW_MATH
```

## .axioenvs/application.modbus_tcp_slave/build/gcc-riscv32.release/gen/Kconfig/Kconfig.component.aw_mbedtls_adapter
```kconfig
menuconfig AW_MBEDTLS_ADAPTER
    bool "mbedtls adaptation layer of AWorks"
    libsafe 
    select AW_INTERFACE
    select AW_API_TIME
    select AW_OS_DELAYED_WORK
    select AWB_SUBSYS_NETIF
    select AW_COMMON_IOCTL_CODE
    select COMPILER_SUPPORT_POSIX_SOCKET
    select COMPILER_SUPPORT_POSIX_FILE
    select COMPILER_SUPPORT_LIBC_TIME
    select COMPILER_SUPPORT_STDIO
    default n
    help
        Version: 1.0.9-lp

        
if AW_MBEDTLS_ADAPTER

source "D:/aworks_lp_hpm6450_general_sdk-0.9.1/components/aw_mbedtls_adapter/Kconfig.opts"

endif #AW_MBEDTLS_ADAPTER
```

## .axioenvs/application.modbus_tcp_slave/build/gcc-riscv32.release/gen/Kconfig/Kconfig.component.aw_mem_manage_mem_pool
```kconfig
menuconfig AW_MEM_MANAGE_MEM_POOL
    bool "AWorks Pool Manager"
    libsafe 
    select AW_INTERFACE
    default n
    help
        Version: 0.0.0

        
```

## .axioenvs/application.modbus_tcp_slave/build/gcc-riscv32.release/gen/Kconfig/Kconfig.component.aw_mem_manager_ringbuffer
```kconfig
menuconfig AW_MEM_MANAGER_RINGBUFFER
    bool "AWorks Ringbuffer"
    libsafe 
    select AW_INTERFACE
    default n
    help
        Version: 0.0.0

        
```

## .axioenvs/application.modbus_tcp_slave/build/gcc-riscv32.release/gen/Kconfig/Kconfig.component.aw_modbus
```kconfig
menuconfig AW_MODBUS
    bool "Modbus"
    libsafe 
    default n
    help
        Version: 1.0.23

        
if AW_MODBUS


osource  "$(ax_imp_paths,modbus_adapter_interface,,False)"

endif #AW_MODBUS
```

## .axioenvs/application.modbus_tcp_slave/build/gcc-riscv32.release/gen/Kconfig/Kconfig.component.aw_notifier
```kconfig
menuconfig AW_NOTIFIER
    bool "AWorks Notifier"
    libsafe 
    select AW_INTERFACE
    default n
    help
        Version: 0.0.0

        
```

## .axioenvs/application.modbus_tcp_slave/build/gcc-riscv32.release/gen/Kconfig/Kconfig.component.aw_os_defer
```kconfig
menuconfig AW_OS_DEFER
    bool "AWorks defer base"
    libsafe 
    select AW_INTERFACE
    default n
    help
        Version: 0.0.0

        
```

## .axioenvs/application.modbus_tcp_slave/build/gcc-riscv32.release/gen/Kconfig/Kconfig.component.aw_pthread
```kconfig
menuconfig AW_PTHREAD
    bool "AWorks Pthread adpater"
    libsafe 
    select AW_INTERFACE
    select AW_ERR_TO_ERRNO
    select PTHREAD_LIKE_TLS_KEY_EN
    select AWORKS_BASE_PTHREAD_SUPPORT
    default n
    help
        Version: 0.0.0

        Detail:help

        AWorks posix pthread adapter.
if AW_PTHREAD

source "D:/aworks_lp_hpm6450_general_sdk-0.9.1/frameworks/64cf32e2-aworks_lp/posix/aw_pthread/Kconfig.opts"

endif #AW_PTHREAD
```

## .axioenvs/application.modbus_tcp_slave/build/gcc-riscv32.release/gen/Kconfig/Kconfig.component.aw_shell_playback
```kconfig
menuconfig AW_SHELL_PLAYBACK
    bool "AWorks Shell supports playback commands"
    libsafe 
    select AW_APP_SHELL
    select AW_STDIO
    select AW_DEV_API
    default n
    help
        Version: 0.0.0

        
```

## .axioenvs/application.modbus_tcp_slave/build/gcc-riscv32.release/gen/Kconfig/Kconfig.component.aw_stdio
```kconfig
menuconfig AW_STDIO
    bool "AWorks stdio functions"
    libsafe 
    select AW_INTERFACE
    default n
    help
        Version: 0.0.0

        
if AW_STDIO

source "D:/aworks_lp_hpm6450_general_sdk-0.9.1/frameworks/64cf32e2-aworks_lp/components/kernel_user_common/aw_stdio/Kconfig.opts"

endif #AW_STDIO
```

## .axioenvs/application.modbus_tcp_slave/build/gcc-riscv32.release/gen/Kconfig/Kconfig.component.aw_subsys_driver_cam
```kconfig
menuconfig AW_SUBSYS_DRIVER_CAM
    bool "Subsys for camera"
    libsafe 
    select AW_INTERFACE
    default n
    help
        Version: 0.0.0

        
if AW_SUBSYS_DRIVER_CAM

source "D:/aworks_lp_hpm6450_general_sdk-0.9.1/frameworks/64cf32e2-aworks_lp/subsys/aw_subsys_driver_cam/Kconfig.opts"

endif #AW_SUBSYS_DRIVER_CAM
```

## .axioenvs/application.modbus_tcp_slave/build/gcc-riscv32.release/gen/Kconfig/Kconfig.component.aw_subsys_driver_can
```kconfig
menuconfig AW_SUBSYS_DRIVER_CAN
    bool "Subsys for can device"
    libsafe 
    select AW_MEM_MANAGER_RINGBUFFER
    select AW_COMMON_IOCTL_CODE
    select AWB_FS_DEVFS
    default n
    help
        Version: 0.0.0

        
if AW_SUBSYS_DRIVER_CAN

source "D:/aworks_lp_hpm6450_general_sdk-0.9.1/frameworks/64cf32e2-aworks_lp/subsys/aw_subsys_driver_can/Kconfig.opts"

endif #AW_SUBSYS_DRIVER_CAN
```

## .axioenvs/application.modbus_tcp_slave/build/gcc-riscv32.release/gen/Kconfig/Kconfig.component.aw_subsys_driver_dac
```kconfig
menuconfig AW_SUBSYS_DRIVER_DAC
    bool "Subsys for dac device"
    libsafe 
    select AWBUS
    select AW_COMMON_IOCTL_CODE
    select AWB_FS_DEVFS
    default n
    help
        Version: 0.0.0

        
```

## .axioenvs/application.modbus_tcp_slave/build/gcc-riscv32.release/gen/Kconfig/Kconfig.component.aw_subsys_driver_dma
```kconfig
menuconfig AW_SUBSYS_DRIVER_DMA
    bool "Subsys for direct memory access(DMA)"
    libsafe 
    default n
    help
        Version: 0.0.0

        
```

## .axioenvs/application.modbus_tcp_slave/build/gcc-riscv32.release/gen/Kconfig/Kconfig.component.aw_subsys_driver_hwtimer_cap
```kconfig
menuconfig AW_SUBSYS_DRIVER_HWTIMER_CAP
    bool "Subsys for hwtimer capture"
    libsafe 
    select AW_COMMON_IOCTL_CODE
    select AWB_FS_DEVFS
    select AW_MEM_MANAGER_RINGBUFFER
    default n
    help
        Version: 0.0.0

        
```

## .axioenvs/application.modbus_tcp_slave/build/gcc-riscv32.release/gen/Kconfig/Kconfig.component.aw_subsys_driver_hwtimer_delay
```kconfig
menuconfig AW_SUBSYS_DRIVER_HWTIMER_DELAY
    bool "Subsys for delay timmer"
    libsafe 
    select AW_COMMON_IOCTL_CODE
    select AWB_FS_DEVFS
    default n
    help
        Version: 0.0.0

        
```

## .axioenvs/application.modbus_tcp_slave/build/gcc-riscv32.release/gen/Kconfig/Kconfig.component.aw_subsys_driver_hwtimer_period
```kconfig
menuconfig AW_SUBSYS_DRIVER_HWTIMER_PERIOD
    bool "Subsys for hwtimer period"
    libsafe 
    select AW_COMMON_IOCTL_CODE
    select AWB_FS_DEVFS
    default n
    help
        Version: 0.0.0

        
```

## .axioenvs/application.modbus_tcp_slave/build/gcc-riscv32.release/gen/Kconfig/Kconfig.component.aw_subsys_driver_i2c
```kconfig
menuconfig AW_SUBSYS_DRIVER_I2C
    bool "Subsys for i2c master device"
    libsafe 
    select AW_COMMON_IOCTL_CODE
    select AWB_FS_DEVFS
    select AWBUS
    default n
    help
        Version: 0.0.0

        
if AW_SUBSYS_DRIVER_I2C

source "D:/aworks_lp_hpm6450_general_sdk-0.9.1/frameworks/64cf32e2-aworks_lp/subsys/aw_subsys_driver_i2c/Kconfig.opts"

endif #AW_SUBSYS_DRIVER_I2C
```

## .axioenvs/application.modbus_tcp_slave/build/gcc-riscv32.release/gen/Kconfig/Kconfig.component.aw_subsys_driver_i2c_slave
```kconfig
menuconfig AW_SUBSYS_DRIVER_I2C_SLAVE
    bool "Subsys for i2c slave device"
    libsafe 
    select AW_COMMON_IOCTL_CODE
    select AWB_FS_DEVFS
    select AWBUS
    default n
    help
        Version: 0.0.0

        
if AW_SUBSYS_DRIVER_I2C_SLAVE

source "D:/aworks_lp_hpm6450_general_sdk-0.9.1/frameworks/64cf32e2-aworks_lp/subsys/aw_subsys_driver_i2c_slave/Kconfig.opts"

endif #AW_SUBSYS_DRIVER_I2C_SLAVE
```

## .axioenvs/application.modbus_tcp_slave/build/gcc-riscv32.release/gen/Kconfig/Kconfig.component.aw_subsys_driver_mtd
```kconfig
menuconfig AW_SUBSYS_DRIVER_MTD
    bool "Subsys for memory technology device(MTD)"
    libsafe 
    select AWB_FS_DEVFS
    select AW_SUBSYS_DRIVER_SPI
    select AW_COMMON_IOCTL_CODE
    select AW_MATH
    select AWBUS
    select AW_STDIO_PRINTF_TYPES_LONG_LONG_EN
    default n
    help
        Version: 0.0.0

        
if AW_SUBSYS_DRIVER_MTD

source "D:/aworks_lp_hpm6450_general_sdk-0.9.1/frameworks/64cf32e2-aworks_lp/subsys/aw_subsys_driver_mtd/Kconfig.opts"

endif #AW_SUBSYS_DRIVER_MTD
```

## .axioenvs/application.modbus_tcp_slave/build/gcc-riscv32.release/gen/Kconfig/Kconfig.component.aw_subsys_driver_sdio
```kconfig
menuconfig AW_SUBSYS_DRIVER_SDIO
    bool "Subsys for sdio host controler"
    libsafe 
    select AW_COMMON_IOCTL_CODE
    select AWB_FS_DEVFS
    select AW_STDIO
    select AW_SUBSYS_STORAGE_BLOCKDEV
    default n
    help
        Version: 0.0.0

        
```

## .axioenvs/application.modbus_tcp_slave/build/gcc-riscv32.release/gen/Kconfig/Kconfig.component.aw_subsys_driver_sensor
```kconfig
menuconfig AW_SUBSYS_DRIVER_SENSOR
    bool "Subsys for sensor"
    libsafe 
    select AW_COMMON_IOCTL_CODE
    select AWB_FS_DEVFS
    select AW_INTERFACE
    default n
    help
        Version: 0.0.0

        
```

## .axioenvs/application.modbus_tcp_slave/build/gcc-riscv32.release/gen/Kconfig/Kconfig.component.aw_subsys_pm_wakeup_timer
```kconfig
menuconfig AW_SUBSYS_PM_WAKEUP_TIMER
    bool "Subsys for wakeup timer"
    libsafe 
    select AW_INTERFACE
    default n
    help
        Version: 0.0.0

        
```

## .axioenvs/application.modbus_tcp_slave/build/gcc-riscv32.release/gen/Kconfig/Kconfig.component.aw_subsys_storage_blockdev
```kconfig
menuconfig AW_SUBSYS_STORAGE_BLOCKDEV
    bool "component aw_subsys_storage_blockdev"
    libsafe 
    select AWORKS_BASE
    select AW_COMMON_IOCTL_CODE
    select AWB_FS_DEVFS
    select AW_STDIO
    default n
    help
        Version: 0.0.0

        
```

## .axioenvs/application.modbus_tcp_slave/build/gcc-riscv32.release/gen/Kconfig/Kconfig.component.aw_subsys_system_sysdebug
```kconfig
menuconfig AW_SUBSYS_SYSTEM_SYSDEBUG
    bool "support for aw_kprintf"
    libsafe 
    select AW_STDIO
    default y
    help
        Version: 0.0.0

        Detail:AWorks enable aw_kprintf interface support.
if AW_SUBSYS_SYSTEM_SYSDEBUG

source "D:/aworks_lp_hpm6450_general_sdk-0.9.1/frameworks/64cf32e2-aworks_lp/subsys/aw_subsys_system_sysdebug/Kconfig.opts"

endif #AW_SUBSYS_SYSTEM_SYSDEBUG
```
