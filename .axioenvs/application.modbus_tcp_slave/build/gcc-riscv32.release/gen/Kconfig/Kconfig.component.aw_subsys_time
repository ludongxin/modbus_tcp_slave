## .axioenvs/application.modbus_tcp_slave/build/gcc-riscv32.release/gen/Kconfig/Kconfig.component.awb_common_driver.driver.general_zlg7291
```kconfig
menuconfig DRV_GENERAL_ZLG7291
    bool "general,zlg7291 ['zlg,zlg7291']"
    select AW_OS_DEFER
    select AW_OS_ISR_DEFER
    default n
    help
        Example of adding device to board.dts:

        &i2c0{
            zlg7291:zlg7291@0x30{
                compatible = "zlg,zlg7291";
                status = "zlg7291";
                label = "zlg7291";
                reg = <0x30>;
                int-pins = <&pin1 PIN_PE24 (AW_PIN_CFG_GPIO_INPUT|AW_PIN_CFG_PULL_UP|IOC_PE24_FUNC_CTL_GPIO_E_24)
                                           (AW_PIN_CFG_GPIO_INPUT|AW_PIN_CFG_PULL_UP|IOC_PE24_FUNC_CTL_GPIO_E_24)
                                           (AW_PIN_CFG_GPIO_INPUT|AW_PIN_CFG_PULL_UP|IOC_PE24_FUNC_CTL_GPIO_E_24)>;
                reset-pins = <&pin1 PIN_PF00 (AW_PIN_CFG_GPIO_OUTPUT_LOW|AW_PIN_CFG_PULL_UP| IOC_PF00_FUNC_CTL_GPIO_F_00)
                                             (AW_PIN_CFG_GPIO_OUTPUT_LOW|AW_PIN_CFG_PULL_UP| IOC_PF00_FUNC_CTL_GPIO_F_00)
                                             (AW_PIN_CFG_GPIO_OUTPUT_LOW|AW_PIN_CFG_PULL_UP| IOC_PF00_FUNC_CTL_GPIO_F_00)>;
            };
        };
        

        And also, you can config pin in pins.dts as follow:
        

        &zlg7291{
            int-pins = <&pin1 PIN_PE24 (AW_PIN_CFG_GPIO_INPUT|AW_PIN_CFG_PULL_UP|IOC_PE24_FUNC_CTL_GPIO_E_24)
                                       (AW_PIN_CFG_GPIO_INPUT|AW_PIN_CFG_PULL_UP|IOC_PE24_FUNC_CTL_GPIO_E_24)
                                       (AW_PIN_CFG_GPIO_INPUT|AW_PIN_CFG_PULL_UP|IOC_PE24_FUNC_CTL_GPIO_E_24)>;
            reset-pins = <&pin1 PIN_PF00 (AW_PIN_CFG_GPIO_OUTPUT_LOW|AW_PIN_CFG_PULL_UP| IOC_PF00_FUNC_CTL_GPIO_F_00)
                                         (AW_PIN_CFG_GPIO_OUTPUT_LOW|AW_PIN_CFG_PULL_UP| IOC_PF00_FUNC_CTL_GPIO_F_00)
                                         (AW_PIN_CFG_GPIO_OUTPUT_LOW|AW_PIN_CFG_PULL_UP| IOC_PF00_FUNC_CTL_GPIO_F_00)>;
        };
```

## .axioenvs/application.modbus_tcp_slave/build/gcc-riscv32.release/gen/Kconfig/Kconfig.component.awb_common_driver.driver.gpio_mdio
```kconfig
menuconfig DRV_GPIO_MDIO
    bool "gpio_mdio ['general,gpio_mdio']"
    select AW_SUBSYS_DRIVER_MII
    select AW_SUBSYS_SYSTEM_PM_PIN
    default n
    help
        Example of adding device to board.dts:

        Step 1 add the following fragment to "board.dts"
        / {
            gpio_mdio_0:gpio_mdio {
                compatible = "general,gpio_mdio";
                label = "gpio_mdio0";
                status = "disabled";
                #address-cells = <1>;
                #size-cells = <0>;
                yt8512h_0:yt8512h_phy@0x02{
                    compatible = "motorcomm,yt8512h";
                    status = "disabled";
                    dev_clk = <HPM_CLK_TOP_AHB0>;
                    label = "yt8512h_0";
                    reg = <0x02>;
                };
            };
        };
        

        Step 2 add the following fragment to "pins.dts"
        

        &gpio_mdio_0{
            mdc-pins  = <&pin1 PIN_PD11   (IOC_PD11_FUNC_CTL_GPIO_D_11  | AW_PIN_CFG_GPIO_OUTPUT_LOW  | AW_PIN_CFG_PULL_UP)
                                          (IOC_PD11_FUNC_CTL_GPIO_D_11  | AW_PIN_CFG_GPIO_OUTPUT_LOW  | AW_PIN_CFG_PULL_UP)
                                          (IOC_PD11_FUNC_CTL_GPIO_D_11  | AW_PIN_CFG_GPIO_OUTPUT_LOW  | AW_PIN_CFG_PULL_UP)>;
            mdio-pins  = <&pin1 PIN_PD14  (IOC_PD14_FUNC_CTL_GPIO_D_14  | AW_PIN_CFG_GPIO_OUTPUT_HIGH | AW_PIN_CFG_PULL_UP)
                                          (IOC_PD14_FUNC_CTL_GPIO_D_14  | AW_PIN_CFG_GPIO_OUTPUT_HIGH | AW_PIN_CFG_PULL_UP)
                                          (IOC_PD14_FUNC_CTL_GPIO_D_14  | AW_PIN_CFG_GPIO_OUTPUT_HIGH | AW_PIN_CFG_PULL_UP)>;
        };
```

## .axioenvs/application.modbus_tcp_slave/build/gcc-riscv32.release/gen/Kconfig/Kconfig.component.awb_common_driver.driver.gt911
```kconfig
menuconfig DRV_GT911
    bool "gt911 ['goodix,gt911']"
    select AW_SUBSYS_DRIVER_I2C
    select AW_SUBSYS_DRIVER_INPUT
    default n
    help
        Example of adding device to board.dts:

        &i2c1 {
            gt911:gt911@5d{
                compatible = "goodix,gt911";
                label = "gt911";
                reg = <0x5d>;
                status = "disabled";
                cfg_group        = [         
                32 20 03 e0 01 05 3D 00 02 08
                28 08 5A 46 03 05 00 00 00 00
                00 00 04 04 04 04 03 88 29 0A
                4B 4D 0C 08 00 00 00 21 02 1D
                00 01 00 00 00 00 00 00 00 00
                00 46 64 94 D5 02 07 00 00 04
                83 48 00 77 4D 00 6D 53 00 64
                59 00 5A 60 00 5A 00 00 00 00
                00 00 00 00 00 00 00 00 00 00
                00 00 00 00 00 00 00 00 00 00
                00 00 00 00 00 00 00 00 00 00
                00 00 02 04 06 08 0A 0C 0E 10
                12 14 FF FF FF FF 00 00 00 00
                00 00 00 00 00 00 00 00 00 00
                00 00 00 02 04 06 08 0F 10 12
                16 18 1C 1D 1E 1F 20 21 22 FF
                FF FF FF FF FF FF FF FF 00 00
                00 00 00 00 00 00 00 00 00 00
                00 00 00 00 ba 01];
                /* rst-pins is optional */
                rst-pins = <&pin1 GPIO1_31 GPIO1_31_GPIO
                                           GPIO1_31_GPIO
                                           GPIO1_31_GPIO>;
                int-pins = <&pin1 GPIO1_30 GPIO1_30_GPIO
                                           GPIO1_30_GPIO
                                           GPIO1_30_GPIO>;
            };
        };
        

        The cfg_group needs to be provided by the touch screen manufacturer
        

        And also, you can config pin in pins.dts as follow:
        

        &gt911 {  
                /* rst-pins is optional */
                rst-pins = <&pin1 GPIO1_31 GPIO1_31_GPIO
                                           GPIO1_31_GPIO
                                           GPIO1_31_GPIO>;
                int-pins = <&pin1 GPIO1_30 GPIO1_31_GPIO
                                           GPIO1_31_GPIO
                                           GPIO1_31_GPIO>;
        };

        Parameters:

           cfg_group:  gt911 config group


if DRV_GT911

source "D:/aworks_lp_hpm6450_general_sdk-0.9.1/frameworks/64cf32e2-aworks_lp/subsys/awb_common_driver/dts/bindings/touchscreen/gt911/goodix,gt911_ts.Kconfig.opts"

endif #DRV_GT911
```

## .axioenvs/application.modbus_tcp_slave/build/gcc-riscv32.release/gen/Kconfig/Kconfig.component.awb_common_driver.driver.is37sml01g1
```kconfig
menuconfig DRV_IS37SML01G1
    bool "is37sml01g1 ['issi,is37sml01g1']"
    select AW_SUBSYS_DRIVER_MTD
    select AW_MATH
    default n
    help
        Example of adding device to board.dts:

        &spi0 {
            is37sml01g1:is37sml01g1@0{
                compatible = "issi,is37sml01g1";
                label = "is37sml01g1";
                reg = <0>; /* cs index, chipselects from the spi host */
                status = "disabled";
         
                partition_0 {
                label        = "is37sml01g1_partition_0";
                block_start  = <0>;
                block_number = <512>;
                };
                partition_1 {
                label        = "is37sml01g1_partition_1";
                block_start  = <512>;
                block_number = <500>;
                };
                partition_2 {
                label        = "is37sml01g1_partition_2";
                block_start  = <1012>;
                block_number = <12>;
                };
            };
        };

        Subnode parameters:

           block_start:  The block number at the beginning of a partition

           block_number:  Number of blocks occupied by a partition
```

## .axioenvs/application.modbus_tcp_slave/build/gcc-riscv32.release/gen/Kconfig/Kconfig.component.awb_common_driver.driver.jedec_jesd216_nor_flash_spiex
```kconfig
menuconfig DRV_JEDEC_JESD216_NOR_FLASH_SPIEX
    bool "jedec_jesd216_nor_flash_spiex ['jedec,jesd216_nor_flash_spiex']"
    select AW_SUBSYS_DRIVER_MTD
    select AW_SFDP
    default n
    help
        Example of adding device to board.dts:

        / {
           &spiex { 
             w25q64fw:w25q64fw@0 { 
             compatible = "jedec,jesd216_nor_flash_spi"; 
             label = "w25q64fw"; 
             reg = <0>; /* cs index, chipselects from the spi host */
             status = "disabled"; 
             partition_0 { 
                 label   = "w25_nor0"; 
                 address = <0 (4*1024*1024)>; 
             };
             partition_1 { 
                 label   = "w25_nor1"; 
                 address = <(4*1024*1024) (2*1024*1024)>; 
             }; 
             partition_2 { 
                 label   = "w25_nor2"; 
                 address = <(6*1024*1024) (2*1024*1024)>; 
             }; 
           }; 
         }; 

        Subnode parameters:

           address:  The offset in the flash device Memory size
```
