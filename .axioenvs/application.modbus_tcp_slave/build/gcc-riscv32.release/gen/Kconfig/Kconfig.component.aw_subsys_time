## .axioenvs/application.modbus_tcp_slave/build/gcc-riscv32.release/gen/Kconfig/Kconfig.component.awb_common_driver.driver.cyw43362_spi
```kconfig
menuconfig DRV_CYW43362_SPI
    bool "cyw43362_spi ['cypress,cyw43362_spi']"
    select AWB_SUBSYS_NETIF
    select AW_SUBSYS_DRIVER_WIFI
    select AW_SUBSYS_DRIVER_SPI
    select WICED
    default n
    help
        Example of adding device to board.dts:

        &lpspi3 {
            cyw43362:cyw43362_spi@0{
                compatible = "cypress,cyw43362_spi";
                label = "cyw43362";
                reg = <0>; /* cs index, chipselects from the spi host */
                status = "disabled";
                wake-pins = <&pin1 GPIO3_5  (AW_PIN_CFG_GPIO_OUTPUT_LOW|AW_PIN_CFG_PULL_DOWN|GPIO3_5_GPIO)
                                            (AW_PIN_CFG_GPIO_OUTPUT_LOW|AW_PIN_CFG_PULL_DOWN|GPIO3_5_GPIO)
                                            (AW_PIN_CFG_GPIO_OUTPUT_LOW|AW_PIN_CFG_PULL_DOWN|GPIO3_5_GPIO)>;
                reset-pins= <&pin1 GPIO3_4  (AW_PIN_CFG_GPIO_OUTPUT_LOW|AW_PIN_CFG_PULL_DOWN|GPIO3_4_GPIO)
                                            (AW_PIN_CFG_GPIO_OUTPUT_LOW|AW_PIN_CFG_PULL_DOWN|GPIO3_4_GPIO)
                                            (AW_PIN_CFG_GPIO_OUTPUT_LOW|AW_PIN_CFG_PULL_DOWN|GPIO3_4_GPIO)>;
                int-pins= <&pin1 GPIO3_4    (AW_PIN_CFG_GPIO_INPUT|AW_PIN_CFG_PULL_DOWN|GPIO3_3_GPIO)
                                            (AW_PIN_CFG_GPIO_INPUT|AW_PIN_CFG_PULL_DOWN|GPIO3_3_GPIO)
                                            (AW_PIN_CFG_GPIO_INPUT|AW_PIN_CFG_PULL_DOWN|GPIO3_3_GPIO)>;
            };
        };
        

        And also, you can config pin in pins.dts as follow:
        

        &cyw43362{
                wake-pins = <&pin1 GPIO3_5  (AW_PIN_CFG_GPIO_OUTPUT_LOW|AW_PIN_CFG_PULL_DOWN|GPIO3_5_GPIO)
                                            (AW_PIN_CFG_GPIO_OUTPUT_LOW|AW_PIN_CFG_PULL_DOWN|GPIO3_5_GPIO)
                                            (AW_PIN_CFG_GPIO_OUTPUT_LOW|AW_PIN_CFG_PULL_DOWN|GPIO3_5_GPIO)>;
                reset-pins= <&pin1 GPIO3_4  (AW_PIN_CFG_GPIO_OUTPUT_LOW|AW_PIN_CFG_PULL_DOWN|GPIO3_4_GPIO)
                                            (AW_PIN_CFG_GPIO_OUTPUT_LOW|AW_PIN_CFG_PULL_DOWN|GPIO3_4_GPIO)
                                            (AW_PIN_CFG_GPIO_OUTPUT_LOW|AW_PIN_CFG_PULL_DOWN|GPIO3_4_GPIO)>;
                int-pins= <&pin1 GPIO3_4    (AW_PIN_CFG_GPIO_INPUT|AW_PIN_CFG_PULL_DOWN|GPIO3_3_GPIO)
                                            (AW_PIN_CFG_GPIO_INPUT|AW_PIN_CFG_PULL_DOWN|GPIO3_3_GPIO)
                                            (AW_PIN_CFG_GPIO_INPUT|AW_PIN_CFG_PULL_DOWN|GPIO3_3_GPIO)>;
        };

if DRV_CYW43362_SPI

source "D:/aworks_lp_hpm6450_general_sdk-0.9.1/frameworks/64cf32e2-aworks_lp/subsys/awb_common_driver/dts/bindings/cyw43xxx/cypress,cyw43362_spi.Kconfig.opts"

endif #DRV_CYW43362_SPI
```

## .axioenvs/application.modbus_tcp_slave/build/gcc-riscv32.release/gen/Kconfig/Kconfig.component.awb_common_driver.driver.cyw43455_sdio
```kconfig
menuconfig DRV_CYW43455_SDIO
    bool "cyw43455_sdio ['cypress,cyw43455_sdio']"
    select AW_SUBSYS_DRIVER_SDIO
    select AWB_SUBSYS_NETIF
    select AW_SUBSYS_DRIVER_WIFI
    select WICED
    default n
    help
        Example of adding device to board.dts:

        &sdio2 {
            cyw43455:cyw43455_sdio{
                compatible = "cypress,cyw43455_sdio";
                label = "cyw43455";
                status = "disabled";
                wake-pins = <&pin1 PIN_PD25 (AW_PIN_CFG_GPIO_INPUT|AW_PIN_CFG_PULL_DOWN|IOC_PD25_FUNC_CTL_GPIO_D_25)
                                            (AW_PIN_CFG_GPIO_INPUT|AW_PIN_CFG_PULL_DOWN|IOC_PD25_FUNC_CTL_GPIO_D_25)
                                            (AW_PIN_CFG_GPIO_INPUT|AW_PIN_CFG_PULL_DOWN|IOC_PD25_FUNC_CTL_GPIO_D_25)>;
                reset-pins= <&pin1 PIN_PD15 (AW_PIN_CFG_GPIO_OUTPUT_LOW|AW_PIN_CFG_PULL_DOWN|IOC_PD15_FUNC_CTL_GPIO_D_15)
                                            (AW_PIN_CFG_GPIO_OUTPUT_LOW|AW_PIN_CFG_PULL_DOWN|IOC_PD15_FUNC_CTL_GPIO_D_15)
                                            (AW_PIN_CFG_GPIO_OUTPUT_LOW|AW_PIN_CFG_PULL_DOWN|IOC_PD15_FUNC_CTL_GPIO_D_15)>;
            };
        };
        

        And also, you can config pin in pins.dts as follow:
        

        &cyw43455{
            wake-pins = <&pin1 PIN_PD25 (AW_PIN_CFG_GPIO_INPUT|AW_PIN_CFG_PULL_DOWN|IOC_PD25_FUNC_CTL_GPIO_D_25)
                                        (AW_PIN_CFG_GPIO_INPUT|AW_PIN_CFG_PULL_DOWN|IOC_PD25_FUNC_CTL_GPIO_D_25)
                                        (AW_PIN_CFG_GPIO_INPUT|AW_PIN_CFG_PULL_DOWN|IOC_PD25_FUNC_CTL_GPIO_D_25)>;
            reset-pins= <&pin1 PIN_PD15 (AW_PIN_CFG_GPIO_OUTPUT_LOW|AW_PIN_CFG_PULL_DOWN|IOC_PD15_FUNC_CTL_GPIO_D_15)
                                        (AW_PIN_CFG_GPIO_OUTPUT_LOW|AW_PIN_CFG_PULL_DOWN|IOC_PD15_FUNC_CTL_GPIO_D_15)
                                        (AW_PIN_CFG_GPIO_OUTPUT_LOW|AW_PIN_CFG_PULL_DOWN|IOC_PD15_FUNC_CTL_GPIO_D_15)>;
        };

if DRV_CYW43455_SDIO

source "D:/aworks_lp_hpm6450_general_sdk-0.9.1/frameworks/64cf32e2-aworks_lp/subsys/awb_common_driver/dts/bindings/cyw43xxx/cypress,cyw43455_sdio.Kconfig.opts"

endif #DRV_CYW43455_SDIO
```

## .axioenvs/application.modbus_tcp_slave/build/gcc-riscv32.release/gen/Kconfig/Kconfig.component.awb_common_driver.driver.dp83848_phy
```kconfig
menuconfig DRV_DP83848_PHY
    bool "dp83848_phy ['ti,dp83848']"
    select AW_SUBSYS_SYSTEM_PM_PIN
    select AW_SUBSYS_DRIVER_PHY_POLL
    default n
    help
        Example of adding device to board.dts:

        &enet {
            phy-handle = <&dp83848>;
            dp83848:dp83848_phy@1{
                compatible = "ti,dp83848";
                status = "disabled";
                label = "dp83848";
                dev_clk = <IMX1050_CLK_ENET1_TX_REF>;
                reg = <0x01>;
                rst-pins = <&pin1 PIN_PE26    (IOC_PE26_FUNC_CTL_GPIO_E_26|AW_PIN_CFG_GPIO_OUTPUT_HIGH)
                                              (IOC_PE26_FUNC_CTL_GPIO_E_26|AW_PIN_CFG_GPIO_OUTPUT_HIGH)
                                              (IOC_PE26_FUNC_CTL_GPIO_E_26|AW_PIN_CFG_GPIO_OUTPUT_HIGH)>;
            };
        };
        And also, you can config pin in pins.dts as follow:
        

        &dp83848{
                rst-pins = <&pin1 PIN_PE26    (IOC_PE26_FUNC_CTL_GPIO_E_26|AW_PIN_CFG_GPIO_OUTPUT_HIGH)
                                              (IOC_PE26_FUNC_CTL_GPIO_E_26|AW_PIN_CFG_GPIO_OUTPUT_HIGH)
                                              (IOC_PE26_FUNC_CTL_GPIO_E_26|AW_PIN_CFG_GPIO_OUTPUT_HIGH)>;
        };

        Parameters:

           dev_clk:  if use MCU internal clk output for PHY work, must set it correct; otherwise, this item can be omitted.
```

## .axioenvs/application.modbus_tcp_slave/build/gcc-riscv32.release/gen/Kconfig/Kconfig.component.awb_common_driver.driver.fixed_phy
```kconfig
menuconfig DRV_FIXED_PHY
    bool "fixed_phy ['none,fixed_phy']"
    select AW_SUBSYS_SYSTEM_PM_PIN
    select AW_SUBSYS_DRIVER_PHY_POLL
    default n
    help
        Example of adding device to board.dts:

        &enet {
            phy-handle = <&fixed_phy_0>;
        
            fixed_phy_0:fixed_phy_0{
                compatible = "none,fixed_phy";
                status = "disabled";
                label = "fixed_phy_0";
        };
```

## .axioenvs/application.modbus_tcp_slave/build/gcc-riscv32.release/gen/Kconfig/Kconfig.component.awb_common_driver.driver.ft5x06
```kconfig
menuconfig DRV_FT5X06
    bool "ft5x06 ['focaltech,ft5x06']"
    select AW_SUBSYS_DRIVER_I2C
    select AW_SUBSYS_DRIVER_INPUT
    default n
    help
        Example of adding device to board.dts:

        &i2c1 {
            ft5x06:ft5x06@38{
                compatible = "focaltech,ft5x06";
                label = "ft5x06";
                status = "disabled";
                reg = <0x38>;
                int-pins = <&pin1 PIN_PE02  (AW_PIN_CFG_GPIO_INPUT|AW_PIN_CFG_PULL_UP|IOC_PE02_FUNC_CTL_GPIO_E_02)
                                            (AW_PIN_CFG_GPIO_INPUT|AW_PIN_CFG_PULL_UP|IOC_PE02_FUNC_CTL_GPIO_E_02)
                                            (AW_PIN_CFG_GPIO_INPUT|AW_PIN_CFG_PULL_UP|IOC_PE02_FUNC_CTL_GPIO_E_02)>;
                /* rst-pins is optional */
                rst-pins = <&pin1 PIN_PE01  (AW_PIN_CFG_GPIO_OUTPUT|AW_PIN_CFG_PULL_UP|IOC_PE01_FUNC_CTL_GPIO_E_01)
                                            (AW_PIN_CFG_GPIO_OUTPUT|AW_PIN_CFG_PULL_UP|IOC_PE01_FUNC_CTL_GPIO_E_01)
                                            (AW_PIN_CFG_GPIO_OUTPUT|AW_PIN_CFG_PULL_UP|IOC_PE01_FUNC_CTL_GPIO_E_01)>;
            };
        };
        

        And also, you can config pin in pins.dts as follow:
        

        &ft5x06 {  
                int-pins = <&pin1 PIN_PE02  (AW_PIN_CFG_GPIO_INPUT|AW_PIN_CFG_PULL_UP|IOC_PE02_FUNC_CTL_GPIO_E_02)
                                            (AW_PIN_CFG_GPIO_INPUT|AW_PIN_CFG_PULL_UP|IOC_PE02_FUNC_CTL_GPIO_E_02)
                                            (AW_PIN_CFG_GPIO_INPUT|AW_PIN_CFG_PULL_UP|IOC_PE02_FUNC_CTL_GPIO_E_02)>;
                /* rst-pins is optional */
                rst-pins = <&pin1 PIN_PE01  (AW_PIN_CFG_GPIO_OUTPUT|AW_PIN_CFG_PULL_UP|IOC_PE01_FUNC_CTL_GPIO_E_01)
                                            (AW_PIN_CFG_GPIO_OUTPUT|AW_PIN_CFG_PULL_UP|IOC_PE01_FUNC_CTL_GPIO_E_01)
                                            (AW_PIN_CFG_GPIO_OUTPUT|AW_PIN_CFG_PULL_UP|IOC_PE01_FUNC_CTL_GPIO_E_01)>;
        };

if DRV_FT5X06

source "D:/aworks_lp_hpm6450_general_sdk-0.9.1/frameworks/64cf32e2-aworks_lp/subsys/awb_common_driver/dts/bindings/touchscreen/ft5x06/focaltech,ft5x06.Kconfig.opts"

endif #DRV_FT5X06
```

## .axioenvs/application.modbus_tcp_slave/build/gcc-riscv32.release/gen/Kconfig/Kconfig.component.awb_common_driver.driver.general_zlg72128_i2c
```kconfig
menuconfig DRV_GENERAL_ZLG72128_I2C
    bool "general,zlg72128_i2c ['zlg,zlg72128_i2c']"
    select AW_OS_DEFER
    select AW_OS_ISR_DEFER
    select AW_SUBSYS_DRIVER_SPI
    default n
    help
        Example of adding device to board.dts:

        &i2c0{
            zlg72128:zlg72128@0x30{
                compatible = "zlg,zlg72128_i2c";
                status = "zlg72128";
                label = "zlg72128";
                is_int;
                reg = <0x30>;
                int-pins = <&pin1 PIN_PE24 (AW_PIN_CFG_GPIO_INPUT|AW_PIN_CFG_PULL_UP|IOC_PE24_FUNC_CTL_GPIO_E_24)
                                           (AW_PIN_CFG_GPIO_INPUT|AW_PIN_CFG_PULL_UP|IOC_PE24_FUNC_CTL_GPIO_E_24)
                                           (AW_PIN_CFG_GPIO_INPUT|AW_PIN_CFG_PULL_UP|IOC_PE24_FUNC_CTL_GPIO_E_24)>;
                reset-pins = <&pin1 PIN_PF00 (AW_PIN_CFG_GPIO_OUTPUT_LOW|AW_PIN_CFG_PULL_UP| IOC_PF00_FUNC_CTL_GPIO_F_00)
                                             (AW_PIN_CFG_GPIO_OUTPUT_LOW|AW_PIN_CFG_PULL_UP| IOC_PF00_FUNC_CTL_GPIO_F_00)
                                             (AW_PIN_CFG_GPIO_OUTPUT_LOW|AW_PIN_CFG_PULL_UP| IOC_PF00_FUNC_CTL_GPIO_F_00)>;
            };
        };
        

        And also, you can config pin in pins.dts as follow:
        

        &zlg72128{
            int-pins = <&pin1 PIN_PE24 (AW_PIN_CFG_GPIO_INPUT|AW_PIN_CFG_PULL_UP|IOC_PE24_FUNC_CTL_GPIO_E_24)
                                       (AW_PIN_CFG_GPIO_INPUT|AW_PIN_CFG_PULL_UP|IOC_PE24_FUNC_CTL_GPIO_E_24)
                                       (AW_PIN_CFG_GPIO_INPUT|AW_PIN_CFG_PULL_UP|IOC_PE24_FUNC_CTL_GPIO_E_24)>;
            reset-pins = <&pin1 PIN_PF00 (AW_PIN_CFG_GPIO_OUTPUT_LOW|AW_PIN_CFG_PULL_UP| IOC_PF00_FUNC_CTL_GPIO_F_00)
                                         (AW_PIN_CFG_GPIO_OUTPUT_LOW|AW_PIN_CFG_PULL_UP| IOC_PF00_FUNC_CTL_GPIO_F_00)
                                         (AW_PIN_CFG_GPIO_OUTPUT_LOW|AW_PIN_CFG_PULL_UP| IOC_PF00_FUNC_CTL_GPIO_F_00)>;
        };
```

## .axioenvs/application.modbus_tcp_slave/build/gcc-riscv32.release/gen/Kconfig/Kconfig.component.awb_common_driver.driver.general_zlg72128_spi
```kconfig
menuconfig DRV_GENERAL_ZLG72128_SPI
    bool "general,zlg72128_spi ['zlg,zlg72128_spi']"
    select AW_OS_DEFER
    select AW_OS_ISR_DEFER
    select AW_SUBSYS_DRIVER_I2C
    default n
    help
        Example of adding device to board.dts:

        &spi0{
            zlg72128:zlg72128@0{
                compatible = "zlg,zlg72128_spi";
                status = "zlg72128";
                label = "zlg72128";
                is_int;
                reg = <0>;
                int-pins = <&pin1 PIN_PE24 (AW_PIN_CFG_GPIO_INPUT|AW_PIN_CFG_PULL_UP|IOC_PE24_FUNC_CTL_GPIO_E_24)
                                           (AW_PIN_CFG_GPIO_INPUT|AW_PIN_CFG_PULL_UP|IOC_PE24_FUNC_CTL_GPIO_E_24)
                                           (AW_PIN_CFG_GPIO_INPUT|AW_PIN_CFG_PULL_UP|IOC_PE24_FUNC_CTL_GPIO_E_24)>;
                reset-pins = <&pin1 PIN_PF00 (AW_PIN_CFG_GPIO_OUTPUT_LOW|AW_PIN_CFG_PULL_UP| IOC_PF00_FUNC_CTL_GPIO_F_00)
                                             (AW_PIN_CFG_GPIO_OUTPUT_LOW|AW_PIN_CFG_PULL_UP| IOC_PF00_FUNC_CTL_GPIO_F_00)
                                             (AW_PIN_CFG_GPIO_OUTPUT_LOW|AW_PIN_CFG_PULL_UP| IOC_PF00_FUNC_CTL_GPIO_F_00)>;
            };
        };
        

        And also, you can config pin in pins.dts as follow:
        

        &zlg72128{
            int-pins = <&pin1 PIN_PE24 (AW_PIN_CFG_GPIO_INPUT|AW_PIN_CFG_PULL_UP|IOC_PE24_FUNC_CTL_GPIO_E_24)
                                       (AW_PIN_CFG_GPIO_INPUT|AW_PIN_CFG_PULL_UP|IOC_PE24_FUNC_CTL_GPIO_E_24)
                                       (AW_PIN_CFG_GPIO_INPUT|AW_PIN_CFG_PULL_UP|IOC_PE24_FUNC_CTL_GPIO_E_24)>;
            reset-pins = <&pin1 PIN_PF00 (AW_PIN_CFG_GPIO_OUTPUT_LOW|AW_PIN_CFG_PULL_UP| IOC_PF00_FUNC_CTL_GPIO_F_00)
                                         (AW_PIN_CFG_GPIO_OUTPUT_LOW|AW_PIN_CFG_PULL_UP| IOC_PF00_FUNC_CTL_GPIO_F_00)
                                         (AW_PIN_CFG_GPIO_OUTPUT_LOW|AW_PIN_CFG_PULL_UP| IOC_PF00_FUNC_CTL_GPIO_F_00)>;
        };
```
