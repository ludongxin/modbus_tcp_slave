## .axioenvs/application.modbus_tcp_slave/build/gcc-riscv32.release/gen/Kconfig/Kconfig.component.aw_subsys_time
```kconfig
menuconfig AW_SUBSYS_TIME
    bool "Subsys for time and RTC device"
    libsafe 
    select AW_INTERFACE
    select AW_API_TIMETRANS
    select AW_COMMON_IOCTL_CODE
    select AWB_FS_DEVFS
    select AW_API_TIMETRANS_LOCAL
    default n
    help
        Version: 0.0.0

        
if AW_SUBSYS_TIME

source "D:/aworks_lp_hpm6450_general_sdk-0.9.1/frameworks/64cf32e2-aworks_lp/subsys/aw_subsys_time/Kconfig.opts"

endif #AW_SUBSYS_TIME
```

## .axioenvs/application.modbus_tcp_slave/build/gcc-riscv32.release/gen/Kconfig/Kconfig.component.aw_wifi_utils
```kconfig
menuconfig AW_WIFI_UTILS
    bool "AWorks WiFi Utils"
    libsafe 
    select AW_INTERFACE
    select AW_DEV_API
    select AW_STDIO
    default n
    help
        Version: 0.0.0

        Detail:This component provide base api(such as country convert,MAC convert,etc..) for WiFi operation. it always be enabled by other components.
```

## .axioenvs/application.modbus_tcp_slave/build/gcc-riscv32.release/gen/Kconfig/Kconfig.component.aw_zws_adapter
```kconfig
menuconfig AW_ZWS_ADAPTER
    bool "ZWS adaptation layer of AWorks"
    libsafe 
    select AW_INTERFACE
    select AW_STDIO
    select AW_IOT_COMMON
    default n
    help
        Version: 0.3.0

        Detail:help

        Please refer to the demo in demos/application/app_cloud_demos/app_zws_ota_demo/ for quick use of ZWS in AWorks.

if AW_ZWS_ADAPTER

source "D:/aworks_lp_hpm6450_general_sdk-0.9.1/components/aw_zws_adapter/Kconfig.opts"

endif #AW_ZWS_ADAPTER
```

## .axioenvs/application.modbus_tcp_slave/build/gcc-riscv32.release/gen/Kconfig/Kconfig.component.awb_common_driver
```kconfig
menuconfig AWB_COMMON_DRIVER
    bool "AWorks Common Drivers"
    libsafe 
    default n
    help
        Version: 0.0.0

        
```

## .axioenvs/application.modbus_tcp_slave/build/gcc-riscv32.release/gen/Kconfig/Kconfig.component.awb_common_driver.driver.arm_gtimer_systimer
```kconfig
menuconfig DRV_ARM_GTIMER_SYSTIMER
    bool "arm_gtimer_systimer ['arm,arm-gtimer-systimer']"
    default n

if DRV_ARM_GTIMER_SYSTIMER

source "D:/aworks_lp_hpm6450_general_sdk-0.9.1/frameworks/64cf32e2-aworks_lp/subsys/awb_common_driver/dts/bindings/arm_gtimer/arm,arm-gtimer-systmr.Kconfig.opts"

endif #DRV_ARM_GTIMER_SYSTIMER
```

## .axioenvs/application.modbus_tcp_slave/build/gcc-riscv32.release/gen/Kconfig/Kconfig.component.awb_common_driver.driver.armv7a_pme_timestamp
```kconfig
menuconfig DRV_ARMV7A_PME_TIMESTAMP
    bool "armv7a_pme_timestamp ['armv7a,pme_timestamp']"
    select AWBUS
    default n

if DRV_ARMV7A_PME_TIMESTAMP

source "D:/aworks_lp_hpm6450_general_sdk-0.9.1/frameworks/64cf32e2-aworks_lp/subsys/awb_common_driver/dts/bindings/armv7a_pme/armv7a,pme_timestamp.Kconfig.opts"

endif #DRV_ARMV7A_PME_TIMESTAMP
```

## .axioenvs/application.modbus_tcp_slave/build/gcc-riscv32.release/gen/Kconfig/Kconfig.component.awb_common_driver.driver.armv7m_systick_systimer
```kconfig
menuconfig DRV_ARMV7M_SYSTICK_SYSTIMER
    bool "armv7m_systick_systimer ['arm,armv7m-systick-systimer']"
    select AWBUS
    default n
```

## .axioenvs/application.modbus_tcp_slave/build/gcc-riscv32.release/gen/Kconfig/Kconfig.component.awb_common_driver.driver.bh1730fvc
```kconfig
menuconfig DRV_BH1730FVC
    bool "bh1730fvc ['ROHM,bh1730fvc']"
    select AW_SUBSYS_DRIVER_SENSOR
    default n
    help
        Example of adding device to board.dts:

        &i2c1{
            bh1730fvc:bh1730fvc@29 {
                compatible = "ROHM,bh1730fvc";
                label = "BH1730FVC";
                status = "disabled";
                reg = <0x29>;
            };
        };

        Parameters:

           integration_time_denominator:  integration time denominator
```

## .axioenvs/application.modbus_tcp_slave/build/gcc-riscv32.release/gen/Kconfig/Kconfig.component.awb_common_driver.driver.bmg160
```kconfig
menuconfig DRV_BMG160
    bool "bmg160 ['BST,bmg160']"
    select AW_SUBSYS_DRIVER_SENSOR
    select AW_OS_ISR_DEFER
    default n
    help
        Example of adding device to board.dts:

        &i2c1{
            bmg160:bmg160@68 {
                compatible = "BST,bmg160";
                label = "BMG160";
                status = "disabled";
                reg = <0x68>;
                event-pins = <&pin1 GPIO1_25 GPIO1_25_GPIO (GPIO1_25_GPIO|AW_PIN_CFG_GPIO_INPUT) GPIO1_25_GPIO>;
                data-pins  = <&pin1 GPIO1_26 GPIO1_26_GPIO (GPIO1_26_GPIO|AW_PIN_CFG_GPIO_INPUT) GPIO1_26_GPIO>;
            };
        };
        

        And also, you can config pin in pins.dts as follow:
        

        &bmg160{
            event-pins = <&pin1 GPIO1_25 GPIO1_25_GPIO (GPIO1_25_GPIO|AW_PIN_CFG_GPIO_INPUT) GPIO1_25_GPIO>;
            data-pins  = <&pin1 GPIO1_26 GPIO1_26_GPIO (GPIO1_26_GPIO|AW_PIN_CFG_GPIO_INPUT) GPIO1_26_GPIO>;
        };
```

## .axioenvs/application.modbus_tcp_slave/build/gcc-riscv32.release/gen/Kconfig/Kconfig.component.awb_common_driver.driver.bmp280
```kconfig
menuconfig DRV_BMP280
    bool "bmp280 ['BOSCH,bmp280']"
    select AW_SUBSYS_DRIVER_SENSOR
    select AW_OS_ISR_DEFER
    default n
    help
        Example of adding device to board.dts:

        &i2c1{
            bmp280:bmp280@77 {
                compatible = "BOSCH,bmp280";
                label = "BMP280";
                status = "disabled";
                reg = <0x77>;
            };
        };
```

## .axioenvs/application.modbus_tcp_slave/build/gcc-riscv32.release/gen/Kconfig/Kconfig.component.awb_common_driver.driver.canfdsm_uart_can
```kconfig
menuconfig DRV_CANFDSM_UART_CAN
    bool "canfdsm_uart_can ['zlg,canfdsm-uart-can']"
    select AWBUS
    select AW_SUBSYS_DRIVER_CAN
    select AW_SUBSYS_SYSTEM_PM_PIN
    default n
    help
        zlg,canfdsm-uart-can" is used to realize UART to CAN.

        Example of adding device to board.dts:

        / {
            canfdsm_uart_can:canfdsm_uart_can{
                compatible = "zlg,canfdsm-uart-can";
                label = "canfdsm_uart_can";
                uart_id = <&uart2>;
                status = "disabled";
                /**
                  * cfg pin
                  * If the CFG pin is controlled by hardware,you can omit this pin configuration.
                  */
                cfg-pins  = <&pin1 GPIO1_8   (GPIO1_8_GPIO | AW_PIN_CFG_GPIO_OUTPUT_LOW  | AW_PIN_CFG_PULL_UP)
                                             (GPIO1_8_GPIO | AW_PIN_CFG_GPIO_OUTPUT_LOW  | AW_PIN_CFG_PULL_UP)
                                             (GPIO1_8_GPIO | AW_PIN_CFG_GPIO_OUTPUT_LOW  | AW_PIN_CFG_PULL_UP)>;
            };
        };
        

        And also, you can config pin in pins.dts as follow:
        

        &canfdsm_uart_can{  
                cfg-pins  = <&pin1 GPIO1_8   (GPIO1_8_GPIO | AW_PIN_CFG_GPIO_OUTPUT_LOW  | AW_PIN_CFG_PULL_UP)
                                             (GPIO1_8_GPIO | AW_PIN_CFG_GPIO_OUTPUT_LOW  | AW_PIN_CFG_PULL_UP)
                                             (GPIO1_8_GPIO | AW_PIN_CFG_GPIO_OUTPUT_LOW  | AW_PIN_CFG_PULL_UP)>;
        };

        Parameters:

           uart_id:  Must be bound to the uart port, otherwise, device operate will fail.
```

## .axioenvs/application.modbus_tcp_slave/build/gcc-riscv32.release/gen/Kconfig/Kconfig.component.awb_common_driver.driver.csm300x_spi_can
```kconfig
menuconfig DRV_CSM300X_SPI_CAN
    bool "csm300x_spi_can ['zlg,csm300x-spi-can']"
    select AW_SUBSYS_DRIVER_SPI
    select AW_SUBSYS_DRIVER_CAN
    select AW_SUBSYS_SYSTEM_PM_PIN
    select AW_OS_ISR_DEFER
    default n
    help
        "zlg,csm300x-spi-can" is used to realize SPI to CAN.

        Example of adding device to board.dts:

        &spi1 {
            csm300x_spi_can:csm300x_spi_can@0{
                compatible = "zlg,csm300x-spi-can";
                label = "csm300x_spi_can";
                reg = <0>; /* cs index, chipselects from the spi host */
                status = "disabled";
                cfg-pins  = <&pin1 GPIO1_8   (GPIO1_8_GPIO  | AW_PIN_CFG_GPIO_OUTPUT_LOW  | AW_PIN_CFG_PULL_UP)
                                             (GPIO1_8_GPIO  | AW_PIN_CFG_GPIO_OUTPUT_LOW  | AW_PIN_CFG_PULL_UP)
                                             (GPIO1_8_GPIO  | AW_PIN_CFG_GPIO_OUTPUT_LOW  | AW_PIN_CFG_PULL_UP)>;
                /* if exist mode pin to control cam300x */
                mode-pins = <&pin1 GPIO1_9   (GPIO1_9_GPIO  | AW_PIN_CFG_GPIO_OUTPUT_LOW  | AW_PIN_CFG_PULL_UP)
                                             (GPIO1_9_GPIO  | AW_PIN_CFG_GPIO_OUTPUT_LOW  | AW_PIN_CFG_PULL_UP)
                                             (GPIO1_9_GPIO  | AW_PIN_CFG_GPIO_OUTPUT_LOW  | AW_PIN_CFG_PULL_UP)>;
                rst-pins  = <&pin1 GPIO3_4   (GPIO3_4_GPIO  | AW_PIN_CFG_GPIO_OUTPUT_HIGH | AW_PIN_CFG_PULL_UP)
                                             (GPIO3_4_GPIO  | AW_PIN_CFG_GPIO_OUTPUT_HIGH | AW_PIN_CFG_PULL_UP)
                                             (GPIO3_4_GPIO  | AW_PIN_CFG_GPIO_OUTPUT_HIGH | AW_PIN_CFG_PULL_UP)>;
                int-pins  = <&pin1 GPIO1_20  (GPIO1_20_GPIO | AW_PIN_CFG_GPIO_INPUT       | AW_PIN_CFG_PULL_UP)
                                             (GPIO1_20_GPIO | AW_PIN_CFG_GPIO_INPUT       | AW_PIN_CFG_PULL_UP)
                                             (GPIO1_20_GPIO | AW_PIN_CFG_GPIO_INPUT       | AW_PIN_CFG_PULL_UP)>;
                ctl0-pins = <&pin1 GPIO1_26  (GPIO1_26_GPIO | AW_PIN_CFG_GPIO_OUTPUT_LOW  | AW_PIN_CFG_PULL_UP)
                                             (GPIO1_26_GPIO | AW_PIN_CFG_GPIO_OUTPUT_LOW  | AW_PIN_CFG_PULL_UP)
                                             (GPIO1_26_GPIO | AW_PIN_CFG_GPIO_OUTPUT_LOW  | AW_PIN_CFG_PULL_UP)>;
                ctl1-pins = <&pin1 GPIO1_27  (GPIO1_27_GPIO | AW_PIN_CFG_GPIO_OUTPUT_LOW  | AW_PIN_CFG_PULL_UP)
                                             (GPIO1_27_GPIO | AW_PIN_CFG_GPIO_OUTPUT_LOW  | AW_PIN_CFG_PULL_UP)
                                             (GPIO1_27_GPIO | AW_PIN_CFG_GPIO_OUTPUT_LOW  | AW_PIN_CFG_PULL_UP)>;
            };
        };
        

        And also, you can config pin in pins.dts as follow:
        

        &csm300x_spi_can{  
                cfg-pins  = <&pin1 GPIO1_8   (GPIO1_8_GPIO  | AW_PIN_CFG_GPIO_OUTPUT_LOW  | AW_PIN_CFG_PULL_UP)
                                             (GPIO1_8_GPIO  | AW_PIN_CFG_GPIO_OUTPUT_LOW  | AW_PIN_CFG_PULL_UP)
                                             (GPIO1_8_GPIO  | AW_PIN_CFG_GPIO_OUTPUT_LOW  | AW_PIN_CFG_PULL_UP)>;
                /* if exist mode pin to control cam300x */
                mode-pins = <&pin1 GPIO1_9   (GPIO1_9_GPIO  | AW_PIN_CFG_GPIO_OUTPUT_LOW  | AW_PIN_CFG_PULL_UP)
                                             (GPIO1_9_GPIO  | AW_PIN_CFG_GPIO_OUTPUT_LOW  | AW_PIN_CFG_PULL_UP)
                                             (GPIO1_9_GPIO  | AW_PIN_CFG_GPIO_OUTPUT_LOW  | AW_PIN_CFG_PULL_UP)>;
                rst-pins  = <&pin1 GPIO3_4   (GPIO3_4_GPIO  | AW_PIN_CFG_GPIO_OUTPUT_HIGH | AW_PIN_CFG_PULL_UP)
                                             (GPIO3_4_GPIO  | AW_PIN_CFG_GPIO_OUTPUT_HIGH | AW_PIN_CFG_PULL_UP)
                                             (GPIO3_4_GPIO  | AW_PIN_CFG_GPIO_OUTPUT_HIGH | AW_PIN_CFG_PULL_UP)>;
                int-pins  = <&pin1 GPIO1_20  (GPIO1_20_GPIO | AW_PIN_CFG_GPIO_INPUT       | AW_PIN_CFG_PULL_UP)
                                             (GPIO1_20_GPIO | AW_PIN_CFG_GPIO_INPUT       | AW_PIN_CFG_PULL_UP)
                                             (GPIO1_20_GPIO | AW_PIN_CFG_GPIO_INPUT       | AW_PIN_CFG_PULL_UP)>;
                ctl0-pins = <&pin1 GPIO1_26  (GPIO1_26_GPIO | AW_PIN_CFG_GPIO_OUTPUT_LOW  | AW_PIN_CFG_PULL_UP)
                                             (GPIO1_26_GPIO | AW_PIN_CFG_GPIO_OUTPUT_LOW  | AW_PIN_CFG_PULL_UP)
                                             (GPIO1_26_GPIO | AW_PIN_CFG_GPIO_OUTPUT_LOW  | AW_PIN_CFG_PULL_UP)>;
                ctl1-pins = <&pin1 GPIO1_27  (GPIO1_27_GPIO | AW_PIN_CFG_GPIO_OUTPUT_LOW  | AW_PIN_CFG_PULL_UP)
                                             (GPIO1_27_GPIO | AW_PIN_CFG_GPIO_OUTPUT_LOW  | AW_PIN_CFG_PULL_UP)
                                             (GPIO1_27_GPIO | AW_PIN_CFG_GPIO_OUTPUT_LOW  | AW_PIN_CFG_PULL_UP)>;
        };
```

## .axioenvs/application.modbus_tcp_slave/build/gcc-riscv32.release/gen/Kconfig/Kconfig.component.awb_common_driver.driver.csm300x_uart_can
```kconfig
menuconfig DRV_CSM300X_UART_CAN
    bool "csm300x_uart_can ['zlg,csm300x-uart-can']"
    select AWBUS
    select AW_SUBSYS_DRIVER_CAN
    select AW_SUBSYS_SYSTEM_PM_PIN
    default n
    help
        "zlg,csm300x-uart-can" is used to realize UART to CAN.

        Example of adding device to board.dts:

        / {
            csm300x_uart_can:csm300x_uart_can{
                compatible = "zlg,csm300x-uart-can";
                label = "csm300x_uart_can";
                uart_id = <&uart2>;
                status = "disabled";
                cfg-pins  = <&pin1 GPIO1_8   (GPIO1_8_GPIO | AW_PIN_CFG_GPIO_OUTPUT_LOW  | AW_PIN_CFG_PULL_UP)
                                             (GPIO1_8_GPIO | AW_PIN_CFG_GPIO_OUTPUT_LOW  | AW_PIN_CFG_PULL_UP)
                                             (GPIO1_8_GPIO | AW_PIN_CFG_GPIO_OUTPUT_LOW  | AW_PIN_CFG_PULL_UP)>;
                /* if exist mode pin to control cam300x */
                mode-pins = <&pin1 GPIO1_9   (GPIO1_9_GPIO | AW_PIN_CFG_GPIO_OUTPUT_LOW  | AW_PIN_CFG_PULL_UP)
                                             (GPIO1_9_GPIO | AW_PIN_CFG_GPIO_OUTPUT_LOW  | AW_PIN_CFG_PULL_UP)
                                             (GPIO1_9_GPIO | AW_PIN_CFG_GPIO_OUTPUT_LOW  | AW_PIN_CFG_PULL_UP)>;
                rst-pins  = <&pin1 GPIO3_4   (GPIO3_4_GPIO | AW_PIN_CFG_GPIO_OUTPUT_HIGH | AW_PIN_CFG_PULL_UP)
                                             (GPIO3_4_GPIO | AW_PIN_CFG_GPIO_OUTPUT_HIGH | AW_PIN_CFG_PULL_UP)
                                             (GPIO3_4_GPIO | AW_PIN_CFG_GPIO_OUTPUT_HIGH | AW_PIN_CFG_PULL_UP)>;
            };
        };
        

        And also, you can config pin in pins.dts as follow:
        

        &csm300x_uart_can{  
                cfg-pins  = <&pin1 GPIO1_8   (GPIO1_8_GPIO | AW_PIN_CFG_GPIO_OUTPUT_LOW  | AW_PIN_CFG_PULL_UP)
                                             (GPIO1_8_GPIO | AW_PIN_CFG_GPIO_OUTPUT_LOW  | AW_PIN_CFG_PULL_UP)
                                             (GPIO1_8_GPIO | AW_PIN_CFG_GPIO_OUTPUT_LOW  | AW_PIN_CFG_PULL_UP)>;
                /* if exist mode pin to control cam300x */
                mode-pins = <&pin1 GPIO1_9   (GPIO1_9_GPIO | AW_PIN_CFG_GPIO_OUTPUT_LOW  | AW_PIN_CFG_PULL_UP)
                                             (GPIO1_9_GPIO | AW_PIN_CFG_GPIO_OUTPUT_LOW  | AW_PIN_CFG_PULL_UP)
                                             (GPIO1_9_GPIO | AW_PIN_CFG_GPIO_OUTPUT_LOW  | AW_PIN_CFG_PULL_UP)>;
                rst-pins  = <&pin1 GPIO3_4   (GPIO3_4_GPIO | AW_PIN_CFG_GPIO_OUTPUT_HIGH | AW_PIN_CFG_PULL_UP)
                                             (GPIO3_4_GPIO | AW_PIN_CFG_GPIO_OUTPUT_HIGH | AW_PIN_CFG_PULL_UP)
                                             (GPIO3_4_GPIO | AW_PIN_CFG_GPIO_OUTPUT_HIGH | AW_PIN_CFG_PULL_UP)>;
        };

        Parameters:

           uart_id:  Must be bound to the uart port, otherwise, device operate will fail.
```
