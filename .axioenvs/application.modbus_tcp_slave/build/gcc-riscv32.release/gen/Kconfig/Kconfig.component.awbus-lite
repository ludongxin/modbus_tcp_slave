## .axioenvs/application.modbus_tcp_slave/build/gcc-riscv32.release/gen/Kconfig/Kconfig.component.awbus-lite
```kconfig
menuconfig AWBUS_LITE
    bool "AWbus-Lite"
    libsafe 
    default n
    help
        Version: 1.0.0

        
```

## .axioenvs/application.modbus_tcp_slave/build/gcc-riscv32.release/gen/Kconfig/Kconfig.component.aworks_base
```kconfig
menuconfig AWORKS_BASE
    bool "AWorks base"
    libsafe 
    default n
    help
        Version: 0.0.0

        Detail:This component provide base defines and base-interface in AWorks.
if AWORKS_BASE

source "D:/aworks_lp_hpm6450_general_sdk-0.9.1/frameworks/64cf32e2-aworks_lp/components/kernel_user_common/aworks_base/Kconfig.opts"

endif #AWORKS_BASE
```

## .axioenvs/application.modbus_tcp_slave/build/gcc-riscv32.release/gen/Kconfig/Kconfig.component.canopen
```kconfig
menuconfig CANOPEN
    bool "AWorks CANopen Protocol Stack"
    libsafe 
    select AW_DEV_API
    select COMPILER_SUPPORT_STDIO
    select RTK_OBJECT_CREATE_EN
    default n
    help
        Version: 0.2.2

        
if CANOPEN

source "D:/aworks_lp_hpm6450_general_sdk-0.9.1/components/04a64c39-canopen/Kconfig.opts"

endif #CANOPEN
```

## .axioenvs/application.modbus_tcp_slave/build/gcc-riscv32.release/gen/Kconfig/Kconfig.component.compiler_arm_none_eabi_gcc
```kconfig
menuconfig COMPILER_ARM_NONE_EABI_GCC
    bool "Compiler arm-none-eabi-gcc support(libc and posix)"
    libsafe 
    select AW_ERR_TO_ERRNO
    select AW_COMPILER_POSIX_COMMON_BASE
    select AW_SYS_DEFINE_SOCKET
    default n
    help
        Version: 0.0.0

        
if COMPILER_ARM_NONE_EABI_GCC

source "D:/aworks_lp_hpm6450_general_sdk-0.9.1/frameworks/64cf32e2-aworks_lp/app/applications/compiler_arm-none-eabi-gcc/Kconfig.opts"

endif #COMPILER_ARM_NONE_EABI_GCC
```

## .axioenvs/application.modbus_tcp_slave/build/gcc-riscv32.release/gen/Kconfig/Kconfig.component.dhcp_server
```kconfig
menuconfig DHCP_SERVER
    bool "DHCP Server"
    libsafe 
    select AW_COMPILER_COMMON_POSIX_SOCKET
    select AW_API_INET_LOCAL
    select AW_API_TIME
    select AW_DEV_API
    select AW_IO_DIR
    select COMPILER_IMPLEMENT_POSIX_API_CLOSE
    select COMPILER_IMPLEMENT_POSIX_API_FCNTL
    select COMPILER_IMPLEMENT_POSIX_API_WRITE
    select COMPILER_IMPLEMENT_POSIX_API_OPEN
    select COMPILER_SUPPORT_POSIX_SOCKET
    select AWB_SUBSYS_NETIF
    select AWB_NETIF_USER_INTERFACE
    select LWIP_DHCP
    default n
    help
        Version: 0.0.0

        Detail:DHCP Server only support IPV4
if DHCP_SERVER

source "D:/aworks_lp_hpm6450_general_sdk-0.9.1/frameworks/64cf32e2-aworks_lp/app/applications/dhcp_server/Kconfig.opts"

endif #DHCP_SERVER
```

## .axioenvs/application.modbus_tcp_slave/build/gcc-riscv32.release/gen/Kconfig/Kconfig.component.libcurl
```kconfig
menuconfig LIBCURL
    bool "libcurl"
    libsafe 
    select MBEDTLS
    default n
    help
        Version: 7.86.1

        Detail:help

        libcurl is a free client-side URL transfer library,it supports about 26

        protocols. In AWorks,we only open a part of it for use.
if LIBCURL


osource  "$(ax_imp_paths,libcurl_adapter_interface,,False)"

endif #LIBCURL
```

## .axioenvs/application.modbus_tcp_slave/build/gcc-riscv32.release/gen/Kconfig/Kconfig.component.lwip2_1_x
```kconfig
menuconfig LWIP2_1_X
    bool "lwip TCP/IP protocol suite"
    libsafe 
    select AW_INTERFACE
    default n
    help
        Version: 0.0.0

        
```

## .axioenvs/application.modbus_tcp_slave/build/gcc-riscv32.release/gen/Kconfig/Kconfig.component.mbedtls
```kconfig
menuconfig MBEDTLS
    bool "MbedTLS"
    libsafe 
    default n
    help
        Version: 3.0.3

        Detail:help

        Mbed TLS is a C library that implements cryptographic primitives,

        X.509 certificate manipulation and the SSL/TLS and DTLS protocols.

        Its small code footprint makes it suitable for embedded systems.

        

        Source Code Version: MbedTLS 3.0.0
if MBEDTLS


osource  "$(ax_imp_paths,mbedtls_adapter_interface,,False)"

endif #MBEDTLS
```

## .axioenvs/application.modbus_tcp_slave/build/gcc-riscv32.release/gen/Kconfig/Kconfig.component.mtb_shared
```kconfig
menuconfig MTB_SHARED
    bool "mtb_shared for hpm6450"
    libsafe 
    select COMPILER_SUPPORT_LIBC_MALLOC_FREE
    select COMPILER_SUPPORT_LIBC_TIME
    select RTK_OBJECT_CREATE_EN
    default n
    help
        Version: 0.1.0

        
```

## .axioenvs/application.modbus_tcp_slave/build/gcc-riscv32.release/gen/Kconfig/Kconfig.component.ncnn
```kconfig
menuconfig NCNN
    bool "ncnn"
    libsafe 
    default n
    help
        Version: 0.1.0

        
```
