## .axioenvs/application.modbus_tcp_slave/build/gcc-riscv32.release/gen/Kconfig/Kconfig.component.protobufc
```kconfig
menuconfig PROTOBUFC
    bool "a C implementation of the Google Protocol Buffers"
    libsafe 
    default n
    help
        Version: 0.1.0

        
```

## .axioenvs/application.modbus_tcp_slave/build/gcc-riscv32.release/gen/Kconfig/Kconfig.component.rpc_protobufc_adapter
```kconfig
menuconfig RPC_PROTOBUFC_ADAPTER
    bool "AWorks RPC-PROTOBUFC adapter"
    libsafe 
    select RPC_PROTOBUFC
    select OPENAMP
    default n
    help
        Version: 0.0.0

        
if RPC_PROTOBUFC_ADAPTER

source "D:/aworks_lp_hpm6450_general_sdk-0.9.1/frameworks/64cf32e2-aworks_lp/components/kernel_user_common/rpc_protobufc_adapter/Kconfig.opts"

endif #RPC_PROTOBUFC_ADAPTER
```

## .axioenvs/application.modbus_tcp_slave/build/gcc-riscv32.release/gen/Kconfig/Kconfig.component.telnet
```kconfig
menuconfig TELNET
    bool "AWorks Telnet Shell Terminals"
    libsafe 
    select AW_API_SOCKET
    select AWB_INET_SOCKET
    select AW_APP_SHELL
    default n
    help
        Version: 1.0.5-lp

        
if TELNET

source "D:/aworks_lp_hpm6450_general_sdk-0.9.1/components/telnet/Kconfig.opts"

endif #TELNET
```

## .axioenvs/application.modbus_tcp_slave/build/gcc-riscv32.release/gen/Kconfig/Kconfig.component.wiced
```kconfig
menuconfig WICED
    bool "WICED"
    libsafe 
    select AWB_SUBSYS_NETIF
    select COMPILER_SUPPORT_LIBC_MALLOC_FREE
    default n
    help
        Version: 1.0.19

        
```

## .axioenvs/application.modbus_tcp_slave/build/gcc-riscv32.release/gen/Kconfig/Kconfig.component.zlib
```kconfig
menuconfig ZLIB
    bool "Zlib"
    libsafe 
    default n
    help
        Version: 1.2.18

        
if ZLIB


osource  "$(ax_imp_paths,zlib_adapter_interface,,False)"

endif #ZLIB
```

## Kconfig.opts
```kconfig
config DEMO_MODEBUS_TCP_SLAVE
    bool "choose demo modbus tcp slave"
    select AW_MB_TCP_ENABLE
    libsafe
    default y

config NETWORK_DEVICE
    string  "The device name of enet in this test" 
    default "$(user_dev_name,enet,0)"
    libsafe
    enum
        $(user_dev_name,enet)
        $(user_dev_name,wifi)
    help
        Select the network card device to be used for testing.

config TCP_PORT
    int "the default TCP port"
    default 502
    libsafe
    help
        Port for modbus TCP connections.
        
```
