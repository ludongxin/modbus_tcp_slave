## .axioenvs/application.modbus_tcp_slave/build/gcc-riscv32.release/gen/Kconfig/Kconfig.component.aw_aworks_syscalls
```kconfig
menuconfig AW_AWORKS_SYSCALLS
    bool "AWorks syscalls for user mode"
    libsafe 
    default n
    help
        Version: 0.0.0

        
if AW_AWORKS_SYSCALLS

source "D:/aworks_lp_hpm6450_general_sdk-0.9.1/frameworks/64cf32e2-aworks_lp/components/kernel/aw_aworks_syscalls/Kconfig.opts"

endif #AW_AWORKS_SYSCALLS
```

## .axioenvs/application.modbus_tcp_slave/build/gcc-riscv32.release/gen/Kconfig/Kconfig.component.aw_bitmap_allocator
```kconfig
menuconfig AW_BITMAP_ALLOCATOR
    bool "Memory allocator using bitmap"
    libsafe 
    select AW_INTERFACE
    default n
    help
        Version: 0.0.0

        
```

## .axioenvs/application.modbus_tcp_slave/build/gcc-riscv32.release/gen/Kconfig/Kconfig.component.aw_clk_framework
```kconfig
menuconfig AW_CLK_FRAMEWORK
    bool "AWorks Clock Framework"
    libsafe 
    select AW_MATH
    select AW_DEFS_CLK
    default n
    help
        Version: 0.0.0

        
if AW_CLK_FRAMEWORK

source "D:/aworks_lp_hpm6450_general_sdk-0.9.1/frameworks/64cf32e2-aworks_lp/components/kernel/clock/Kconfig.opts"

endif #AW_CLK_FRAMEWORK
```

## .axioenvs/application.modbus_tcp_slave/build/gcc-riscv32.release/gen/Kconfig/Kconfig.component.aw_compiler_common_posix_socket
```kconfig
menuconfig AW_COMPILER_COMMON_POSIX_SOCKET
    bool "AWorks Common Socket"
    libsafe 
    select AW_API_SOCKET
    select AW_API_INET_HEADER
    default n
    help
        Version: 0.0.0

        Detail:This component provide common socket APIs for compilers such as arm-non-eabi-gcc and armcc.
if AW_COMPILER_COMMON_POSIX_SOCKET

source "D:/aworks_lp_hpm6450_general_sdk-0.9.1/frameworks/64cf32e2-aworks_lp/components/kernel_user_common/aw_compiler_common_posix_socket/Kconfig.opts"

endif #AW_COMPILER_COMMON_POSIX_SOCKET
```

## .axioenvs/application.modbus_tcp_slave/build/gcc-riscv32.release/gen/Kconfig/Kconfig.component.aw_compiler_posix_common_base
```kconfig
menuconfig AW_COMPILER_POSIX_COMMON_BASE
    bool "AWorks Posix Base"
    libsafe 
    select AW_INTERFACE
    default n
    help
        Version: 0.0.0

        Detail:Common posix base implement for all compilers.
```

## .axioenvs/application.modbus_tcp_slave/build/gcc-riscv32.release/gen/Kconfig/Kconfig.component.aw_cpu_driver_hpm.driver.hpm_adc12
```kconfig
menuconfig DRV_HPM_ADC12
    bool "hpm_adc12 ['riscv,hpm-adc12']"
    select AWB_ADC_SERVICE
    select AW_SUBSYS_DRIVER_ADC
    select AW_SUBSYS_SYSTEM_PM_PIN
    default n
```

## .axioenvs/application.modbus_tcp_slave/build/gcc-riscv32.release/gen/Kconfig/Kconfig.component.aw_cpu_driver_hpm.driver.hpm_cam
```kconfig
menuconfig DRV_HPM_CAM
    bool "hpm_cam ['riscv,hpm-cam']"
    select AW_SUBSYS_DRIVER_DISPLAY
    select AW_SUBSYS_SYSTEM_PM_PIN
    select AW_SUBSYS_DRIVER_CAM
    default n
```

## .axioenvs/application.modbus_tcp_slave/build/gcc-riscv32.release/gen/Kconfig/Kconfig.component.aw_cpu_driver_hpm.driver.hpm_can
```kconfig
menuconfig DRV_HPM_CAN
    bool "hpm_can ['riscv,hpm_can']"
    select AW_SUBSYS_DRIVER_CAN
    select AW_SUBSYS_SYSTEM_PM_PIN
    default n
```

## .axioenvs/application.modbus_tcp_slave/build/gcc-riscv32.release/gen/Kconfig/Kconfig.component.aw_cpu_driver_hpm.driver.hpm_dac
```kconfig
menuconfig DRV_HPM_DAC
    bool "hpm_dac ['riscv,hpm_dac']"
    select AW_SUBSYS_DRIVER_DAC
    select AW_SUBSYS_SYSTEM_PM_PIN
    default n
```

## .axioenvs/application.modbus_tcp_slave/build/gcc-riscv32.release/gen/Kconfig/Kconfig.component.aw_cpu_driver_hpm.driver.hpm_dao
```kconfig
menuconfig DRV_HPM_DAO
    bool "hpm_dao ['riscv,hpm-dao']"
    select AW_SUBSYS_SYSTEM_PM_PIN
    select AWSA_FRAMEWORK
    select DEV_I2S1
    select DEV_HDMA
    default n
```

## .axioenvs/application.modbus_tcp_slave/build/gcc-riscv32.release/gen/Kconfig/Kconfig.component.aw_cpu_driver_hpm.driver.hpm_enet_raw
```kconfig
menuconfig DRV_HPM_ENET_RAW
    bool "hpm_enet_raw ['riscv,hpm_ethernet_raw']"
    select AW_SUBSYS_SYSTEM_PM_PIN
    select AW_SUBSYS_DRIVER_MII
    select AWB_SUBSYS_NETIF
    default n

if DRV_HPM_ENET_RAW

source "D:/aworks_lp_hpm6450_general_sdk-0.9.1/platforms/platform-hpm-aworks-lp/components/aw_cpu_driver_hpm/dts/bindings/enet/riscv,hpm_ethernet_raw.Kconfig.opts"

endif #DRV_HPM_ENET_RAW
```

## .axioenvs/application.modbus_tcp_slave/build/gcc-riscv32.release/gen/Kconfig/Kconfig.component.aw_cpu_driver_hpm.driver.hpm_enet_virtual
```kconfig
menuconfig DRV_HPM_ENET_VIRTUAL
    bool "hpm_enet_virtual ['riscv,hpm_virtual_ethernet']"
    select AW_SUBSYS_SYSTEM_PM_PIN
    select AW_SUBSYS_DRIVER_MII
    select AWB_SUBSYS_NETIF
    default n
```

## .axioenvs/application.modbus_tcp_slave/build/gcc-riscv32.release/gen/Kconfig/Kconfig.component.aw_cpu_driver_hpm.driver.hpm_gtmr_systmr
```kconfig
menuconfig DRV_HPM_GTMR_SYSTMR
    bool "hpm_gtmr_systmr ['riscv,hpm_gtmr_systmr']"
    select AWBUS
    default n
```

## .axioenvs/application.modbus_tcp_slave/build/gcc-riscv32.release/gen/Kconfig/Kconfig.component.aw_cpu_driver_hpm.driver.hpm_gtmr_timestamp
```kconfig
menuconfig DRV_HPM_GTMR_TIMESTAMP
    bool "hpm_gtmr_timestamp ['riscv,hpm_gtmr_timestamp']"
    select AWBUS
    default n
```

## .axioenvs/application.modbus_tcp_slave/build/gcc-riscv32.release/gen/Kconfig/Kconfig.component.aw_cpu_driver_hpm.driver.hpm_i2c
```kconfig
menuconfig DRV_HPM_I2C
    bool "hpm_i2c ['riscv,hpm_i2c']"
    select AW_SUBSYS_DRIVER_I2C
    select AW_SUBSYS_SYSTEM_PM_PIN
    select AW_DEV_API
    default n
```

## .axioenvs/application.modbus_tcp_slave/build/gcc-riscv32.release/gen/Kconfig/Kconfig.component.aw_cpu_driver_hpm.driver.hpm_i2c_slave
```kconfig
menuconfig DRV_HPM_I2C_SLAVE
    bool "hpm_i2c_slave ['riscv,hpm_i2c_slave']"
    select AW_SUBSYS_DRIVER_I2C_SLAVE
    select AW_SUBSYS_SYSTEM_PM_PIN
    default n
```

## .axioenvs/application.modbus_tcp_slave/build/gcc-riscv32.release/gen/Kconfig/Kconfig.component.aw_cpu_driver_hpm.driver.hpm_i2s
```kconfig
menuconfig DRV_HPM_I2S
    bool "hpm_i2s ['riscv,hpm-i2s']"
    select AW_SUBSYS_SYSTEM_PM_PIN
    select AWSA_FRAMEWORK
    default n
```

## .axioenvs/application.modbus_tcp_slave/build/gcc-riscv32.release/gen/Kconfig/Kconfig.component.aw_cpu_driver_hpm.driver.hpm_lcdc
```kconfig
menuconfig DRV_HPM_LCDC
    bool "hpm_lcdc ['riscv,hpm-lcdc']"
    select AW_SUBSYS_DRIVER_DISPLAY
    select AW_SUBSYS_SYSTEM_PM_PIN
    default n
```

## .axioenvs/application.modbus_tcp_slave/build/gcc-riscv32.release/gen/Kconfig/Kconfig.component.aw_cpu_driver_hpm.driver.hpm_mbx
```kconfig
menuconfig DRV_HPM_MBX
    bool "hpm_mbx ['riscv,hpm_mbx']"
    select AWBUS
    default n
```

## .axioenvs/application.modbus_tcp_slave/build/gcc-riscv32.release/gen/Kconfig/Kconfig.component.aw_cpu_driver_hpm.driver.hpm_multi_core
```kconfig
menuconfig DRV_HPM_MULTI_CORE
    bool "hpm_multi_core ['riscv,hpm_multi_core']"
    select AWBUS
    default n
```

## .axioenvs/application.modbus_tcp_slave/build/gcc-riscv32.release/gen/Kconfig/Kconfig.component.aw_cpu_driver_hpm.driver.hpm_nor_xpi
```kconfig
menuconfig DRV_HPM_NOR_XPI
    bool "hpm_nor_xpi ['riscv,hpm-nor-xpi']"
    select AW_SUBSYS_DRIVER_XIP_FLASH
    default n
```

## .axioenvs/application.modbus_tcp_slave/build/gcc-riscv32.release/gen/Kconfig/Kconfig.component.aw_cpu_driver_hpm.driver.hpm_otp
```kconfig
menuconfig DRV_HPM_OTP
    bool "hpm_otp ['riscv,hpm-otp']"
    select AWB_FS_DEVFS
    default n
```

## .axioenvs/application.modbus_tcp_slave/build/gcc-riscv32.release/gen/Kconfig/Kconfig.component.aw_cpu_driver_hpm.driver.hpm_ptmr_wkuptmr
```kconfig
menuconfig DRV_HPM_PTMR_WKUPTMR
    bool "hpm_ptmr_wkuptmr ['riscv,hpm_ptmr_wkuptmr']"
    select AWBUS
    select AW_API_PM
    default n
```

## .axioenvs/application.modbus_tcp_slave/build/gcc-riscv32.release/gen/Kconfig/Kconfig.component.aw_cpu_driver_hpm.driver.hpm_ptpc_timestamp
```kconfig
menuconfig DRV_HPM_PTPC_TIMESTAMP
    bool "hpm_ptpc_timestamp ['riscv,hpm_ptpc']"
    select AWBUS
    default n
```

## .axioenvs/application.modbus_tcp_slave/build/gcc-riscv32.release/gen/Kconfig/Kconfig.component.aw_cpu_driver_hpm.driver.hpm_pwm
```kconfig
menuconfig DRV_HPM_PWM
    bool "hpm_pwm ['riscv,hpm-pwm']"
    select AW_MATH
    select AW_SUBSYS_DRIVER_PWM
    select AW_SUBSYS_SYSTEM_PM_PIN
    default n
```
