## .axioenvs/application.modbus_tcp_slave/build/gcc-riscv32.debug/gen/Kconfig/Kconfig.component.aw_cpu_driver_hpm.driver.hpm_spi_int
```kconfig
menuconfig DRV_HPM_SPI_INT
    bool "hpm_spi_int ['riscv,hpm-spi_int']"
    select AW_SUBSYS_DRIVER_SPI
    select AW_SUBSYS_SYSTEM_PM_PIN
    default n
```

## .axioenvs/application.modbus_tcp_slave/build/gcc-riscv32.debug/gen/Kconfig/Kconfig.component.aw_cpu_driver_hpm.driver.hpm_spiex
```kconfig
menuconfig DRV_HPM_SPIEX
    bool "hpm_spiex ['riscv,hpm-spiex']"
    select AW_CLK_FRAMEWORK
    select AW_SUBSYS_SYSTEM_PM_PIN
    select AW_SUBSYS_DRIVER_SPIEX
    default n
```

## .axioenvs/application.modbus_tcp_slave/build/gcc-riscv32.debug/gen/Kconfig/Kconfig.component.aw_cpu_driver_hpm.driver.hpm_uart
```kconfig
menuconfig DRV_HPM_UART
    bool "hpm_uart ['riscv,hpm_uart']"
    select AW_SUBSYS_DRIVER_SERIAL
    select AW_SUBSYS_SYSTEM_PM_PIN
    select AW_OS_DELAYED_WORK
    default n

if DRV_HPM_UART

source "D:/aworks_lp_hpm6450_general_sdk-0.9.1/platforms/platform-hpm-aworks-lp/components/aw_cpu_driver_hpm/dts/bindings/uart/riscv,hpm_uart.Kconfig.opts"

endif #DRV_HPM_UART
```

## .axioenvs/application.modbus_tcp_slave/build/gcc-riscv32.debug/gen/Kconfig/Kconfig.component.aw_cpu_driver_hpm.driver.hpm_uart_debug
```kconfig
menuconfig DRV_HPM_UART_DEBUG
    bool "hpm_uart_debug ['riscv,hpm_uart_dbg']"
    select AW_SUBSYS_SYSTEM_SYSDEBUG
    select AW_SUBSYS_DRIVER_SERIAL
    select AW_SUBSYS_SYSTEM_PM_PIN
    select AW_OS_DELAYED_WORK
    select AW_SUBSYS_SYSTEM_SYSDEBUG
    default n
```

## .axioenvs/application.modbus_tcp_slave/build/gcc-riscv32.debug/gen/Kconfig/Kconfig.component.aw_cpu_driver_hpm.driver.riscv_hpm_plic
```kconfig
menuconfig DRV_RISCV_HPM_PLIC
    bool "riscv_hpm_plic ['riscv,hpm_plic']"
    select AWBL_INTCTLR_SERVICE
    select AW_SUBSYS_SYSTEM_INTCTLR
    select AWBUS
    default n
```

## .axioenvs/application.modbus_tcp_slave/build/gcc-riscv32.debug/gen/Kconfig/Kconfig.component.aw_defs_clk
```kconfig
menuconfig AW_DEFS_CLK
    bool "AWorks Clock Base"
    libsafe 
    select AW_INTERFACE
    default n
    help
        Version: 0.0.0

        
```

## .axioenvs/application.modbus_tcp_slave/build/gcc-riscv32.debug/gen/Kconfig/Kconfig.component.aw_face_recognition
```kconfig
menuconfig AW_FACE_RECOGNITION
    bool "aw_face_recognition"
    libsafe 
    select NCNN
    default n
    help
        Version: 0.1.0

        
```

## .axioenvs/application.modbus_tcp_slave/build/gcc-riscv32.debug/gen/Kconfig/Kconfig.component.aw_fs_fatfs
```kconfig
menuconfig AW_FS_FATFS
    bool "Fatfs"
    libsafe 
    select AW_SUBSYS_STORAGE_BLOCKDEV
    select AW_MEM_MANAGE_MEM_POOL
    select AW_API_TIMETRANS
    select AW_IO_BASE
    select AW_CH_ENCODING_CONVERT
    select AWB_VFS_MOUNT_EN
    default n
    help
        Version: 0.0.0

        
if AW_FS_FATFS

source "D:/aworks_lp_hpm6450_general_sdk-0.9.1/frameworks/64cf32e2-aworks_lp/components/kernel/aw_fs_fatfs/Kconfig.opts"

endif #AW_FS_FATFS
```

## .axioenvs/application.modbus_tcp_slave/build/gcc-riscv32.debug/gen/Kconfig/Kconfig.component.aw_fs_lffs
```kconfig
menuconfig AW_FS_LFFS
    bool "Lffs"
    libsafe 
    select AW_IO_BASE
    select AW_SUBSYS_DRIVER_MTD
    select AW_OS_SYS_DEFER
    select AW_OS_DELAYED_WORK
    select AW_MEM_MANAGE_MEM_POOL
    select AW_API_TIME
    select AW_STDIO
    select AWB_VFS_MOUNT_EN
    default n
    help
        Version: 0.0.0

        
if AW_FS_LFFS

source "D:/aworks_lp_hpm6450_general_sdk-0.9.1/frameworks/64cf32e2-aworks_lp/components/kernel/aw_fs_lffs/Kconfig.opts"

endif #AW_FS_LFFS
```

## .axioenvs/application.modbus_tcp_slave/build/gcc-riscv32.debug/gen/Kconfig/Kconfig.component.aw_iec61850_adapter
```kconfig
menuconfig AW_IEC61850_ADAPTER
    bool "AWorksLP adapter for IEC61850"
    libsafe 
    select SQLITE3
    select MBEDTLS
    select AWB_PACKET_SOCKET
    select AW_SQLITE3_ADAPTER
    select AW_MBEDTLS_ADAPTER
    select COMPILER_SUPPORT_POSIX_FILE
    select COMPILER_SUPPORT_STDIO
    select COMPILER_SUPPORT_LIBC_FILE
    select COMPILER_SUPPORT_LIBC_TIME
    select COMPILER_SUPPORT_POSIX_PTHREAD
    default n
    help
        Version: 0.1.0+beta0

        
```

## .axioenvs/application.modbus_tcp_slave/build/gcc-riscv32.debug/gen/Kconfig/Kconfig.component.aw_input_utils
```kconfig
menuconfig AW_INPUT_UTILS
    bool "AWorks Input Utils"
    libsafe 
    select AW_INTERFACE
    select AW_DEV_API
    default n
    help
        Version: 0.0.0

        
if AW_INPUT_UTILS

source "D:/aworks_lp_hpm6450_general_sdk-0.9.1/frameworks/64cf32e2-aworks_lp/app/applications/aw_input_utils/Kconfig.opts"

endif #AW_INPUT_UTILS
```

## .axioenvs/application.modbus_tcp_slave/build/gcc-riscv32.debug/gen/Kconfig/Kconfig.component.aw_interface
```kconfig
menuconfig AW_INTERFACE
    bool "AWorks Interface"
    libsafe 
    default n
    help
        Version: 0.0.0

        
```

## .axioenvs/application.modbus_tcp_slave/build/gcc-riscv32.debug/gen/Kconfig/Kconfig.component.aw_io_base
```kconfig
menuconfig AW_IO_BASE
    bool "AWorks IO base"
    libsafe 
    select AW_INTERFACE
    select AW_MEM_MANAGE_MEM_POOL
    select AW_COMMON_IOCTL_CODE
    default n
    help
        Version: 0.0.0

        Detail:This component provide base IO-APIs(such as,aw_open,aw_close,aw_lseek,etc..) in AWorks
if AW_IO_BASE

source "D:/aworks_lp_hpm6450_general_sdk-0.9.1/frameworks/64cf32e2-aworks_lp/components/kernel/aw_io_base/Kconfig.opts"

endif #AW_IO_BASE
```

## .axioenvs/application.modbus_tcp_slave/build/gcc-riscv32.debug/gen/Kconfig/Kconfig.component.aw_iot_common
```kconfig
menuconfig AW_IOT_COMMON
    bool "IOT Common"
    libsafe 
    select CJSON
    select AW_MBEDTLS_ADAPTER
    select MBEDTLS
    default n
    help
        Version: 0.5.0

        
if AW_IOT_COMMON

source "D:/aworks_lp_hpm6450_general_sdk-0.9.1/components/aw_iot_common/Kconfig.opts"

endif #AW_IOT_COMMON
```

## .axioenvs/application.modbus_tcp_slave/build/gcc-riscv32.debug/gen/Kconfig/Kconfig.component.aw_libcurl_adapter
```kconfig
menuconfig AW_LIBCURL_ADAPTER
    bool "libcurl adaptation layer of AWorks"
    libsafe 
    select COMPILER_SUPPORT_POSIX_SOCKET
    select COMPILER_SUPPORT_POSIX_FILE
    select COMPILER_SUPPORT_LIBC_TIME
    select COMPILER_SUPPORT_STDIO
    select AW_IO_DIR
    default n
    help
        Version: 0.1.0

        
if AW_LIBCURL_ADAPTER

source "D:/aworks_lp_hpm6450_general_sdk-0.9.1/components/aw_libcurl_adapter/Kconfig.opts"

endif #AW_LIBCURL_ADAPTER
```

## .axioenvs/application.modbus_tcp_slave/build/gcc-riscv32.debug/gen/Kconfig/Kconfig.component.aw_lua_adapter
```kconfig
menuconfig AW_LUA_ADAPTER
    bool "LUA AWorks Adapter"
    libsafe 
    select AW_APP_SHELL
    default n
    help
        Version: 1.0.6

        
```

## .axioenvs/application.modbus_tcp_slave/build/gcc-riscv32.debug/gen/Kconfig/Kconfig.component.aw_mem_manager_mem_heap
```kconfig
menuconfig AW_MEM_MANAGER_MEM_HEAP
    bool "AWorks Heap Manager"
    libsafe 
    select AW_INTERFACE
    default n
    help
        Version: 0.0.0

        
```

## .axioenvs/application.modbus_tcp_slave/build/gcc-riscv32.debug/gen/Kconfig/Kconfig.component.aw_modbus_adapter
```kconfig
menuconfig AW_MODBUS_ADAPTER
    bool "AWorks Mudbus Adapter"
    libsafe 
    select AW_INTERFACE
    select AW_DEV_API
    select COMPILER_SUPPORT_POSIX_FILE
    default n
    help
        Version: 1.0.12

        Detail:help

        modbus protocol support.

if AW_MODBUS_ADAPTER

source "D:/aworks_lp_hpm6450_general_sdk-0.9.1/components/24eb128d-aw_modbus_adapter/Kconfig.opts"

endif #AW_MODBUS_ADAPTER
```

## .axioenvs/application.modbus_tcp_slave/build/gcc-riscv32.debug/gen/Kconfig/Kconfig.component.aw_onfi
```kconfig
menuconfig AW_ONFI
    bool "ONFI"
    libsafe 
    select AW_SUBSYS_DRIVER_MTD
    default n
    help
        Version: 0.0.0

        
```

## .axioenvs/application.modbus_tcp_slave/build/gcc-riscv32.debug/gen/Kconfig/Kconfig.component.aw_os_delayed_work
```kconfig
menuconfig AW_OS_DELAYED_WORK
    bool "AWorks delayed work service"
    libsafe 
    select AW_OS_DEFER
    default n
    help
        Version: 0.0.0

        
if AW_OS_DELAYED_WORK

source "D:/aworks_lp_hpm6450_general_sdk-0.9.1/frameworks/64cf32e2-aworks_lp/system/delayed_work/Kconfig.opts"

endif #AW_OS_DELAYED_WORK
```

## .axioenvs/application.modbus_tcp_slave/build/gcc-riscv32.debug/gen/Kconfig/Kconfig.component.aw_os_isr_defer
```kconfig
menuconfig AW_OS_ISR_DEFER
    bool "AWorks isr defer service"
    libsafe 
    select AW_OS_DEFER
    default n
    help
        Version: 0.0.0

        
if AW_OS_ISR_DEFER

source "D:/aworks_lp_hpm6450_general_sdk-0.9.1/frameworks/64cf32e2-aworks_lp/system/isr_defer/Kconfig.opts"

endif #AW_OS_ISR_DEFER
```

## .axioenvs/application.modbus_tcp_slave/build/gcc-riscv32.debug/gen/Kconfig/Kconfig.component.aw_psp_rtk
```kconfig
menuconfig AW_PSP_RTK
    bool "RTK Platform support"
    libsafe 
    select RTK
    select AW_TLS
    default n
    help
        Version: 0.0.0

        
if AW_PSP_RTK

source "D:/aworks_lp_hpm6450_general_sdk-0.9.1/frameworks/64cf32e2-aworks_lp/psp/aw_psp_rtk/Kconfig.opts"

endif #AW_PSP_RTK
```

## .axioenvs/application.modbus_tcp_slave/build/gcc-riscv32.debug/gen/Kconfig/Kconfig.component.aw_ptp
```kconfig
menuconfig AW_PTP
    bool "PTP"
    libsafe 
    select COMPILER_SUPPORT_POSIX_SOCKET
    default n
    help
        Version: 0.1.1+lp

        
```

## .axioenvs/application.modbus_tcp_slave/build/gcc-riscv32.debug/gen/Kconfig/Kconfig.component.aw_sfdp
```kconfig
menuconfig AW_SFDP
    bool "SFDP"
    libsafe 
    select AW_SUBSYS_DRIVER_SPIEX
    select AW_SUBSYS_DRIVER_SPI
    default n
    help
        Version: 0.0.0

        
```

## .axioenvs/application.modbus_tcp_slave/build/gcc-riscv32.debug/gen/Kconfig/Kconfig.component.aw_shell_dev_serial
```kconfig
menuconfig AW_SHELL_DEV_SERIAL
    bool "AWorks Shell Terminals using serial"
    libsafe 
    default n
    help
        Version: 0.0.0

        
if AW_SHELL_DEV_SERIAL

source "D:/aworks_lp_hpm6450_general_sdk-0.9.1/frameworks/64cf32e2-aworks_lp/app/applications/aw_shell_dev_serial/Kconfig.opts"

endif #AW_SHELL_DEV_SERIAL
```
