## .axioenvs/application.modbus_tcp_slave/build/gcc-riscv32.debug/gen/Kconfig/Kconfig.component.aw_tencentcloud_adapter
```kconfig
menuconfig AW_TENCENTCLOUD_ADAPTER
    bool "component aw_tencentcloud_adapter"
    libsafe 
    select AW_IOT_COMMON
    default n
    help
        Version: 0.1.0

        
if AW_TENCENTCLOUD_ADAPTER

source "D:/aworks_lp_hpm6450_general_sdk-0.9.1/components/aw_tencentcloud_adapter/Kconfig.opts"

endif #AW_TENCENTCLOUD_ADAPTER
```

## .axioenvs/application.modbus_tcp_slave/build/gcc-riscv32.debug/gen/Kconfig/Kconfig.component.aw_tls
```kconfig
menuconfig AW_TLS
    bool "AWorks thread local storage functions"
    libsafe 
    select AW_INTERFACE
    default n
    help
        Version: 0.0.0

        
```

## .axioenvs/application.modbus_tcp_slave/build/gcc-riscv32.debug/gen/Kconfig/Kconfig.component.aw_zlib_adapter
```kconfig
menuconfig AW_ZLIB_ADAPTER
    bool "Zlib AWorks Adapter"
    libsafe 
    select AW_APP_SHELL
    select COMPILER_SUPPORT_POSIX_FILE
    select COMPILER_SUPPORT_STDIO
    select COMPILER_SUPPORT_LIBC_MALLOC_FREE
    default n
    help
        Version: 1.0.3

        
```

## .axioenvs/application.modbus_tcp_slave/build/gcc-riscv32.debug/gen/Kconfig/Kconfig.component.aw_zws
```kconfig
menuconfig AW_ZWS
    bool "ZWS"
    libsafe 
    select AW_ZWS_ADAPTER
    default n
    help
        Version: 0.3.0

        
if AW_ZWS


osource  "$(ax_imp_paths,zws_adapter_interface,,False)"

endif #AW_ZWS
```

## .axioenvs/application.modbus_tcp_slave/build/gcc-riscv32.debug/gen/Kconfig/Kconfig.component.awb_common_driver.driver.24cxx
```kconfig
menuconfig DRV_24CXX
    bool "24cxx ['atmel,24cxx']"
    default n
    help
        Example of adding device to board.dts:

        &i2c6{
            atmel_24cxx@50 {
                compatible = "atmel,24cxx";
                label = "24cxx";
                reg = <0x50>;
                status = "disabled";
            };
        };
```

## .axioenvs/application.modbus_tcp_slave/build/gcc-riscv32.debug/gen/Kconfig/Kconfig.component.awb_common_driver.driver.arm_gic
```kconfig
menuconfig DRV_ARM_GIC
    bool "arm_gic ['arm,gic']"
    select AWBL_INTCTLR_SERVICE
    select AW_SUBSYS_SYSTEM_INTCTLR
    select AWBUS
    default n
```

## .axioenvs/application.modbus_tcp_slave/build/gcc-riscv32.debug/gen/Kconfig/Kconfig.component.awb_common_driver.driver.armcm_nvic
```kconfig
menuconfig DRV_ARMCM_NVIC
    bool "armcm_nvic ['arm,v7m-nvic']"
    select AWBL_INTCTLR_SERVICE
    select AW_SUBSYS_SYSTEM_INTCTLR
    select AWBUS
    default n
```

## .axioenvs/application.modbus_tcp_slave/build/gcc-riscv32.debug/gen/Kconfig/Kconfig.component.awb_common_driver.driver.armv6m_nvic
```kconfig
menuconfig DRV_ARMV6M_NVIC
    bool "armv6m_nvic ['arm,v6m-nvic']"
    select AWBL_INTCTLR_SERVICE
    select AW_SUBSYS_SYSTEM_INTCTLR
    select AWBUS
    default n
```

## .axioenvs/application.modbus_tcp_slave/build/gcc-riscv32.debug/gen/Kconfig/Kconfig.component.awb_common_driver.driver.armv7m_systick_timestamp
```kconfig
menuconfig DRV_ARMV7M_SYSTICK_TIMESTAMP
    bool "armv7m_systick_timestamp ['arm,armv7m-systick_timestamp']"
    select AWBUS
    default n
```

## .axioenvs/application.modbus_tcp_slave/build/gcc-riscv32.debug/gen/Kconfig/Kconfig.component.awb_common_driver.driver.bma253
```kconfig
menuconfig DRV_BMA253
    bool "bma253 ['BOSCH,bma253']"
    select AW_SUBSYS_DRIVER_SENSOR
    select AW_OS_ISR_DEFER
    default n
    help
        Example of adding device to board.dts:

        &i2c1{
            bma253:bma253@18 {
                compatible = "BOSCH,bma253";
                label = "BMA253";
                status = "disabled";
                reg = <0x18>;
                event-pins = <&pin1 GPIO1_2 GPIO1_2_GPIO (GPIO1_2_GPIO|AW_PIN_CFG_GPIO_INPUT) GPIO1_2_GPIO>;
                data-pins  = <&pin1 GPIO1_3 GPIO1_3_GPIO (GPIO1_3_GPIO|AW_PIN_CFG_GPIO_INPUT) GPIO1_3_GPIO>;
            };
        };
        

        And also, you can config pin in pins.dts as follow:
        

        &bma253{
            event-pins = <&pin1 GPIO1_2 GPIO1_2_GPIO (GPIO1_2_GPIO|AW_PIN_CFG_GPIO_INPUT) GPIO1_2_GPIO>;
            data-pins  = <&pin1 GPIO1_3 GPIO1_3_GPIO (GPIO1_3_GPIO|AW_PIN_CFG_GPIO_INPUT) GPIO1_3_GPIO>;
        };
```

## .axioenvs/application.modbus_tcp_slave/build/gcc-riscv32.debug/gen/Kconfig/Kconfig.component.awb_common_driver.driver.bme280
```kconfig
menuconfig DRV_BME280
    bool "bme280 ['BST,bme280']"
    select AW_SUBSYS_DRIVER_SENSOR
    default n
    help
        Example of adding device to board.dts:

        &i2c1{
            bme280:bme280@76 {
                compatible = "BST,bme280";
                label = "BME280";
                status = "disabled";
                reg = <0x76>;
            };
        };
```

## .axioenvs/application.modbus_tcp_slave/build/gcc-riscv32.debug/gen/Kconfig/Kconfig.component.awb_common_driver.driver.bu21029muv
```kconfig
menuconfig DRV_BU21029MUV
    bool "bu21029muv ['rohm,bu21029muv']"
    select AW_SUBSYS_DRIVER_I2C
    select AW_SUBSYS_DRIVER_INPUT
    default n
    help
        Example of adding device to board.dts:

        &i2c1 {
            bu21029muv:bu21029muv@40{
                compatible = "rohm,bu21029muv";
                label = "bu21029muv";
                x_plate_ohms = <760>;
                status = "disabled"
                reg = <0x40>;
                int-pins = <&pin1 PIN_PE02  (AW_PIN_CFG_GPIO_INPUT|AW_PIN_CFG_PULL_UP|IOC_PE02_FUNC_CTL_GPIO_E_02)
                                            (AW_PIN_CFG_GPIO_INPUT|AW_PIN_CFG_PULL_UP|IOC_PE02_FUNC_CTL_GPIO_E_02)
                                            (AW_PIN_CFG_GPIO_INPUT|AW_PIN_CFG_PULL_UP|IOC_PE02_FUNC_CTL_GPIO_E_02)>;
                /* rst-pins is optional */
                rst-pins = <&pin1 PIN_PE01  (AW_PIN_CFG_GPIO_OUTPUT|AW_PIN_CFG_PULL_UP|IOC_PE01_FUNC_CTL_GPIO_E_01)
                                            (AW_PIN_CFG_GPIO_OUTPUT|AW_PIN_CFG_PULL_UP|IOC_PE01_FUNC_CTL_GPIO_E_01)
                                            (AW_PIN_CFG_GPIO_OUTPUT|AW_PIN_CFG_PULL_UP|IOC_PE01_FUNC_CTL_GPIO_E_01)>;
            };
            };
        };
        

        And also, you can config pin in pins.dts as follow:
        

        &bu21029muv{  
                int-pins = <&pin1 PIN_PE02  (AW_PIN_CFG_GPIO_INPUT|AW_PIN_CFG_PULL_UP|IOC_PE02_FUNC_CTL_GPIO_E_02)
                                            (AW_PIN_CFG_GPIO_INPUT|AW_PIN_CFG_PULL_UP|IOC_PE02_FUNC_CTL_GPIO_E_02)
                                            (AW_PIN_CFG_GPIO_INPUT|AW_PIN_CFG_PULL_UP|IOC_PE02_FUNC_CTL_GPIO_E_02)>;
                /* rst-pins is optional */
                rst-pins = <&pin1 PIN_PE01  (AW_PIN_CFG_GPIO_OUTPUT|AW_PIN_CFG_PULL_UP|IOC_PE01_FUNC_CTL_GPIO_E_01)
                                            (AW_PIN_CFG_GPIO_OUTPUT|AW_PIN_CFG_PULL_UP|IOC_PE01_FUNC_CTL_GPIO_E_01)
                                            (AW_PIN_CFG_GPIO_OUTPUT|AW_PIN_CFG_PULL_UP|IOC_PE01_FUNC_CTL_GPIO_E_01)>;
            };
        };

        Parameters:

           x_plate_ohms:  x-plate resistance


if DRV_BU21029MUV

source "D:/aworks_lp_hpm6450_general_sdk-0.9.1/frameworks/64cf32e2-aworks_lp/subsys/awb_common_driver/dts/bindings/touchscreen/bu21029muv/rohm,bu21029muv.Kconfig.opts"

endif #DRV_BU21029MUV
```

## .axioenvs/application.modbus_tcp_slave/build/gcc-riscv32.debug/gen/Kconfig/Kconfig.component.awb_common_driver.driver.ch395_spi_enet
```kconfig
menuconfig DRV_CH395_SPI_ENET
    bool "ch395_spi_enet ['WCH,ch395-spi-enet']"
    select AW_SUBSYS_DRIVER_SPI
    select AWB_SUBSYS_NETIF
    select AW_SUBSYS_SYSTEM_PM_PIN
    select AW_OS_ISR_DEFER
    default n
    help
        "WCH,ch395-spi-enet" is used to realize SPI to Ethernet.

        Example of adding device to board.dts:

        Step 1 add the following fragment to "board.dts"
        /*注意：该spi0的dts配置与标准配置不同，由于cs信号控制自定义后，不再需要reg、chipselects参数，这两个参数必须被移除，否则会报错*/
        

        &spi0 {
            ch395_spi_enet:ch395_spi_enet {
                compatible = "WCH,ch395-spi-enet";
                label = "ch395_spi_enet";
                status = "disabled";
            };
        };
        

        Step 2 add the following fragment to "pins.dts"
        

        &ch395_spi_enet{
                /*注意事项：驱动使用时，rst、isr、cs 3个引脚为必须引脚，不可省略，其他引脚的电平配置请参考官网ch395模块文档（章节4：引脚）自行定义*/
                rst-pins  = <&pin1 PIN_PD24  (IOC_PD24_FUNC_CTL_GPIO_D_24  | AW_PIN_CFG_GPIO_OUTPUT_HIGH  | AW_PIN_CFG_PULL_UP)
                                             (IOC_PD24_FUNC_CTL_GPIO_D_24  | AW_PIN_CFG_GPIO_OUTPUT_HIGH  | AW_PIN_CFG_PULL_UP)
                                             (IOC_PD24_FUNC_CTL_GPIO_D_24  | AW_PIN_CFG_GPIO_OUTPUT_HIGH  | AW_PIN_CFG_PULL_UP)>;
                rdy-pins  = <&pin1 PIN_PD23  (IOC_PD23_FUNC_CTL_GPIO_D_23  | AW_PIN_CFG_GPIO_INPUT        | AW_PIN_CFG_PULL_UP)
                                             (IOC_PD23_FUNC_CTL_GPIO_D_23  | AW_PIN_CFG_GPIO_INPUT        | AW_PIN_CFG_PULL_UP)
                                             (IOC_PD23_FUNC_CTL_GPIO_D_23  | AW_PIN_CFG_GPIO_INPUT        | AW_PIN_CFG_PULL_UP)>;
                sel-pins  = <&pin1 PIN_PB10  (IOC_PB10_FUNC_CTL_GPIO_B_10  | AW_PIN_CFG_GPIO_OUTPUT_HIGH  | AW_PIN_CFG_PULL_UP)
                                             (IOC_PB10_FUNC_CTL_GPIO_B_10  | AW_PIN_CFG_GPIO_OUTPUT_HIGH  | AW_PIN_CFG_PULL_UP)
                                             (IOC_PB10_FUNC_CTL_GPIO_B_10  | AW_PIN_CFG_GPIO_OUTPUT_HIGH  | AW_PIN_CFG_PULL_UP)>;
                txd-pins = <&pin1 PIN_PE24   (IOC_PE24_FUNC_CTL_GPIO_E_24  | AW_PIN_CFG_GPIO_OUTPUT_LOW   | AW_PIN_CFG_PULL_UP)
                                             (IOC_PE24_FUNC_CTL_GPIO_E_24  | AW_PIN_CFG_GPIO_OUTPUT_LOW   | AW_PIN_CFG_PULL_UP)
                                             (IOC_PE24_FUNC_CTL_GPIO_E_24  | AW_PIN_CFG_GPIO_OUTPUT_LOW   | AW_PIN_CFG_PULL_UP)>;
                isr-pins  = <&pin1 PIN_PB11  (IOC_PB11_FUNC_CTL_GPIO_B_11  | AW_PIN_CFG_GPIO_INPUT        | AW_PIN_CFG_PULL_UP)
                                             (IOC_PB11_FUNC_CTL_GPIO_B_11  | AW_PIN_CFG_GPIO_INPUT        | AW_PIN_CFG_PULL_UP)
                                             (IOC_PB11_FUNC_CTL_GPIO_B_11  | AW_PIN_CFG_GPIO_INPUT        | AW_PIN_CFG_PULL_UP)>;
                /*由于原生的@reg模式控制的cs信号，无法满足该模块驱动时序，模块内部驱动管脚cs，需要用户自行定义*/
                cs-pins   = <&pin1 PIN_PZ02  (IOC_PZ02_FUNC_CTL_GPIO_Z_02  | AW_PIN_CFG_GPIO_OUTPUT_HIGH)
                                             (IOC_PZ02_FUNC_CTL_GPIO_Z_02  | AW_PIN_CFG_GPIO_OUTPUT_HIGH)
                                             (IOC_PZ02_FUNC_CTL_GPIO_Z_02  | AW_PIN_CFG_GPIO_OUTPUT_HIGH)>;
        };
```

## .axioenvs/application.modbus_tcp_slave/build/gcc-riscv32.debug/gen/Kconfig/Kconfig.component.awb_common_driver.driver.ch395_uart_enet
```kconfig
menuconfig DRV_CH395_UART_ENET
    bool "ch395_uart_enet ['WCH,ch395-uart-enet']"
    select AWBUS
    select AWB_SUBSYS_NETIF
    select AW_SUBSYS_SYSTEM_PM_PIN
    select AW_OS_ISR_DEFER
    default n
    help
        "WCH,ch395-uart-enet" is used to realize UART to Ethernet.

        Example of adding device to board.dts:

        Step 1 add the following fragment to "board.dts"
        / {
           ch395_uart_enet:ch395_uart_enet{
               compatible = "WCH,ch395-uart-enet";
               label = "ch395_uart_enet";
               uart_id = <&uart5>;
               status = "disabled";
           };
        };
        

        Step 2 add the following fragment to "pins.dts"
        

        &ch395_uart_enet{
                rst-pins  = <&pin1 PIN_PD24  (IOC_PD24_FUNC_CTL_GPIO_D_24  | AW_PIN_CFG_GPIO_OUTPUT_HIGH  | AW_PIN_CFG_PULL_UP)
                                             (IOC_PD24_FUNC_CTL_GPIO_D_24  | AW_PIN_CFG_GPIO_OUTPUT_HIGH  | AW_PIN_CFG_PULL_UP)
                                             (IOC_PD24_FUNC_CTL_GPIO_D_24  | AW_PIN_CFG_GPIO_OUTPUT_HIGH  | AW_PIN_CFG_PULL_UP)>;
                rdy-pins  = <&pin1 PIN_PD23  (IOC_PD23_FUNC_CTL_GPIO_D_23  | AW_PIN_CFG_GPIO_INPUT        | AW_PIN_CFG_PULL_UP)
                                             (IOC_PD23_FUNC_CTL_GPIO_D_23  | AW_PIN_CFG_GPIO_INPUT        | AW_PIN_CFG_PULL_UP)
                                             (IOC_PD23_FUNC_CTL_GPIO_D_23  | AW_PIN_CFG_GPIO_INPUT        | AW_PIN_CFG_PULL_UP)>;
                sel-pins  = <&pin1 PIN_PB10  (IOC_PB10_FUNC_CTL_GPIO_B_10  | AW_PIN_CFG_GPIO_OUTPUT_HIGH  | AW_PIN_CFG_PULL_UP)
                                             (IOC_PB10_FUNC_CTL_GPIO_B_10  | AW_PIN_CFG_GPIO_OUTPUT_HIGH  | AW_PIN_CFG_PULL_UP)
                                             (IOC_PB10_FUNC_CTL_GPIO_B_10  | AW_PIN_CFG_GPIO_OUTPUT_HIGH  | AW_PIN_CFG_PULL_UP)>;
                isr-pins  = <&pin1 PIN_PB11  (IOC_PB11_FUNC_CTL_GPIO_B_11  | AW_PIN_CFG_GPIO_INPUT       | AW_PIN_CFG_PULL_UP)
                                             (IOC_PB11_FUNC_CTL_GPIO_B_11  | AW_PIN_CFG_GPIO_INPUT       | AW_PIN_CFG_PULL_UP)
                                             (IOC_PB11_FUNC_CTL_GPIO_B_11  | AW_PIN_CFG_GPIO_INPUT       | AW_PIN_CFG_PULL_UP)>;
        };

        Parameters:

           uart_id:  Must be bound to the uart port, otherwise, device operate will fail.
```

## .axioenvs/application.modbus_tcp_slave/build/gcc-riscv32.debug/gen/Kconfig/Kconfig.component.awb_common_driver.driver.cyw43362_sdio
```kconfig
menuconfig DRV_CYW43362_SDIO
    bool "cyw43362_sdio ['cypress,cyw43362_sdio']"
    select AW_SUBSYS_DRIVER_SDIO
    select AWB_SUBSYS_NETIF
    select AW_SUBSYS_DRIVER_WIFI
    select WICED
    default n
    help
        Example of adding device to board.dts:

        &sdio2 {
            cyw43362:cyw43362_sdio{
                compatible = "cypress,cyw43362_sdio";
                label = "cyw43362";
                status = "disabled";
                wake-pins = <&pin1 PIN_PD25 (AW_PIN_CFG_GPIO_INPUT|AW_PIN_CFG_PULL_DOWN|IOC_PD25_FUNC_CTL_GPIO_D_25)
                                            (AW_PIN_CFG_GPIO_INPUT|AW_PIN_CFG_PULL_DOWN|IOC_PD25_FUNC_CTL_GPIO_D_25)
                                            (AW_PIN_CFG_GPIO_INPUT|AW_PIN_CFG_PULL_DOWN|IOC_PD25_FUNC_CTL_GPIO_D_25)>;
                reset-pins= <&pin1 PIN_PD15 (AW_PIN_CFG_GPIO_OUTPUT_LOW|AW_PIN_CFG_PULL_DOWN|IOC_PD15_FUNC_CTL_GPIO_D_15)
                                            (AW_PIN_CFG_GPIO_OUTPUT_LOW|AW_PIN_CFG_PULL_DOWN|IOC_PD15_FUNC_CTL_GPIO_D_15)
                                            (AW_PIN_CFG_GPIO_OUTPUT_LOW|AW_PIN_CFG_PULL_DOWN|IOC_PD15_FUNC_CTL_GPIO_D_15)>;
            };
        };
        

        And also, you can config pin in pins.dts as follow:
        

        &cyw43362{
            wake-pins = <&pin1 PIN_PD25 (AW_PIN_CFG_GPIO_INPUT|AW_PIN_CFG_PULL_DOWN|IOC_PD25_FUNC_CTL_GPIO_D_25)
                                        (AW_PIN_CFG_GPIO_INPUT|AW_PIN_CFG_PULL_DOWN|IOC_PD25_FUNC_CTL_GPIO_D_25)
                                        (AW_PIN_CFG_GPIO_INPUT|AW_PIN_CFG_PULL_DOWN|IOC_PD25_FUNC_CTL_GPIO_D_25)>;
            reset-pins= <&pin1 PIN_PD15 (AW_PIN_CFG_GPIO_OUTPUT_LOW|AW_PIN_CFG_PULL_DOWN|IOC_PD15_FUNC_CTL_GPIO_D_15)
                                        (AW_PIN_CFG_GPIO_OUTPUT_LOW|AW_PIN_CFG_PULL_DOWN|IOC_PD15_FUNC_CTL_GPIO_D_15)
                                        (AW_PIN_CFG_GPIO_OUTPUT_LOW|AW_PIN_CFG_PULL_DOWN|IOC_PD15_FUNC_CTL_GPIO_D_15)>;
        };

if DRV_CYW43362_SDIO

source "D:/aworks_lp_hpm6450_general_sdk-0.9.1/frameworks/64cf32e2-aworks_lp/subsys/awb_common_driver/dts/bindings/cyw43xxx/cypress,cyw43362_sdio.Kconfig.opts"

endif #DRV_CYW43362_SDIO
```
