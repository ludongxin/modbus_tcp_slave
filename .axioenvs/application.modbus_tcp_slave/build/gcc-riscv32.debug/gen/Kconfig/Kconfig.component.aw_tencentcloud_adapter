## .axioenvs/application.modbus_tcp_slave/build/gcc-riscv32.debug/gen/Kconfig/Kconfig.component.awb_common_driver.driver.cyw43438_sdio
```kconfig
menuconfig DRV_CYW43438_SDIO
    bool "cyw43438_sdio ['cypress,cyw43438_sdio']"
    select AW_SUBSYS_DRIVER_SDIO
    select AWB_SUBSYS_NETIF
    select AW_SUBSYS_DRIVER_WIFI
    select WICED
    default n
    help
        Example of adding device to board.dts:

        &sdio2 {
            cyw43438:cyw43438_sdio{
                compatible = "cypress,cyw43438_sdio";
                label = "cyw43438";
                status = "disabled";
                wake-pins = <&pin1 PIN_PD25 (AW_PIN_CFG_GPIO_INPUT|AW_PIN_CFG_PULL_DOWN|IOC_PD25_FUNC_CTL_GPIO_D_25)
                                            (AW_PIN_CFG_GPIO_INPUT|AW_PIN_CFG_PULL_DOWN|IOC_PD25_FUNC_CTL_GPIO_D_25)
                                            (AW_PIN_CFG_GPIO_INPUT|AW_PIN_CFG_PULL_DOWN|IOC_PD25_FUNC_CTL_GPIO_D_25)>;
                reset-pins= <&pin1 PIN_PD15 (AW_PIN_CFG_GPIO_OUTPUT_LOW|AW_PIN_CFG_PULL_DOWN|IOC_PD15_FUNC_CTL_GPIO_D_15)
                                            (AW_PIN_CFG_GPIO_OUTPUT_LOW|AW_PIN_CFG_PULL_DOWN|IOC_PD15_FUNC_CTL_GPIO_D_15)
                                            (AW_PIN_CFG_GPIO_OUTPUT_LOW|AW_PIN_CFG_PULL_DOWN|IOC_PD15_FUNC_CTL_GPIO_D_15)>;
            };
        };
        

        And also, you can config pin in pins.dts as follow:
        

        &cyw43438{
            wake-pins = <&pin1 PIN_PD25 (AW_PIN_CFG_GPIO_INPUT|AW_PIN_CFG_PULL_DOWN|IOC_PD25_FUNC_CTL_GPIO_D_25)
                                        (AW_PIN_CFG_GPIO_INPUT|AW_PIN_CFG_PULL_DOWN|IOC_PD25_FUNC_CTL_GPIO_D_25)
                                        (AW_PIN_CFG_GPIO_INPUT|AW_PIN_CFG_PULL_DOWN|IOC_PD25_FUNC_CTL_GPIO_D_25)>;
            reset-pins= <&pin1 PIN_PD15 (AW_PIN_CFG_GPIO_OUTPUT_LOW|AW_PIN_CFG_PULL_DOWN|IOC_PD15_FUNC_CTL_GPIO_D_15)
                                        (AW_PIN_CFG_GPIO_OUTPUT_LOW|AW_PIN_CFG_PULL_DOWN|IOC_PD15_FUNC_CTL_GPIO_D_15)
                                        (AW_PIN_CFG_GPIO_OUTPUT_LOW|AW_PIN_CFG_PULL_DOWN|IOC_PD15_FUNC_CTL_GPIO_D_15)>;
        };

if DRV_CYW43438_SDIO

source "D:/aworks_lp_hpm6450_general_sdk-0.9.1/frameworks/64cf32e2-aworks_lp/subsys/awb_common_driver/dts/bindings/cyw43xxx/cypress,cyw43438_sdio.Kconfig.opts"

endif #DRV_CYW43438_SDIO
```

## .axioenvs/application.modbus_tcp_slave/build/gcc-riscv32.debug/gen/Kconfig/Kconfig.component.awb_common_driver.driver.dp83867_phy
```kconfig
menuconfig DRV_DP83867_PHY
    bool "dp83867_phy ['ti,dp83867']"
    select AW_SUBSYS_SYSTEM_PM_PIN
    select AW_SUBSYS_DRIVER_PHY_POLL
    default n
    help
        Example of adding device to board.dts:

        &enet0 {
            phy-handle = <&dp83867>;
            dp83867:dp83867_phy@5{
                compatible = "ti,dp83867";
                status = "disabled";
                label = "ti,dp83867";
                reg = <0x05>;
            };
         };

        Parameters:

           dev_clk:  the ref pll clk for dp83867,if dp83867 has osc ,this must be -1
```

## .axioenvs/application.modbus_tcp_slave/build/gcc-riscv32.debug/gen/Kconfig/Kconfig.component.awb_common_driver.driver.general_dc_buzzer
```kconfig
menuconfig DRV_GENERAL_DC_BUZZER
    bool "general,dc_buzzer ['general,dc_buzzer']"
    select AWBUS
    select AW_SUBSYS_SYSTEM_PM_PIN
    default n
    help
        Example of adding device to board.dts:

         /{
            dc_buzzer{
               compatible = "general,dc_buzzer";
               label = "dc_buzzers";
               status = "disabled";
               dc_buzzer0{
                   pins = <&pin1 GPIO4_14 GPIO4_14_GPIO GPIO4_14_GPIO GPIO4_14_GPIO>;
                   label = "dc_buzzer0";
                   active_low = "true"; 
                   status = "disabled";
               };
            };
         };

        Subnode parameters:

           active_low:  if buzzer on when PIN output low, must set "active_low = "true"", otherwise set "active_low = "false"".


if DRV_GENERAL_DC_BUZZER

source "D:/aworks_lp_hpm6450_general_sdk-0.9.1/frameworks/64cf32e2-aworks_lp/subsys/awb_common_driver/dts/bindings/buzzer/general,dc_buzzer.Kconfig.opts"

endif #DRV_GENERAL_DC_BUZZER
```

## .axioenvs/application.modbus_tcp_slave/build/gcc-riscv32.debug/gen/Kconfig/Kconfig.component.awb_common_driver.driver.general_uart_lin
```kconfig
menuconfig DRV_GENERAL_UART_LIN
    bool "general,uart-lin ['general,uart-lin']"
    select AWBUS
    default n
    help
        Example of adding device to board.dts:

           / {
              lin_0:lin0{
                  compatible = "general,uart-lin";
                  label = "lin0";
                  uart_id = <&uart8>;
                  status = "disabled";
              };
          };

        Parameters:

           uart_id:  Must be bound to the serial port, otherwise, device operate will fail.
```

## .axioenvs/application.modbus_tcp_slave/build/gcc-riscv32.debug/gen/Kconfig/Kconfig.component.awb_common_driver.driver.generic_phy
```kconfig
menuconfig DRV_GENERIC_PHY
    bool "generic_phy ['none,generic_phy']"
    select AW_SUBSYS_SYSTEM_PM_PIN
    select AW_SUBSYS_DRIVER_PHY_POLL
    default n
    help
        Example of adding device to board.dts:

        &enet {
            phy-handle = <&generic>;
            generic:generic_phy@1{
                compatible = "none,generic_phy";
                status = "disabled";
                label = "generic";
                reg = <0x01>;
            };
        };
```

## .axioenvs/application.modbus_tcp_slave/build/gcc-riscv32.debug/gen/Kconfig/Kconfig.component.awb_common_driver.driver.gigadevice
```kconfig
menuconfig DRV_GIGADEVICE
    bool "gigadevice ['gd,gd5fxgqx']"
    select AW_SUBSYS_DRIVER_MTD
    select AW_MATH
    default n
    help
        Example of adding device to board.dts:

        &spi0 {
            gd5f1gq5ue:gd5f1gq5ue@0{
                compatible = "gd,gd5fxgqx";
                label = "gd5f1gq5ue";
                reg = <0>; /* cs index, chipselects from the spi host */
                status = "disabled";
         
                partition_0 {
                label        = "gd5f1gq5ue_partition_0";
                block_start  = <0>;
                block_number = <512>;
                };
                partition_1 {
                label        = "gd5f1gq5ue_partition_1";
                block_start  = <512>;
                block_number = <500>;
                };
                partition_2 {
                label        = "gd5f1gq5ue_partition_2";
                block_start  = <1012>;
                block_number = <12>;
                };
            };
        };

        Subnode parameters:

           block_start:  The block number at the beginning of a partition

           block_number:  Number of blocks occupied by a partition
```

## .axioenvs/application.modbus_tcp_slave/build/gcc-riscv32.debug/gen/Kconfig/Kconfig.component.awb_common_driver.driver.gpio_i2c
```kconfig
menuconfig DRV_GPIO_I2C
    bool "gpio_i2c ['general,gpio_i2c']"
    select AW_SUBSYS_DRIVER_I2C
    select AW_SUBSYS_SYSTEM_PM_PIN
    default n
    help
        Example of adding device to board.dts:

        / {
            gpioi2c0:gpioi2c_0 {
                compatible = "general,gpio_i2c";
                label = "gpioi2c0";
                #address-cells = <1>;
                #size-cells = <0>;
                bus_speed = <400000>;
                status = "disabled";
                scl-pins = <&pin1 GPIO1_16 GPIO1_16_GPIO GPIO1_16_GPIO GPIO1_16_GPIO>;
                sda-pins = <&pin1 GPIO1_17 GPIO1_17_GPIO GPIO1_17_GPIO GPIO1_17_GPIO>;
            };
        };
        

        And also, you can config pin in pins.dts as follow:
        

        &gpioi2c0{
                scl-pins = <&pin1 GPIO1_16 GPIO1_16_GPIO GPIO1_16_GPIO GPIO1_16_GPIO>;
                sda-pins = <&pin1 GPIO1_17 GPIO1_17_GPIO GPIO1_17_GPIO GPIO1_17_GPIO>;
        };
```

## .axioenvs/application.modbus_tcp_slave/build/gcc-riscv32.debug/gen/Kconfig/Kconfig.component.awb_common_driver.driver.gpio_key
```kconfig
menuconfig DRV_GPIO_KEY
    bool "gpio_key ['general,gpio_key']"
    select AW_SUBSYS_SYSTEM_PM_PIN
    select AW_OS_DELAYED_WORK
    default n
    help
        Example of adding device to board.dts:

        / {
          gpio_key{
             compatible = "general,gpio_key";
             label = "gpio_keys";
             status = "disabled";
             key1{
                 pins = <&pin1 GPIO1_8 (GPIO1_8_GPIO|AW_PIN_CFG_GPIO_INPUT|AW_PIN_CFG_PULL_UP) 
                                       (GPIO1_8_GPIO|AW_PIN_CFG_GPIO_INPUT|AW_PIN_CFG_PULL_UP) 
                                       (GPIO1_8_GPIO|AW_PIN_CFG_GPIO_INPUT|AW_PIN_CFG_PULL_UP)>;
                 active_high = "false";
                 label = "key1";
                 status = "disabled";
             };
             key2{
                 pins = <&pin1 GPIO1_9 (GPIO1_9_GPIO|AW_PIN_CFG_GPIO_INPUT|AW_PIN_CFG_PULL_UP) 
                                       (GPIO1_9_GPIO|AW_PIN_CFG_GPIO_INPUT|AW_PIN_CFG_PULL_UP)
                                       (GPIO1_9_GPIO|AW_PIN_CFG_GPIO_INPUT|AW_PIN_CFG_PULL_UP)>;
                 active_high = "false";
                 label = "key2";
                 status = "disabled";
              };
          };
        };

        Subnode parameters:

           active_high:  if high level when key be pressed
```

## .axioenvs/application.modbus_tcp_slave/build/gcc-riscv32.debug/gen/Kconfig/Kconfig.component.awb_common_driver.driver.gpio_led
```kconfig
menuconfig DRV_GPIO_LED
    bool "gpio_led ['general,gpio_led']"
    select AW_SUBSYS_DRIVER_LED
    select AW_SUBSYS_SYSTEM_PM_PIN
    default n
    help
        Example of adding device to board.dts:

        / {
            gpio_led{
                compatible = "general,gpio_led";
                label = "gpio_leds";
                status = "disabled";
                led0:led_run{ 
                    pins = <&pin1 GPIO4_16 GPIO4_16_GPIO GPIO4_16_GPIO GPIO4_16_GPIO>;
                    active_low = "true";
                    label = "led_run";
                    status = "disabled";
                };
                led1:led_err{
                   pins = <&pin1 GPIO4_14 GPIO4_14_GPIO GPIO4_14_GPIO GPIO4_14_GPIO>;
                   active_low = "true";
                   label = "led_err";
                   status = "disabled";
                };
           };
        };
        

        And also, you can config pin in pins.dts as follow:
        

        &led0{
            pins = <&pin1 GPIO4_16 GPIO4_16_GPIO GPIO4_16_GPIO GPIO4_16_GPIO>;
        };
        &led1{
            pins = <&pin1 GPIO4_14 GPIO4_14_GPIO GPIO4_14_GPIO GPIO4_14_GPIO>;
        };

        Subnode parameters:

           active_low:  if LED on when PIN output low, must set "active_low = "true"", otherwise set "active_low = "false""(default "active_low = "true"").
```

## .axioenvs/application.modbus_tcp_slave/build/gcc-riscv32.debug/gen/Kconfig/Kconfig.component.awb_common_driver.driver.gpio_spi
```kconfig
menuconfig DRV_GPIO_SPI
    bool "gpio_spi ['general,gpio_spi']"
    select AW_SUBSYS_DRIVER_SPI
    select AW_SUBSYS_SYSTEM_PM_PIN
    default n
    help
        Example of adding device to board.dts:

        / {
            gpiospi0:gpiospi_0 { 
            compatible = "general,gpio_spi";
            label = "gpiospi0";
            #address-cells = <1>;
            #size-cells = <0>;
            bus_speed = <400000>;
            status = "disabled";
            sclk-pins = <&pin1 PIN_PZ03 IOC_PZ03_FUNC_CTL_GPIO_Z_03 IOC_PZ03_FUNC_CTL_GPIO_Z_03 IOC_PZ03_FUNC_CTL_GPIO_Z_03>;
            mosi-pins = <&pin1 PIN_PZ04 IOC_PZ04_FUNC_CTL_GPIO_Z_04 IOC_PZ04_FUNC_CTL_GPIO_Z_04 IOC_PZ04_FUNC_CTL_GPIO_Z_04>;
            miso-pins = <&pin1 PIN_PZ05 IOC_PZ05_FUNC_CTL_GPIO_Z_05 IOC_PZ05_FUNC_CTL_GPIO_Z_05 IOC_PZ05_FUNC_CTL_GPIO_Z_05>;
            cs-pins   = <&pin1 PIN_PZ02 IOC_PZ02_FUNC_CTL_GPIO_Z_02 IOC_PZ02_FUNC_CTL_GPIO_Z_02 IOC_PZ02_FUNC_CTL_GPIO_Z_02>;
            /* 从左至右参数：<引脚编号> <CS是否高有效> <是否硬件CS> <如果是硬件CS，其硬件CS索引(参考寄存器)> */
            chipselects = <PIN_PZ02  0  0  0    /* 片选索引 0 */
                      >;
        };
        

        And also, you can config pin in pins.dts as follow:
        

        &gpiospi0{
            sclk-pins = <&pin1 PIN_PZ03 IOC_PZ03_FUNC_CTL_GPIO_Z_03 IOC_PZ03_FUNC_CTL_GPIO_Z_03 IOC_PZ03_FUNC_CTL_GPIO_Z_03>;
            mosi-pins = <&pin1 PIN_PZ04 IOC_PZ04_FUNC_CTL_GPIO_Z_04 IOC_PZ04_FUNC_CTL_GPIO_Z_04 IOC_PZ04_FUNC_CTL_GPIO_Z_04>;
            miso-pins = <&pin1 PIN_PZ05 IOC_PZ05_FUNC_CTL_GPIO_Z_05 IOC_PZ05_FUNC_CTL_GPIO_Z_05 IOC_PZ05_FUNC_CTL_GPIO_Z_05>;
            cs-pins   = <&pin1 PIN_PZ02 IOC_PZ02_FUNC_CTL_GPIO_Z_02 IOC_PZ02_FUNC_CTL_GPIO_Z_02 IOC_PZ02_FUNC_CTL_GPIO_Z_02>;
            /* 从左至右参数：<引脚编号> <CS是否高有效> <是否硬件CS> <如果是硬件CS，其硬件CS索引(参考寄存器)> */
            chipselects = <PIN_PZ02  0  0  0    /* 片选索引 0 */
                      >;
        };

if DRV_GPIO_SPI

source "D:/aworks_lp_hpm6450_general_sdk-0.9.1/frameworks/64cf32e2-aworks_lp/subsys/awb_common_driver/dts/bindings/gpio_spi/general,gpio_spi.Kconfig.opts"

endif #DRV_GPIO_SPI
```
