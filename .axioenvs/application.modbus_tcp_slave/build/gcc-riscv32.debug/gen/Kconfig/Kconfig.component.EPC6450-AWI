## .axioenvs/application.modbus_tcp_slave/build/gcc-riscv32.debug/gen/Kconfig/Kconfig.component.EPC6450-AWI.device.hpm_pwm_7
```kconfig
menuconfig DEV_PWM0_CHAN7
    bool "pwm0_chan7 @ pwm0"
    default n
    visible if y
    select DRV_HPM_PWM
    select DEV_PIN_1
    select DEV_PIN_1_PIN_RES_52
    select DEV_PIN_1_AWB_PIN_SERVICE

    help
      Filename: "/dev/pwm0_chan7"

      dts_dev_prop:
          name(unit): "hpm_pwm" (7)
          compatible: ['riscv,hpm-pwm']
          dts_path: /soc/pwm@0xF0200000/pwm0_chan7@7
          binding: D:\aworks_lp_hpm6450_general_sdk-0.9.1\platforms\platform-hpm-aworks-lp\components\aw_cpu_driver_hpm\dts\bindings\pwm\riscv,hpm-pwm.yaml


if DEV_PWM0_CHAN7

config DEV_PWM0_CHAN7_PWM_DEFAULT_PERIOD_NS
    int "Default PWM period (ns)"
    default 2000000


config DEV_PWM0_CHAN7_PWM_DEFAULT_DUTY_NS
    int "Default PWM duty (ns)"
    default 1000000

endif #DEV_PWM0_CHAN7
```

## .axioenvs/application.modbus_tcp_slave/build/gcc-riscv32.debug/gen/Kconfig/Kconfig.component.EPC6450-AWI.device.hpm_pwm_8
```kconfig
menuconfig DEV_PWM3_CHAN0
    bool "pwm3_chan0 @ pwm3"
    default n
    visible if y
    select DRV_HPM_PWM

    help
      Filename: "/dev/pwm3_chan0"

      dts_dev_prop:
          name(unit): "hpm_pwm" (8)
          compatible: ['riscv,hpm-pwm']
          dts_path: /soc/pwm@0xF0230000/pwm3_chan0@0
          binding: D:\aworks_lp_hpm6450_general_sdk-0.9.1\platforms\platform-hpm-aworks-lp\components\aw_cpu_driver_hpm\dts\bindings\pwm\riscv,hpm-pwm.yaml


if DEV_PWM3_CHAN0

config DEV_PWM3_CHAN0_PWM_DEFAULT_PERIOD_NS
    int "Default PWM period (ns)"
    default 2000000


config DEV_PWM3_CHAN0_PWM_DEFAULT_DUTY_NS
    int "Default PWM duty (ns)"
    default 1000000


config DEV_PWM3_CHAN0_PWM_PAIR_ENABLE
    bool "pwm_pair_enable"
    default n
    help 
        When this option is enabled only as a complementary PWM device, the following configuration will take effect.


if DEV_PWM3_CHAN0_PWM_PAIR_ENABLE

config DEV_PWM3_CHAN0_PWM_PAIR_DEADTIME1
    int "Default pwm_pair deadtime1 (ns)"
    default 2
    range 0 1000000
    help 
        Default pwm_pair main deadtime (ns)


config DEV_PWM3_CHAN0_PWM_PAIR_DEADTIME2
    int "Default pwm_pair deadtime2 (ns)"
    default 2
    range 0 1000000
    help 
        Default pwm_pair complementary deadtime (ns)

endif #DEV_PWM3_CHAN0_PWM_PAIR_ENABLE

endif #DEV_PWM3_CHAN0
```

## .axioenvs/application.modbus_tcp_slave/build/gcc-riscv32.debug/gen/Kconfig/Kconfig.component.EPC6450-AWI.device.hpm_pwm_timer_0
```kconfig
menuconfig DEV_PWM0
    bool "pwm0"
    default n
    visible if y
    select DRV_HPM_PWM_TIMER
    select DEV_PLIC0
    select DEV_PLIC0_INTERRUPT_RES_72
    select DEV_PLIC0_AWBL_INTCTLR_SERVICE

    help
      Filename: "/dev/pwm0"

      dts_dev_prop:
          name(unit): "hpm_pwm_timer" (0)
          compatible: ['riscv,hpm-pwm-ctrl']
          dts_path: /soc/pwm@0xF0200000
          binding: D:\aworks_lp_hpm6450_general_sdk-0.9.1\platforms\platform-hpm-aworks-lp\components\aw_cpu_driver_hpm\dts\bindings\pwm\riscv,hpm-pwm-ctrl.yaml




if DEV_PWM0
osource "D:/aworks_lp_hpm6450_general_sdk-0.9.1/demos/component/modbus/modbus_tcp_slave/.axioenvs/application.modbus_tcp_slave/build/gcc-riscv32.debug/gen/Kconfig/Kconfig.component.EPC6450-AWI.device.hpm_pwm_0"
if !DEV_PWM0_CHAN0_PWM_PAIR_ENABLE
osource "D:/aworks_lp_hpm6450_general_sdk-0.9.1/demos/component/modbus/modbus_tcp_slave/.axioenvs/application.modbus_tcp_slave/build/gcc-riscv32.debug/gen/Kconfig/Kconfig.component.EPC6450-AWI.device.hpm_pwm_1"
endif #DEV_PWM0_CHAN0_PWM_PAIR_ENABLE
osource "D:/aworks_lp_hpm6450_general_sdk-0.9.1/demos/component/modbus/modbus_tcp_slave/.axioenvs/application.modbus_tcp_slave/build/gcc-riscv32.debug/gen/Kconfig/Kconfig.component.EPC6450-AWI.device.hpm_pwm_2"
if !DEV_PWM0_CHAN2_PWM_PAIR_ENABLE
osource "D:/aworks_lp_hpm6450_general_sdk-0.9.1/demos/component/modbus/modbus_tcp_slave/.axioenvs/application.modbus_tcp_slave/build/gcc-riscv32.debug/gen/Kconfig/Kconfig.component.EPC6450-AWI.device.hpm_pwm_3"
endif #DEV_PWM0_CHAN2_PWM_PAIR_ENABLE
osource "D:/aworks_lp_hpm6450_general_sdk-0.9.1/demos/component/modbus/modbus_tcp_slave/.axioenvs/application.modbus_tcp_slave/build/gcc-riscv32.debug/gen/Kconfig/Kconfig.component.EPC6450-AWI.device.hpm_pwm_4"
if !DEV_PWM0_CHAN4_PWM_PAIR_ENABLE
osource "D:/aworks_lp_hpm6450_general_sdk-0.9.1/demos/component/modbus/modbus_tcp_slave/.axioenvs/application.modbus_tcp_slave/build/gcc-riscv32.debug/gen/Kconfig/Kconfig.component.EPC6450-AWI.device.hpm_pwm_5"
endif #DEV_PWM0_CHAN4_PWM_PAIR_ENABLE
osource "D:/aworks_lp_hpm6450_general_sdk-0.9.1/demos/component/modbus/modbus_tcp_slave/.axioenvs/application.modbus_tcp_slave/build/gcc-riscv32.debug/gen/Kconfig/Kconfig.component.EPC6450-AWI.device.hpm_pwm_6"
if !DEV_PWM0_CHAN6_PWM_PAIR_ENABLE
osource "D:/aworks_lp_hpm6450_general_sdk-0.9.1/demos/component/modbus/modbus_tcp_slave/.axioenvs/application.modbus_tcp_slave/build/gcc-riscv32.debug/gen/Kconfig/Kconfig.component.EPC6450-AWI.device.hpm_pwm_7"
endif #DEV_PWM0_CHAN6_PWM_PAIR_ENABLE

endif #DEV_PWM0
```

## .axioenvs/application.modbus_tcp_slave/build/gcc-riscv32.debug/gen/Kconfig/Kconfig.component.EPC6450-AWI.device.hpm_rtc_0
```kconfig
menuconfig DEV_RTC
    bool "rtc"
    default n
    visible if y
    select DRV_HPM_RTC
    select DEV_PLIC0
    select DEV_PLIC0_INTERRUPT_RES_120
    select DEV_PLIC0_AWBL_INTCTLR_SERVICE

    help
      Filename: "/dev/rtc"

      dts_dev_prop:
          name(unit): "hpm_rtc" (0)
          compatible: ['riscv,hpm-rtc']
          dts_path: /soc/rtc@0xF5044000
          binding: D:\aworks_lp_hpm6450_general_sdk-0.9.1\platforms\platform-hpm-aworks-lp\components\aw_cpu_driver_hpm\dts\bindings\rtc\riscv,hpm-rtc.yaml
```
