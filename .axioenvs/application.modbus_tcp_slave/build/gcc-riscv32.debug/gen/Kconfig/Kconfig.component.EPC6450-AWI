## .axioenvs/application.modbus_tcp_slave/build/gcc-riscv32.debug/gen/Kconfig/Kconfig.component.EPC6450-AWI.device.hpm_can_1
```kconfig
menuconfig DEV_CAN1
    bool "can1"
    default n
    visible if y
    select DRV_HPM_CAN
    select DEV_PLIC0
    select DEV_PLIC0_INTERRUPT_RES_48
    select DEV_PLIC0_AWBL_INTCTLR_SERVICE

    help
      Filename: "/dev/can1"

      dts_dev_prop:
          name(unit): "hpm_can" (1)
          compatible: ['riscv,hpm_can']
          dts_path: /soc/can@F0084000
          binding: D:\aworks_lp_hpm6450_general_sdk-0.9.1\platforms\platform-hpm-aworks-lp\components\aw_cpu_driver_hpm\dts\bindings\can\riscv,hpm_can.yaml


if DEV_CAN1

config DEV_CAN1_DEFAULT_BAUDRATE
    int "the default baudrate (Kbps) for can,or arbitration field baudrate for canfd"
    default 500


config DEV_CAN1_RX_BUF_MSG_COUNT
    int "number of msg count that the rx buffer contain"
    default 256


config DEV_CAN1_ERR_BUF_MSG_COUNT
    int "number of msg count that the err buffer contain"
    default 16


config DEV_CAN1_ENABLE_TIMESTAMP
    bool "CAN msg add timestamp info"
    default y
    select DEV_PTPC 


config DEV_CAN1_IS_LISTEN_ONLY
    bool "CAN work in listen only mode"
    default n


config DEV_CAN1_RECV_SELF_SEND
    bool "CAN recv frames which is sent by himself"
    default n


config DEV_CAN1_IS_LOOPBACK
    bool "CAN work in loopback mode"
    default n


config DEV_CAN1_IS_CANFD_DEV
    bool "register CANFD device"
    default y


if DEV_CAN1_IS_CANFD_DEV

config DEV_CAN1_DATA_BAUDRATE
    int "data field baudrate (Kbps)"
    default 1000

endif #DEV_CAN1_IS_CANFD_DEV

endif #DEV_CAN1
```

## .axioenvs/application.modbus_tcp_slave/build/gcc-riscv32.debug/gen/Kconfig/Kconfig.component.EPC6450-AWI.device.hpm_can_3
```kconfig
menuconfig DEV_CAN3
    bool "can3"
    default n
    visible if y
    select DRV_HPM_CAN
    select DEV_PLIC0
    select DEV_PIN_1
    select DEV_PLIC0_INTERRUPT_RES_50
    select DEV_PLIC0_AWBL_INTCTLR_SERVICE
    select DEV_PIN_1_PIN_RES_133
    select DEV_PIN_1_AWB_PIN_SERVICE
    select DEV_PIN_1_PIN_RES_44

    help
      Filename: "/dev/can3"

      dts_dev_prop:
          name(unit): "hpm_can" (3)
          compatible: ['riscv,hpm_can']
          dts_path: /soc/can@F008c000
          binding: D:\aworks_lp_hpm6450_general_sdk-0.9.1\platforms\platform-hpm-aworks-lp\components\aw_cpu_driver_hpm\dts\bindings\can\riscv,hpm_can.yaml


if DEV_CAN3

config DEV_CAN3_DEFAULT_BAUDRATE
    int "the default baudrate (Kbps) for can,or arbitration field baudrate for canfd"
    default 500


config DEV_CAN3_RX_BUF_MSG_COUNT
    int "number of msg count that the rx buffer contain"
    default 256


config DEV_CAN3_ERR_BUF_MSG_COUNT
    int "number of msg count that the err buffer contain"
    default 16


config DEV_CAN3_ENABLE_TIMESTAMP
    bool "CAN msg add timestamp info"
    default y
    select DEV_PTPC 


config DEV_CAN3_IS_LISTEN_ONLY
    bool "CAN work in listen only mode"
    default n


config DEV_CAN3_RECV_SELF_SEND
    bool "CAN recv frames which is sent by himself"
    default n


config DEV_CAN3_IS_LOOPBACK
    bool "CAN work in loopback mode"
    default n


config DEV_CAN3_IS_CANFD_DEV
    bool "register CANFD device"
    default y


if DEV_CAN3_IS_CANFD_DEV

config DEV_CAN3_DATA_BAUDRATE
    int "data field baudrate (Kbps)"
    default 1000

endif #DEV_CAN3_IS_CANFD_DEV

endif #DEV_CAN3
```

## .axioenvs/application.modbus_tcp_slave/build/gcc-riscv32.debug/gen/Kconfig/Kconfig.component.EPC6450-AWI.device.hpm_enet_1
```kconfig
menuconfig DEV_ETH1
    bool "eth1"
    default n
    visible if y
    select DRV_HPM_ENET
    select DEV_PLIC0
    select DEV_PIN_1
    select DEV_PLIC0_INTERRUPT_RES_109
    select DEV_PLIC0_AWBL_INTCTLR_SERVICE
    select DEV_PIN_1_PIN_RES_107
    select DEV_PIN_1_AWB_PIN_SERVICE
    select DEV_PIN_1_PIN_RES_110
    select DEV_PIN_1_PIN_RES_142
    select DEV_PIN_1_PIN_RES_143
    select DEV_PIN_1_PIN_RES_146
    select DEV_PIN_1_PIN_RES_148
    select DEV_PIN_1_PIN_RES_145
    select DEV_PIN_1_PIN_RES_147
    select DEV_PIN_1_PIN_RES_144

    help
      Filename: "/dev/eth1"

      dts_dev_prop:
          name(unit): "hpm_enet" (1)
          compatible: ['riscv,hpm_ethernet']
          dts_path: /soc/eth@0xF2004000
          binding: D:\aworks_lp_hpm6450_general_sdk-0.9.1\platforms\platform-hpm-aworks-lp\components\aw_cpu_driver_hpm\dts\bindings\enet\riscv,hpm_ethernet.yaml


if DEV_ETH1

config DEV_ETH1_IPADDR
    string "IP address"
    default "192.168.138.251"


config DEV_ETH1_NETMASK
    string "Netmask"
    default "255.255.255.0"


config DEV_ETH1_GATEWAY
    string "Gateway"
    default "192.168.138.1"


config DEV_ETH1_DHCP_EN
    bool "Enable DHCP"
    default n


config DEV_ETH1_INT_TSK_PRIO
    int "Int Task Prio"
    default 2


config DEV_ETH1_FEC_RBD_NUM
    int "Recv buffer descripter Count"
    default 64
    range 8 256


config DEV_ETH1_FEC_TBD_NUM
    int "Transmit buffer descripter Count"
    default 24
    range 8 256


config DEV_ETH1_PASS_ALL_MULTICAST
    bool "enable pass all multicast"
    default n
    help 
        enabled, this bit indicates that all received frames with a multicast destination address (the first bit in the Destination Address field is "1") are delivered.


config DEV_ETH1_PROMISCUOUS_MODE
    bool "Promiscuous Mode"
    default n
    help 
        enabled, the netif will turn off (MAC) address filtering and pass through all network frames.


config DEV_ETH1_IS_INTERNAL_CLK
    bool "Enable internal clk"
    default y


config DEV_ETH1_RX_DELAY
    int "Receive Clock Delay"
    default 0
    range 0 32
    help 
        Receive Clock Delay, this parameter may be different in different hardware borad.


config DEV_ETH1_TX_DELAY
    int "Transmit Clock Delay"
    default 0
    range 0 32
    help 
        Transmit Clock Delay , this parameter may be different in different hardware borad.


config DEV_ETH1_CACHE_RAW_RX_PACKET_COUNT
    int "if user read raw ethernet packet is enabled,this control the max packet count in receive buffer."
    default 64
    range 0 65536


config DEV_ETH1_PTP_ENABLE
    bool "PTP timer enable"
    default n
    select DRV_ENET_1588_TIMESTAMP_EN 
    select AW_SUBSYS_TIME 

endif #DEV_ETH1
```

## .axioenvs/application.modbus_tcp_slave/build/gcc-riscv32.debug/gen/Kconfig/Kconfig.component.EPC6450-AWI.device.hpm_i2c_3
```kconfig
menuconfig DEV_I2C3
    bool "i2c3"
    default n
    visible if y
    select DRV_HPM_I2C
    select DEV_PLIC0
    select DEV_PIN_1
    select DEV_PLIC0_INTERRUPT_RES_71
    select DEV_PLIC0_AWBL_INTCTLR_SERVICE
    select DEV_PIN_1_PIN_RES_45
    select DEV_PIN_1_AWB_PIN_SERVICE
    select DEV_PIN_1_PIN_RES_46

    help
      Filename: "/dev/i2c3"

      dts_dev_prop:
          name(unit): "hpm_i2c" (3)
          compatible: ['riscv,hpm_i2c']
          dts_path: /soc/i2c@0xF302C000
          binding: D:\aworks_lp_hpm6450_general_sdk-0.9.1\platforms\platform-hpm-aworks-lp\components\aw_cpu_driver_hpm\dts\bindings\i2c\riscv,hpm-i2c.yaml


if DEV_I2C3

config DEV_I2C3_TIMEOUT
    int "the bus timeout(us, step: 1000us) for i2c"
    default 5000


config DEV_I2C3_BUS_SPEED
    int "the bus speed for i2c"
    default 100000

endif #DEV_I2C3
```

## .axioenvs/application.modbus_tcp_slave/build/gcc-riscv32.debug/gen/Kconfig/Kconfig.component.EPC6450-AWI.device.hpm_mbx_0
```kconfig
menuconfig DEV_MBX0A
    bool "mbx0a"
    default n
    visible if y
    select DRV_HPM_MBX
    select DEV_PLIC0
    select DEV_PLIC0_INTERRUPT_RES_56
    select DEV_PLIC0_AWBL_INTCTLR_SERVICE

    help
      Filename: "/dev/mbx0a"

      dts_dev_prop:
          name(unit): "hpm_mbx" (0)
          compatible: ['riscv,hpm_mbx']
          dts_path: /soc/mbx@0xF00A0000
          binding: D:\aworks_lp_hpm6450_general_sdk-0.9.1\platforms\platform-hpm-aworks-lp\components\aw_cpu_driver_hpm\dts\bindings\mbx\riscv,hpm_mbx.yaml
```

## .axioenvs/application.modbus_tcp_slave/build/gcc-riscv32.debug/gen/Kconfig/Kconfig.component.EPC6450-AWI.device.hpm_mbx_1
```kconfig
menuconfig DEV_MBX0B
    bool "mbx0b"
    default n
    visible if y
    select DRV_HPM_MBX
    select DEV_PLIC0
    select DEV_PLIC0_INTERRUPT_RES_57
    select DEV_PLIC0_AWBL_INTCTLR_SERVICE

    help
      Filename: "/dev/mbx0b"

      dts_dev_prop:
          name(unit): "hpm_mbx" (1)
          compatible: ['riscv,hpm_mbx']
          dts_path: /soc/mbx@0xF00A4000
          binding: D:\aworks_lp_hpm6450_general_sdk-0.9.1\platforms\platform-hpm-aworks-lp\components\aw_cpu_driver_hpm\dts\bindings\mbx\riscv,hpm_mbx.yaml
```

## .axioenvs/application.modbus_tcp_slave/build/gcc-riscv32.debug/gen/Kconfig/Kconfig.component.EPC6450-AWI.device.hpm_mbx_2
```kconfig
menuconfig DEV_MBX1A
    bool "mbx1a"
    default n
    visible if y
    select DRV_HPM_MBX
    select DEV_PLIC0
    select DEV_PLIC0_INTERRUPT_RES_58
    select DEV_PLIC0_AWBL_INTCTLR_SERVICE

    help
      Filename: "/dev/mbx1a"

      dts_dev_prop:
          name(unit): "hpm_mbx" (2)
          compatible: ['riscv,hpm_mbx']
          dts_path: /soc/mbx@0xF00A8000
          binding: D:\aworks_lp_hpm6450_general_sdk-0.9.1\platforms\platform-hpm-aworks-lp\components\aw_cpu_driver_hpm\dts\bindings\mbx\riscv,hpm_mbx.yaml
```

## .axioenvs/application.modbus_tcp_slave/build/gcc-riscv32.debug/gen/Kconfig/Kconfig.component.EPC6450-AWI.device.hpm_multi_core_0
```kconfig
menuconfig DEV_MULTI_CORE
    bool "multi_core"
    default n
    visible if y
    select DRV_HPM_MULTI_CORE

    help
      Filename: "/dev/multi_core"

      dts_dev_prop:
          name(unit): "hpm_multi_core" (0)
          compatible: ['riscv,hpm_multi_core']
          dts_path: /soc/multi_core
          binding: D:\aworks_lp_hpm6450_general_sdk-0.9.1\platforms\platform-hpm-aworks-lp\components\aw_cpu_driver_hpm\dts\bindings\multi_core\riscv,hpm_multi_core.yaml
```

## .axioenvs/application.modbus_tcp_slave/build/gcc-riscv32.debug/gen/Kconfig/Kconfig.component.EPC6450-AWI.device.hpm_otp_0
```kconfig
menuconfig DEV_OTP
    bool "otp"
    default y
    visible if y
    select DRV_HPM_OTP

    help
      Filename: "/dev/otp"

      dts_dev_prop:
          name(unit): "hpm_otp" (0)
          compatible: ['riscv,hpm-otp']
          dts_path: /soc/otp@0xF40C8000
          binding: D:\aworks_lp_hpm6450_general_sdk-0.9.1\platforms\platform-hpm-aworks-lp\components\aw_cpu_driver_hpm\dts\bindings\otp\riscv,hpm-otp.yaml


if DEV_OTP

config DEV_OTP_WRITE_ENABLE
    bool "allow to write Fuse"
    default n

endif #DEV_OTP
```

## .axioenvs/application.modbus_tcp_slave/build/gcc-riscv32.debug/gen/Kconfig/Kconfig.component.EPC6450-AWI.device.hpm_ptmr_wkuptmr_0
```kconfig
menuconfig DEV_WKUPTMR
    bool "wkuptmr"
    default n
    visible if y
    select DRV_HPM_PTMR_WKUPTMR
    select DEV_PLIC0
    select DEV_PLIC0_INTERRUPT_RES_115
    select DEV_PLIC0_AWBL_INTCTLR_SERVICE

    help
      Filename: "/dev/wkuptmr"

      dts_dev_prop:
          name(unit): "hpm_ptmr_wkuptmr" (0)
          compatible: ['riscv,hpm_ptmr_wkuptmr']
          dts_path: /soc/wkuptmr@F40E0000
          binding: D:\aworks_lp_hpm6450_general_sdk-0.9.1\platforms\platform-hpm-aworks-lp\components\aw_cpu_driver_hpm\dts\bindings\ptmr\riscv,hpm_ptmr_wkuptmr.yaml
```

## .axioenvs/application.modbus_tcp_slave/build/gcc-riscv32.debug/gen/Kconfig/Kconfig.component.EPC6450-AWI.device.hpm_pwm_11
```kconfig
menuconfig DEV_PWM3_CHAN3
    bool "pwm3_chan3 @ pwm3"
    default n
    visible if y
    select DRV_HPM_PWM

    help
      Filename: "/dev/pwm3_chan3"

      dts_dev_prop:
          name(unit): "hpm_pwm" (11)
          compatible: ['riscv,hpm-pwm']
          dts_path: /soc/pwm@0xF0230000/pwm3_chan3@3
          binding: D:\aworks_lp_hpm6450_general_sdk-0.9.1\platforms\platform-hpm-aworks-lp\components\aw_cpu_driver_hpm\dts\bindings\pwm\riscv,hpm-pwm.yaml


if DEV_PWM3_CHAN3

config DEV_PWM3_CHAN3_PWM_DEFAULT_PERIOD_NS
    int "Default PWM period (ns)"
    default 2000000


config DEV_PWM3_CHAN3_PWM_DEFAULT_DUTY_NS
    int "Default PWM duty (ns)"
    default 1000000

endif #DEV_PWM3_CHAN3
```

## .axioenvs/application.modbus_tcp_slave/build/gcc-riscv32.debug/gen/Kconfig/Kconfig.component.EPC6450-AWI.device.hpm_pwm_15
```kconfig
menuconfig DEV_PWM3_CHAN7
    bool "pwm3_chan7 @ pwm3"
    default n
    visible if y
    select DRV_HPM_PWM

    help
      Filename: "/dev/pwm3_chan7"

      dts_dev_prop:
          name(unit): "hpm_pwm" (15)
          compatible: ['riscv,hpm-pwm']
          dts_path: /soc/pwm@0xF0230000/pwm3_chan7@7
          binding: D:\aworks_lp_hpm6450_general_sdk-0.9.1\platforms\platform-hpm-aworks-lp\components\aw_cpu_driver_hpm\dts\bindings\pwm\riscv,hpm-pwm.yaml


if DEV_PWM3_CHAN7

config DEV_PWM3_CHAN7_PWM_DEFAULT_PERIOD_NS
    int "Default PWM period (ns)"
    default 2000000


config DEV_PWM3_CHAN7_PWM_DEFAULT_DUTY_NS
    int "Default PWM duty (ns)"
    default 1000000

endif #DEV_PWM3_CHAN7
```

## .axioenvs/application.modbus_tcp_slave/build/gcc-riscv32.debug/gen/Kconfig/Kconfig.component.EPC6450-AWI.device.hpm_pwm_2
```kconfig
menuconfig DEV_PWM0_CHAN2
    bool "pwm0_chan2 @ pwm0"
    default n
    visible if y
    select DRV_HPM_PWM
    select DEV_PIN_1
    select DEV_PIN_1_PIN_RES_32
    select DEV_PIN_1_AWB_PIN_SERVICE

    help
      Filename: "/dev/pwm0_chan2"

      dts_dev_prop:
          name(unit): "hpm_pwm" (2)
          compatible: ['riscv,hpm-pwm']
          dts_path: /soc/pwm@0xF0200000/pwm0_chan2@2
          binding: D:\aworks_lp_hpm6450_general_sdk-0.9.1\platforms\platform-hpm-aworks-lp\components\aw_cpu_driver_hpm\dts\bindings\pwm\riscv,hpm-pwm.yaml


if DEV_PWM0_CHAN2

config DEV_PWM0_CHAN2_PWM_DEFAULT_PERIOD_NS
    int "Default PWM period (ns)"
    default 2000000


config DEV_PWM0_CHAN2_PWM_DEFAULT_DUTY_NS
    int "Default PWM duty (ns)"
    default 1000000


config DEV_PWM0_CHAN2_PWM_PAIR_ENABLE
    bool "pwm_pair_enable"
    default n
    help 
        When this option is enabled only as a complementary PWM device, the following configuration will take effect.


if DEV_PWM0_CHAN2_PWM_PAIR_ENABLE

config DEV_PWM0_CHAN2_PWM_PAIR_DEADTIME1
    int "Default pwm_pair deadtime1 (ns)"
    default 2
    range 0 1000000
    help 
        Default pwm_pair main deadtime (ns)


config DEV_PWM0_CHAN2_PWM_PAIR_DEADTIME2
    int "Default pwm_pair deadtime2 (ns)"
    default 2
    range 0 1000000
    help 
        Default pwm_pair complementary deadtime (ns)

endif #DEV_PWM0_CHAN2_PWM_PAIR_ENABLE

endif #DEV_PWM0_CHAN2
```

## .axioenvs/application.modbus_tcp_slave/build/gcc-riscv32.debug/gen/Kconfig/Kconfig.component.EPC6450-AWI.device.hpm_pwm_5
```kconfig
menuconfig DEV_PWM0_CHAN5
    bool "pwm0_chan5 @ pwm0"
    default n
    visible if y
    select DRV_HPM_PWM
    select DEV_PIN_1
    select DEV_PIN_1_PIN_RES_58
    select DEV_PIN_1_AWB_PIN_SERVICE

    help
      Filename: "/dev/pwm0_chan5"

      dts_dev_prop:
          name(unit): "hpm_pwm" (5)
          compatible: ['riscv,hpm-pwm']
          dts_path: /soc/pwm@0xF0200000/pwm0_chan5@5
          binding: D:\aworks_lp_hpm6450_general_sdk-0.9.1\platforms\platform-hpm-aworks-lp\components\aw_cpu_driver_hpm\dts\bindings\pwm\riscv,hpm-pwm.yaml


if DEV_PWM0_CHAN5

config DEV_PWM0_CHAN5_PWM_DEFAULT_PERIOD_NS
    int "Default PWM period (ns)"
    default 2000000


config DEV_PWM0_CHAN5_PWM_DEFAULT_DUTY_NS
    int "Default PWM duty (ns)"
    default 1000000

endif #DEV_PWM0_CHAN5
```
