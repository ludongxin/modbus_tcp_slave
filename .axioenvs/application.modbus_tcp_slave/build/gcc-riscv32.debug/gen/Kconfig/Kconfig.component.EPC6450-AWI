## .axioenvs/application.modbus_tcp_slave/build/gcc-riscv32.debug/gen/Kconfig/Kconfig.component.EPC6450-AWI
```kconfig
menuconfig EPC6450_AWI
    bool "Board EPC6450-AWI"
    libsafe 
    select BSP_HPM
    select AW_CPU_BASE_HPM645X_675X
    select AWB_COMMON_DRIVER
    select AW_BITMAP_ALLOCATOR
    select AW_API_NVRAM
    default n
    help
        Version: 0.1.0

        
if EPC6450_AWI


osource "$AW_BOARD_DEVICES_KCONFIG_MENU"

osource "$(topic_components, System::Board::Components)"
source "D:/aworks_lp_hpm6450_general_sdk-0.9.1/platforms/platform-hpm-aworks-lp/boards/EPC6450-AWI/Kconfig.opts"

endif #EPC6450_AWI
```

## .axioenvs/application.modbus_tcp_slave/build/gcc-riscv32.debug/gen/Kconfig/Kconfig.component.EPC6450-AWI.device.cyw43455_sdio_0
```kconfig
menuconfig DEV_CYW43455
    bool "cyw43455 @ sdio0"
    default n
    visible if y
    select DRV_CYW43455_SDIO
    select DEV_SDIO0
    select DEV_PIN_1
    select DEV_PIN_1_PIN_RES_121
    select DEV_PIN_1_AWB_PIN_SERVICE
    select DEV_PIN_1_PIN_RES_111

    help
      Filename: "/dev/cyw43455"

      dts_dev_prop:
          name(unit): "cyw43455_sdio" (0)
          compatible: ['cypress,cyw43455_sdio']
          dts_path: /soc/sdio@0xF2030000/cyw43455_sdio
          binding: D:\aworks_lp_hpm6450_general_sdk-0.9.1\frameworks\64cf32e2-aworks_lp\subsys\awb_common_driver\dts\bindings\cyw43xxx\cypress,cyw43455_sdio.yaml


if DEV_CYW43455

config DEV_CYW43455_SDIO_BUS_CLOCK_FREQUENCY
    int "Bus clock frequency"
    default 40000000
    range 100000 200000000


config DEV_CYW43455_WIFI_COUNTRY
    string "Country"
    default "AW_WIFI_COUNTRY_CHINA"
    enum
        "AW_WIFI_COUNTRY_CHINA"
        "AW_WIFI_COUNTRY_HONG_KONG"


config DEV_CYW43455_STA_NETIF_ENABLE
    bool "Enable STA network interface card"
    default y


config DEV_CYW43455_STA_SUPPORT_802_11_N
    bool "STA Interface supports 802.11n"
    default y


config DEV_CYW43455_STA_DHCP_EN
    bool "STA Enable DHCP"
    default n


config DEV_CYW43455_STA_IPADDR
    string "STA IP address"
    default "192.168.137.252"


config DEV_CYW43455_STA_NETMASK
    string "STA Netmask"
    default "255.255.255.0"


config DEV_CYW43455_STA_GATEWAY
    string "STA Gateway"
    default "192.168.137.1"


config DEV_CYW43455_AP_NETIF_ENABLE
    bool "Enable AP network interface card"
    default y


config DEV_CYW43455_AP_SUPPORT_802_11_N
    bool "AP Interface supports 802.11n"
    default y


config DEV_CYW43455_AP_DHCP_EN
    bool "AP Enable DHCP"
    default n


config DEV_CYW43455_AP_IPADDR
    string "AP IP address"
    default "192.168.138.1"


config DEV_CYW43455_AP_NETMASK
    string "AP Netmask"
    default "255.255.255.0"


config DEV_CYW43455_AP_GATEWAY
    string "AP Gateway"
    default "192.168.138.1"

endif #DEV_CYW43455
```

## .axioenvs/application.modbus_tcp_slave/build/gcc-riscv32.debug/gen/Kconfig/Kconfig.component.EPC6450-AWI.device.ft5x06_0
```kconfig
menuconfig DEV_FT5X06
    bool "ft5x06 @ i2c3"
    default n
    visible if y
    select DRV_FT5X06
    select DEV_I2C3
    select DEV_PIN_1
    select DEV_PIN_1_PIN_RES_130
    select DEV_PIN_1_AWB_PIN_SERVICE

    help
      Filename: "/dev/ft5x06"

      dts_dev_prop:
          name(unit): "ft5x06" (0)
          compatible: ['focaltech,ft5x06']
          dts_path: /soc/i2c@0xF302C000/ft5x06@0x38
          binding: D:\aworks_lp_hpm6450_general_sdk-0.9.1\frameworks\64cf32e2-aworks_lp\subsys\awb_common_driver\dts\bindings\touchscreen\ft5x06\focaltech,ft5x06.yaml


if DEV_FT5X06

config DEV_FT5X06_SWAP_XY_EN
    bool "swap x,y coordinate"
    default y

endif #DEV_FT5X06
```

## .axioenvs/application.modbus_tcp_slave/build/gcc-riscv32.debug/gen/Kconfig/Kconfig.component.EPC6450-AWI.device.general_zlg72128_spi_0
```kconfig
menuconfig DEV_ZLG72128
    bool "zlg72128 @ gpiospi0 #CS0"
    default n
    visible if y
    select DRV_GENERAL_ZLG72128_SPI
    select DEV_GPIOSPI0
    select DEV_PIN_1
    select DEV_PIN_1_PIN_RES_152
    select DEV_PIN_1_AWB_PIN_SERVICE
    select DEV_PIN_1_PIN_RES_160
    select DEV_GPIOSPI0_CHIPSELECT_0

    help
      Filename: "/dev/zlg72128"

      dts_dev_prop:
          name(unit): "general,zlg72128_spi" (0)
          compatible: ['zlg,zlg72128_spi']
          dts_path: /gpiospi_0/zlg72128@0x0
          binding: D:\aworks_lp_hpm6450_general_sdk-0.9.1\frameworks\64cf32e2-aworks_lp\subsys\awb_common_driver\dts\bindings\zlg72128\zlg,zlg72128_spi.yaml


if DEV_ZLG72128

config DEV_ZLG72128_IS_INT
    bool "interrupt pin trigger mode"
    default y


config DEV_ZLG72128_SPI_SPEED_HZ
    int "SPI host clock speed(Hz), spi_speed_hz <= 0.85*(sysclk/2)"
    default 2000000
    range 500000 20000000

endif #DEV_ZLG72128
```

## .axioenvs/application.modbus_tcp_slave/build/gcc-riscv32.debug/gen/Kconfig/Kconfig.component.EPC6450-AWI.device.gt911_0
```kconfig
menuconfig DEV_GT911
    bool "gt911 @ i2c3"
    default n
    visible if y
    select DRV_GT911
    select DEV_I2C3
    select DEV_PIN_1
    select DEV_PIN_1_PIN_RES_130
    select DEV_PIN_1_AWB_PIN_SERVICE
    select DEV_PIN_1_PIN_RES_129

    help
      Filename: "/dev/gt911"

      dts_dev_prop:
          name(unit): "gt911" (0)
          compatible: ['goodix,gt911']
          dts_path: /soc/i2c@0xF302C000/gt911@5d
          binding: D:\aworks_lp_hpm6450_general_sdk-0.9.1\frameworks\64cf32e2-aworks_lp\subsys\awb_common_driver\dts\bindings\touchscreen\gt911\goodix,gt911_ts.yaml
```

## .axioenvs/application.modbus_tcp_slave/build/gcc-riscv32.debug/gen/Kconfig/Kconfig.component.EPC6450-AWI.device.hpm_adc12_1
```kconfig
menuconfig DEV_ADC1
    bool "adc1"
    default n
    visible if y
    select DRV_HPM_ADC12
    select DEV_PLIC0
    select DEV_PLIC0_INTERRUPT_RES_20
    select DEV_PLIC0_AWBL_INTCTLR_SERVICE

    help
      Filename: "/dev/adc1"

      dts_dev_prop:
          name(unit): "hpm_adc12" (1)
          compatible: ['riscv,hpm-adc12']
          dts_path: /soc/adc12@0xF0014000
          binding: D:\aworks_lp_hpm6450_general_sdk-0.9.1\platforms\platform-hpm-aworks-lp\components\aw_cpu_driver_hpm\dts\bindings\adc12\riscv,hpm_adc12.yaml


if DEV_ADC1

config DEV_ADC1_BITS
    string "Set adc12 Resolution"
    default "ADC12_SELRES_12"
    enum
        "ADC12_SELRES_12"
        "ADC12_SELRES_10"
        "ADC12_SELRES_8"
        "ADC12_SELRES_6"


config DEV_ADC1_CONV_MODE
    string "Set adc12 conversion modes"
    default "ADC12_CONV_MODE_SEQUENCE"
    enum
        "ADC12_CONV_MODE_ONESHOT"
        "ADC12_CONV_MODE_PERIOD"
        "ADC12_CONV_MODE_SEQUENCE"


config DEV_ADC1_PERIOD_US
    int "the period conversion time (unit:us)"
    default 100


config DEV_ADC1_VREFH
    int "high lever of reference voltage"
    default 3300


config DEV_ADC1_AWB_ADC_SERVICE
    def_bool y

if DEV_ADC1_AWB_ADC_SERVICE
config DEV_ADC1_ADC_RES_0
    bool "adc1_ch0 (19)"
    default n
    select DEV_PIN_1
    select DEV_PIN_1_AWB_PIN_SERVICE
    select DEV_PIN_1_PIN_RES_142

if DEV_ADC1_ADC_RES_0

config DEV_ADC1_ADC1_CH0_IS_DIFF_SEL
    bool "enable differential mode"
    default n

endif #DEV_ADC1_ADC_RES_0
config DEV_ADC1_ADC_RES_1
    bool "adc1_ch1 (20)"
    default n
    select DEV_PIN_1
    select DEV_PIN_1_AWB_PIN_SERVICE
    select DEV_PIN_1_PIN_RES_143

if DEV_ADC1_ADC_RES_1

config DEV_ADC1_ADC1_CH1_IS_DIFF_SEL
    bool "enable differential mode"
    default n

endif #DEV_ADC1_ADC_RES_1
config DEV_ADC1_ADC_RES_2
    bool "adc1_ch2 (21)"
    default n
    select DEV_PIN_1
    select DEV_PIN_1_AWB_PIN_SERVICE
    select DEV_PIN_1_PIN_RES_144

if DEV_ADC1_ADC_RES_2

config DEV_ADC1_ADC1_CH2_IS_DIFF_SEL
    bool "enable differential mode"
    default n

endif #DEV_ADC1_ADC_RES_2
config DEV_ADC1_ADC_RES_3
    bool "adc1_ch3 (22)"
    default n
    select DEV_PIN_1
    select DEV_PIN_1_AWB_PIN_SERVICE
    select DEV_PIN_1_PIN_RES_145

if DEV_ADC1_ADC_RES_3

config DEV_ADC1_ADC1_CH3_IS_DIFF_SEL
    bool "enable differential mode"
    default n

endif #DEV_ADC1_ADC_RES_3
config DEV_ADC1_ADC_RES_4
    bool "adc1_ch4 (23)"
    default n
    select DEV_PIN_1
    select DEV_PIN_1_AWB_PIN_SERVICE
    select DEV_PIN_1_PIN_RES_146

if DEV_ADC1_ADC_RES_4

config DEV_ADC1_ADC1_CH4_IS_DIFF_SEL
    bool "enable differential mode"
    default n

endif #DEV_ADC1_ADC_RES_4
config DEV_ADC1_ADC_RES_5
    bool "adc1_ch5 (24)"
    default n
    select DEV_PIN_1
    select DEV_PIN_1_AWB_PIN_SERVICE
    select DEV_PIN_1_PIN_RES_147

if DEV_ADC1_ADC_RES_5

config DEV_ADC1_ADC1_CH5_IS_DIFF_SEL
    bool "enable differential mode"
    default n

endif #DEV_ADC1_ADC_RES_5
config DEV_ADC1_ADC_RES_6
    bool "adc1_ch6 (25)"
    default n
    select DEV_PIN_1
    select DEV_PIN_1_AWB_PIN_SERVICE
    select DEV_PIN_1_PIN_RES_148

if DEV_ADC1_ADC_RES_6

config DEV_ADC1_ADC1_CH6_IS_DIFF_SEL
    bool "enable differential mode"
    default n

endif #DEV_ADC1_ADC_RES_6
config DEV_ADC1_ADC_RES_7
    bool "adc1_ch7 (26)"
    default n
    select DEV_PIN_1
    select DEV_PIN_1_AWB_PIN_SERVICE
    select DEV_PIN_1_PIN_RES_149

if DEV_ADC1_ADC_RES_7

config DEV_ADC1_ADC1_CH7_IS_DIFF_SEL
    bool "enable differential mode"
    default n

endif #DEV_ADC1_ADC_RES_7
config DEV_ADC1_ADC_RES_8
    bool "adc1_ch8 (27)"
    default n
    select DEV_PIN_1
    select DEV_PIN_1_AWB_PIN_SERVICE
    select DEV_PIN_1_PIN_RES_150

if DEV_ADC1_ADC_RES_8

config DEV_ADC1_ADC1_CH8_IS_DIFF_SEL
    bool "enable differential mode"
    default n

endif #DEV_ADC1_ADC_RES_8
config DEV_ADC1_ADC_RES_9
    bool "adc1_ch9 (28)"
    default n
    select DEV_PIN_1
    select DEV_PIN_1_AWB_PIN_SERVICE
    select DEV_PIN_1_PIN_RES_151

if DEV_ADC1_ADC_RES_9

config DEV_ADC1_ADC1_CH9_IS_DIFF_SEL
    bool "enable differential mode"
    default n

endif #DEV_ADC1_ADC_RES_9
config DEV_ADC1_ADC_RES_10
    bool "adc1_ch10 (29)"
    default n
    select DEV_PIN_1
    select DEV_PIN_1_AWB_PIN_SERVICE
    select DEV_PIN_1_PIN_RES_152

if DEV_ADC1_ADC_RES_10

config DEV_ADC1_ADC1_CH10_IS_DIFF_SEL
    bool "enable differential mode"
    default n

endif #DEV_ADC1_ADC_RES_10
config DEV_ADC1_ADC_RES_11
    bool "adc1_ch11 (30)"
    default n
    select DEV_PIN_1
    select DEV_PIN_1_AWB_PIN_SERVICE
    select DEV_PIN_1_PIN_RES_153

if DEV_ADC1_ADC_RES_11

config DEV_ADC1_ADC1_CH11_IS_DIFF_SEL
    bool "enable differential mode"
    default n

endif #DEV_ADC1_ADC_RES_11
config DEV_ADC1_ADC_RES_12
    bool "adc1_ch12 (31)"
    default n
    select DEV_PIN_1
    select DEV_PIN_1_AWB_PIN_SERVICE
    select DEV_PIN_1_PIN_RES_158

if DEV_ADC1_ADC_RES_12

config DEV_ADC1_ADC1_CH12_IS_DIFF_SEL
    bool "enable differential mode"
    default n

endif #DEV_ADC1_ADC_RES_12
config DEV_ADC1_ADC_RES_13
    bool "adc1_ch13 (32)"
    default n
    select DEV_PIN_1
    select DEV_PIN_1_AWB_PIN_SERVICE
    select DEV_PIN_1_PIN_RES_159

if DEV_ADC1_ADC_RES_13

config DEV_ADC1_ADC1_CH13_IS_DIFF_SEL
    bool "enable differential mode"
    default n

endif #DEV_ADC1_ADC_RES_13
config DEV_ADC1_ADC_RES_14
    bool "adc1_ch14 (33)"
    default n
    select DEV_PIN_1
    select DEV_PIN_1_AWB_PIN_SERVICE
    select DEV_PIN_1_PIN_RES_160

if DEV_ADC1_ADC_RES_14

config DEV_ADC1_ADC1_CH14_IS_DIFF_SEL
    bool "enable differential mode"
    default n

endif #DEV_ADC1_ADC_RES_14
config DEV_ADC1_ADC_RES_15
    bool "adc1_ch15 (34)"
    default n
    select DEV_PIN_1
    select DEV_PIN_1_AWB_PIN_SERVICE
    select DEV_PIN_1_PIN_RES_161

if DEV_ADC1_ADC_RES_15

config DEV_ADC1_ADC1_CH15_IS_DIFF_SEL
    bool "enable differential mode"
    default n

endif #DEV_ADC1_ADC_RES_15
config DEV_ADC1_ADC_RES_16
    bool "adc1_ch16 (35)"
    default n
    select DEV_PIN_1
    select DEV_PIN_1_AWB_PIN_SERVICE
    select DEV_PIN_1_PIN_RES_162

if DEV_ADC1_ADC_RES_16

config DEV_ADC1_ADC1_CH16_IS_DIFF_SEL
    bool "enable differential mode"
    default n

endif #DEV_ADC1_ADC_RES_16
config DEV_ADC1_ADC_RES_17
    bool "adc1_ch17 (36)"
    default n
    select DEV_PIN_1
    select DEV_PIN_1_AWB_PIN_SERVICE
    select DEV_PIN_1_PIN_RES_164

if DEV_ADC1_ADC_RES_17

config DEV_ADC1_ADC1_CH17_IS_DIFF_SEL
    bool "enable differential mode"
    default n

endif #DEV_ADC1_ADC_RES_17
config DEV_ADC1_ADC_RES_18
    bool "adc1_ch18 (37)"
    default n


if DEV_ADC1_ADC_RES_18

config DEV_ADC1_ADC1_CH18_IS_DIFF_SEL
    bool "enable differential mode"
    default n

endif #DEV_ADC1_ADC_RES_18
endif # DEV_ADC1_AWB_ADC_SERVICE

endif #DEV_ADC1
```

## .axioenvs/application.modbus_tcp_slave/build/gcc-riscv32.debug/gen/Kconfig/Kconfig.component.EPC6450-AWI.device.hpm_adc16_0
```kconfig
menuconfig DEV_ADC3
    bool "adc3"
    default n
    visible if y
    select DRV_HPM_ADC16
    select DEV_PLIC0
    select DEV_PLIC0_INTERRUPT_RES_22
    select DEV_PLIC0_AWBL_INTCTLR_SERVICE

    help
      Filename: "/dev/adc3"

      dts_dev_prop:
          name(unit): "hpm_adc16" (0)
          compatible: ['riscv,hpm-adc16']
          dts_path: /soc/adc16@0xF001C000
          binding: D:\aworks_lp_hpm6450_general_sdk-0.9.1\platforms\platform-hpm-aworks-lp\components\aw_cpu_driver_hpm\dts\bindings\adc16\riscv,hpm_adc16.yaml


if DEV_ADC3

config DEV_ADC3_CONV_MODE
    string "Set adc16 conversion modes"
    default "ADC16_CONV_MODE_SEQUENCE"
    enum
        "ADC16_CONV_MODE_ONESHOT"
        "ADC16_CONV_MODE_PERIOD"
        "ADC16_CONV_MODE_SEQUENCE"


config DEV_ADC3_PERIOD_US
    int "the period conversion time (unit:us)"
    default 100


config DEV_ADC3_VREFH
    int "high lever of reference voltage"
    default 3300


config DEV_ADC3_AWB_ADC_SERVICE
    def_bool y

if DEV_ADC3_AWB_ADC_SERVICE
config DEV_ADC3_ADC_RES_0
    bool "adc3_ch0 (57)"
    default n
    select DEV_PIN_1
    select DEV_PIN_1_AWB_PIN_SERVICE
    select DEV_PIN_1_PIN_RES_147

if DEV_ADC3_ADC_RES_0

endif #DEV_ADC3_ADC_RES_0
config DEV_ADC3_ADC_RES_1
    bool "adc3_ch1 (58)"
    default n
    select DEV_PIN_1
    select DEV_PIN_1_AWB_PIN_SERVICE
    select DEV_PIN_1_PIN_RES_155

if DEV_ADC3_ADC_RES_1

endif #DEV_ADC3_ADC_RES_1
config DEV_ADC3_ADC_RES_2
    bool "adc3_ch2 (59)"
    default n
    select DEV_PIN_1
    select DEV_PIN_1_AWB_PIN_SERVICE
    select DEV_PIN_1_PIN_RES_157

if DEV_ADC3_ADC_RES_2

endif #DEV_ADC3_ADC_RES_2
config DEV_ADC3_ADC_RES_3
    bool "adc3_ch3 (60)"
    default n
    select DEV_PIN_1
    select DEV_PIN_1_AWB_PIN_SERVICE
    select DEV_PIN_1_PIN_RES_163

if DEV_ADC3_ADC_RES_3

endif #DEV_ADC3_ADC_RES_3
config DEV_ADC3_ADC_RES_4
    bool "adc3_ch4 (61)"
    default n
    select DEV_PIN_1
    select DEV_PIN_1_AWB_PIN_SERVICE
    select DEV_PIN_1_PIN_RES_165

if DEV_ADC3_ADC_RES_4

endif #DEV_ADC3_ADC_RES_4
config DEV_ADC3_ADC_RES_5
    bool "adc3_ch5 (62)"
    default n
    select DEV_PIN_1
    select DEV_PIN_1_AWB_PIN_SERVICE
    select DEV_PIN_1_PIN_RES_167

if DEV_ADC3_ADC_RES_5

endif #DEV_ADC3_ADC_RES_5
config DEV_ADC3_ADC_RES_6
    bool "adc3_ch6 (63)"
    default n
    select DEV_PIN_1
    select DEV_PIN_1_AWB_PIN_SERVICE
    select DEV_PIN_1_PIN_RES_169

if DEV_ADC3_ADC_RES_6

endif #DEV_ADC3_ADC_RES_6
config DEV_ADC3_ADC_RES_7
    bool "adc3_ch7 (64)"
    default n
    select DEV_PIN_1
    select DEV_PIN_1_AWB_PIN_SERVICE
    select DEV_PIN_1_PIN_RES_170

if DEV_ADC3_ADC_RES_7

endif #DEV_ADC3_ADC_RES_7
endif # DEV_ADC3_AWB_ADC_SERVICE

endif #DEV_ADC3
```
