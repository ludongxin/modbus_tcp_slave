## .axioenvs/application.modbus_tcp_slave/build/gcc-riscv32.debug/gen/Kconfig/Kconfig.component.aw_sntp_app
```kconfig
menuconfig AW_SNTP_APP
    bool "SNTP App"
    libsafe 
    select AW_API_TIME
    select AW_DEV_API
    select COMPILER_SUPPORT_LIBC_TIME
    default n
    help
        Version: 0.0.0

        Detail:SNTP App supports for IPv4
if AW_SNTP_APP

source "D:/aworks_lp_hpm6450_general_sdk-0.9.1/frameworks/64cf32e2-aworks_lp/app/applications/aw_sntp_app/Kconfig.opts"

endif #AW_SNTP_APP
```

## .axioenvs/application.modbus_tcp_slave/build/gcc-riscv32.debug/gen/Kconfig/Kconfig.component.aw_socket_iodev
```kconfig
menuconfig AW_SOCKET_IODEV
    bool "AWorks socket iodev"
    libsafe 
    select AW_IO_BASE
    default n
    help
        Version: 0.0.0

        
```

## .axioenvs/application.modbus_tcp_slave/build/gcc-riscv32.debug/gen/Kconfig/Kconfig.component.aw_sqlite3_adapter
```kconfig
menuconfig AW_SQLITE3_ADAPTER
    bool "AWorks SQlite3 Adapter"
    libsafe 
    select AW_API_TIME
    default n
    help
        Version: 1.0.7

        
```

## .axioenvs/application.modbus_tcp_slave/build/gcc-riscv32.debug/gen/Kconfig/Kconfig.component.aw_stdlib
```kconfig
menuconfig AW_STDLIB
    bool "AWorks stdlib functions"
    libsafe 
    select AW_CTYPE
    default n
    help
        Version: 0.0.0

        
```

## .axioenvs/application.modbus_tcp_slave/build/gcc-riscv32.debug/gen/Kconfig/Kconfig.component.aw_subsys_awsa_pcm
```kconfig
menuconfig AW_SUBSYS_AWSA_PCM
    bool "Subsys for awsa pcm"
    libsafe 
    select AW_COMMON_IOCTL_CODE
    select AWB_FS_DEVFS
    default n
    help
        Version: 0.0.0

        
```

## .axioenvs/application.modbus_tcp_slave/build/gcc-riscv32.debug/gen/Kconfig/Kconfig.component.aw_subsys_driver_adc
```kconfig
menuconfig AW_SUBSYS_DRIVER_ADC
    bool "Subsys for adc device"
    libsafe 
    select AW_MEM_MANAGER_RINGBUFFER
    select AWBUS
    select AW_COMMON_IOCTL_CODE
    select AWB_FS_DEVFS
    default n
    help
        Version: 0.0.0

        
```

## .axioenvs/application.modbus_tcp_slave/build/gcc-riscv32.debug/gen/Kconfig/Kconfig.component.aw_subsys_driver_display
```kconfig
menuconfig AW_SUBSYS_DRIVER_DISPLAY
    bool "Subsys for display"
    libsafe 
    select AW_COMMON_IOCTL_CODE
    select AWB_FS_DEVFS
    select AW_INTERFACE
    select AW_BITMAP_ALLOCATOR
    default n
    help
        Version: 0.0.0

        
```

## .axioenvs/application.modbus_tcp_slave/build/gcc-riscv32.debug/gen/Kconfig/Kconfig.component.aw_subsys_driver_hwtimer
```kconfig
menuconfig AW_SUBSYS_DRIVER_HWTIMER
    bool "Subsys for hwtimer"
    libsafe 
    select AW_COMMON_IOCTL_CODE
    select AWB_FS_DEVFS
    select AW_MEM_MANAGER_RINGBUFFER
    default n
    help
        Version: 0.0.0

        
```

## .axioenvs/application.modbus_tcp_slave/build/gcc-riscv32.debug/gen/Kconfig/Kconfig.component.aw_subsys_driver_hwtimer_count
```kconfig
menuconfig AW_SUBSYS_DRIVER_HWTIMER_COUNT
    bool "Subsys for hwtimer count"
    libsafe 
    select AW_COMMON_IOCTL_CODE
    select AWB_FS_DEVFS
    default n
    help
        Version: 0.0.0

        
```

## .axioenvs/application.modbus_tcp_slave/build/gcc-riscv32.debug/gen/Kconfig/Kconfig.component.aw_subsys_driver_hwwdog
```kconfig
menuconfig AW_SUBSYS_DRIVER_HWWDOG
    bool "Subsys for hardware watchdog"
    libsafe 
    select AW_COMMON_IOCTL_CODE
    select AWB_FS_DEVFS
    default n
    help
        Version: 0.0.0

        
```

## .axioenvs/application.modbus_tcp_slave/build/gcc-riscv32.debug/gen/Kconfig/Kconfig.component.aw_subsys_driver_input
```kconfig
menuconfig AW_SUBSYS_DRIVER_INPUT
    bool "Subsys for input device"
    libsafe 
    select AW_COMMON_IOCTL_CODE
    select AW_MEM_MANAGER_RINGBUFFER
    select AW_OS_ISR_DEFER
    default n
    help
        Version: 0.0.0

        
if AW_SUBSYS_DRIVER_INPUT

source "D:/aworks_lp_hpm6450_general_sdk-0.9.1/frameworks/64cf32e2-aworks_lp/subsys/aw_subsys_driver_input/Kconfig.opts"

endif #AW_SUBSYS_DRIVER_INPUT
```

## .axioenvs/application.modbus_tcp_slave/build/gcc-riscv32.debug/gen/Kconfig/Kconfig.component.aw_subsys_driver_led
```kconfig
menuconfig AW_SUBSYS_DRIVER_LED
    bool "Subsys for led"
    libsafe 
    select AW_COMMON_IOCTL_CODE
    select AWB_FS_DEVFS
    default n
    help
        Version: 0.0.0

        
```

## .axioenvs/application.modbus_tcp_slave/build/gcc-riscv32.debug/gen/Kconfig/Kconfig.component.aw_subsys_driver_mii
```kconfig
menuconfig AW_SUBSYS_DRIVER_MII
    bool "Subsys for ethernet mii bus"
    libsafe 
    select AW_COMMON_IOCTL_CODE
    select AWB_SUBSYS_NETIF
    select AWBUS
    default n
    help
        Version: 0.0.0

        
```

## .axioenvs/application.modbus_tcp_slave/build/gcc-riscv32.debug/gen/Kconfig/Kconfig.component.aw_subsys_driver_phy_poll
```kconfig
menuconfig AW_SUBSYS_DRIVER_PHY_POLL
    bool "Subsys for ethernet poll phy"
    libsafe 
    select AW_SUBSYS_DRIVER_MII
    default n
    help
        Version: 0.0.0

        
if AW_SUBSYS_DRIVER_PHY_POLL

source "D:/aworks_lp_hpm6450_general_sdk-0.9.1/frameworks/64cf32e2-aworks_lp/subsys/aw_subsys_driver_phy_poll/Kconfig.opts"

endif #AW_SUBSYS_DRIVER_PHY_POLL
```

## .axioenvs/application.modbus_tcp_slave/build/gcc-riscv32.debug/gen/Kconfig/Kconfig.component.aw_subsys_driver_pwm
```kconfig
menuconfig AW_SUBSYS_DRIVER_PWM
    bool "Subsys for pwm"
    libsafe 
    select AW_COMMON_IOCTL_CODE
    select AWB_FS_DEVFS
    select AWBUS_DEV_REF_CHILD_EN
    default n
    help
        Version: 0.0.0

        
```

## .axioenvs/application.modbus_tcp_slave/build/gcc-riscv32.debug/gen/Kconfig/Kconfig.component.aw_subsys_driver_serial
```kconfig
menuconfig AW_SUBSYS_DRIVER_SERIAL
    bool "Subsys for serial device"
    libsafe 
    select AW_MEM_MANAGER_RINGBUFFER
    select AW_COMMON_IOCTL_CODE
    select AWB_FS_DEVFS
    select AWB_PM_NOTIFY
    default n
    help
        Version: 0.0.0

        
if AW_SUBSYS_DRIVER_SERIAL

source "D:/aworks_lp_hpm6450_general_sdk-0.9.1/frameworks/64cf32e2-aworks_lp/subsys/aw_subsys_driver_serial/Kconfig.opts"

endif #AW_SUBSYS_DRIVER_SERIAL
```

## .axioenvs/application.modbus_tcp_slave/build/gcc-riscv32.debug/gen/Kconfig/Kconfig.component.aw_subsys_driver_spi
```kconfig
menuconfig AW_SUBSYS_DRIVER_SPI
    bool "Subsys for spi master device"
    libsafe 
    select AW_COMMON_IOCTL_CODE
    select AWB_FS_DEVFS
    select AWBUS
    default n
    help
        Version: 0.0.0

        
if AW_SUBSYS_DRIVER_SPI

source "D:/aworks_lp_hpm6450_general_sdk-0.9.1/frameworks/64cf32e2-aworks_lp/subsys/aw_subsys_driver_spi/Kconfig.opts"

endif #AW_SUBSYS_DRIVER_SPI
```

## .axioenvs/application.modbus_tcp_slave/build/gcc-riscv32.debug/gen/Kconfig/Kconfig.component.aw_subsys_driver_spiex
```kconfig
menuconfig AW_SUBSYS_DRIVER_SPIEX
    bool "Subsys for spiex master device"
    libsafe 
    select AWBUS
    default n
    help
        Version: 0.0.0

        
```

## .axioenvs/application.modbus_tcp_slave/build/gcc-riscv32.debug/gen/Kconfig/Kconfig.component.aw_subsys_driver_wifi
```kconfig
menuconfig AW_SUBSYS_DRIVER_WIFI
    bool "Subsys for wifi"
    libsafe 
    select AW_COMMON_IOCTL_CODE
    select AWB_FS_DEVFS
    select AW_INTERFACE
    default n
    help
        Version: 0.0.0

        
```

## .axioenvs/application.modbus_tcp_slave/build/gcc-riscv32.debug/gen/Kconfig/Kconfig.component.aw_subsys_driver_xip_flash
```kconfig
menuconfig AW_SUBSYS_DRIVER_XIP_FLASH
    bool "Subsys for XIP Flash"
    libsafe 
    select AW_SUBSYS_DRIVER_MTD
    default n
    help
        Version: 0.0.0

        
if AW_SUBSYS_DRIVER_XIP_FLASH

source "D:/aworks_lp_hpm6450_general_sdk-0.9.1/frameworks/64cf32e2-aworks_lp/subsys/aw_subsys_driver_xip_flash/Kconfig.opts"

endif #AW_SUBSYS_DRIVER_XIP_FLASH
```

## .axioenvs/application.modbus_tcp_slave/build/gcc-riscv32.debug/gen/Kconfig/Kconfig.component.aw_subsys_system_intctlr
```kconfig
menuconfig AW_SUBSYS_SYSTEM_INTCTLR
    bool "Subsys for interrupt controler"
    libsafe 
    default n
    help
        Version: 0.0.0

        
```

## .axioenvs/application.modbus_tcp_slave/build/gcc-riscv32.debug/gen/Kconfig/Kconfig.component.aw_subsys_system_pin
```kconfig
menuconfig AW_SUBSYS_SYSTEM_PIN
    bool "component aw_subsys_system_pin"
    libsafe 
    default n
    help
        Version: 0.0.0

        
```

## .axioenvs/application.modbus_tcp_slave/build/gcc-riscv32.debug/gen/Kconfig/Kconfig.component.aw_subsys_usb
```kconfig
menuconfig AW_SUBSYS_USB
    bool "Subsys for usb"
    libsafe 
    select AW_STDIO
    select AWBUS
    select AW_INTERFACE
    select AW_MEM_MANAGER_MEM_HEAP
    select AW_DEV_API
    select AW_OS_DELAYED_WORK
    select AWB_FS_DEVFS
    default n
    help
        Version: 0.0.0

        
if AW_SUBSYS_USB

source "D:/aworks_lp_hpm6450_general_sdk-0.9.1/frameworks/64cf32e2-aworks_lp/subsys/aw_subsys_driver_usb/Kconfig.opts"

endif #AW_SUBSYS_USB
```

## .axioenvs/application.modbus_tcp_slave/build/gcc-riscv32.debug/gen/Kconfig/Kconfig.component.aw_sys_define_socket
```kconfig
menuconfig AW_SYS_DEFINE_SOCKET
    bool "AWorks Sockets Base"
    libsafe 
    select AW_INTERFACE
    default n
    help
        Version: 0.0.0

        
```

## .axioenvs/application.modbus_tcp_slave/build/gcc-riscv32.debug/gen/Kconfig/Kconfig.component.aw_tencentcloud
```kconfig
menuconfig AW_TENCENTCLOUD
    bool "component aw_tencentcloud"
    libsafe 
    select AW_TENCENTCLOUD_ADAPTER
    default n
    help
        Version: 0.1.0

        
```
