## .axioenvs/application.modbus_tcp_slave/build/gcc-riscv32.debug/gen/Kconfig/Kconfig.component.goahead
```kconfig
menuconfig GOAHEAD
    bool "GoAhead"
    libsafe 
    select MBEDTLS
    default n
    help
        Version: 5.2.1

        
if GOAHEAD


osource  "$(ax_imp_paths,goahead_adapter_interface,,False)"

endif #GOAHEAD
```

## .axioenvs/application.modbus_tcp_slave/build/gcc-riscv32.debug/gen/Kconfig/Kconfig.component.iec61850
```kconfig
menuconfig IEC61850
    bool "Official repository for libIEC61850"
    libsafe 
    default n
    help
        Version: 1.5.1+beta0

        
if IEC61850


osource  "$(ax_imp_paths,iec61850_adapter_interface,,False)"

endif #IEC61850
```

## .axioenvs/application.modbus_tcp_slave/build/gcc-riscv32.debug/gen/Kconfig/Kconfig.component.libjpeg_turbo
```kconfig
menuconfig LIBJPEG_TURBO
    bool "libjpeg-turbo"
    libsafe 
    default n
    help
        Version: 3.0.0

        
if LIBJPEG_TURBO


osource  "$(ax_imp_paths,aw_libjpeg_turbo_adapter_interface,,False)"

endif #LIBJPEG_TURBO
```

## .axioenvs/application.modbus_tcp_slave/build/gcc-riscv32.debug/gen/Kconfig/Kconfig.component.lwip2_x_adapter
```kconfig
menuconfig LWIP2_X_ADAPTER
    bool "lwip 2.1.x adapter"
    libsafe 
    select LWIP2_1_X
    select AW_STDLIB
    select AW_ERR_TO_ERRNO
    default n
    help
        Version: 0.0.0

        
if LWIP2_X_ADAPTER

source "D:/aworks_lp_hpm6450_general_sdk-0.9.1/frameworks/64cf32e2-aworks_lp/net/lwip2.x_adapter/Kconfig.opts"

endif #LWIP2_X_ADAPTER
```

## .axioenvs/application.modbus_tcp_slave/build/gcc-riscv32.debug/gen/Kconfig/Kconfig.component.modbus_tcp_slave
```kconfig
menuconfig MODBUS_TCP_SLAVE
    bool "application modbus_tcp_slave"
    libsafe 
    select AW_MODBUS
    select AW_MODBUS_ADAPTER
    default n
    help
        Version: 0.0.0

        
if MODBUS_TCP_SLAVE

source "D:/aworks_lp_hpm6450_general_sdk-0.9.1/demos/component/modbus/modbus_tcp_slave/Kconfig.opts"

endif #MODBUS_TCP_SLAVE

if MODBUS_TCP_SLAVE
    config AW_IMG_PRJ_BUILD
        def_bool y
endif#MODBUS_TCP_SLAVE
```

## .axioenvs/application.modbus_tcp_slave/build/gcc-riscv32.debug/gen/Kconfig/Kconfig.component.openamp
```kconfig
menuconfig OPENAMP
    bool "OpenAMP"
    libsafe 
    default n
    help
        Version: 0.1.7

        
if OPENAMP

source "D:/aworks_lp_hpm6450_general_sdk-0.9.1/components/openamp/Kconfig.opts"

endif #OPENAMP
```

## .axioenvs/application.modbus_tcp_slave/build/gcc-riscv32.debug/gen/Kconfig/Kconfig.component.platform-hpm-aworks-lp
```kconfig
menuconfig PLATFORM_HPM_AWORKS_LP
    bool "HPM Platform"
    libsafe 
    select AW_CPU_DRIVER_HPM
    select RTK_ARCH_RISC_V
    select RISCV_KERNEL_INTERRUPT_SUPPORT
    select RISCV_FENCE_INSTRUCTION_SUPPORT
    default n
    help
        Version: 0.1.13

        
if PLATFORM_HPM_AWORKS_LP


osource "$AW_PLATFORM_DEVICES_KCONFIG_MENU"

osource "$(topic_components, System::Platform::Components)"


endif #PLATFORM_HPM_AWORKS_LP
```

## .axioenvs/application.modbus_tcp_slave/build/gcc-riscv32.debug/gen/Kconfig/Kconfig.component.rpc-protobufc
```kconfig
menuconfig RPC_PROTOBUFC
    bool "an implementation of rpc based on protobuf"
    libsafe 
    select PROTOBUFC
    default n
    help
        Version: 0.1.1

        
```

## .axioenvs/application.modbus_tcp_slave/build/gcc-riscv32.debug/gen/Kconfig/Kconfig.component.rtk
```kconfig
menuconfig RTK
    bool "RTK Real-Time Kernel"
    libsafe 
    select AWORKS_BASE
    default n
    help
        Version: 0.0.0

        
if RTK

source "D:/aworks_lp_hpm6450_general_sdk-0.9.1/frameworks/64cf32e2-aworks_lp/kernel/rtk/Kconfig.opts"

endif #RTK
```

## .axioenvs/application.modbus_tcp_slave/build/gcc-riscv32.debug/gen/Kconfig/Kconfig.component.sqlite3
```kconfig
menuconfig SQLITE3
    bool "SQlite3"
    libsafe 
    default n
    help
        Version: 1.1.3

        
if SQLITE3


osource  "$(ax_imp_paths,sqlite3_adapter_interface,,False)"

endif #SQLITE3
```

## .axioenvs/application.modbus_tcp_slave/build/gcc-riscv32.debug/gen/Kconfig/Kconfig.component.stack_protector_by_gcc
```kconfig
menuconfig STACK_PROTECTOR_BY_GCC
    bool "Stack protection supported for GCC"
    libsafe 
    select AW_INTERFACE
    default n
    help
        Version: 0.0.0

        
```

## .axioenvs/application.modbus_tcp_slave/build/gcc-riscv32.debug/gen/Kconfig/Kconfig.component.tkc
```kconfig
menuconfig TKC
    bool "cross-platform universal c library toolkit"
    libsafe 
    select AW_COMPILER_COMMON_POSIX_SOCKET
    select AW_IO_BASE
    select AW_DEV_API
    default n
    help
        Version: 0.2.2

        
if TKC

source "D:/aworks_lp_hpm6450_general_sdk-0.9.1/components/tkc/Kconfig.opts"

endif #TKC
```

## .axioenvs/application.modbus_tcp_slave/build/gcc-riscv32.debug/gen/Kconfig/Kconfig.component.wolfssh
```kconfig
menuconfig WOLFSSH
    bool "wolfssh"
    libsafe 
    select WOLFSSL
    select COMPILER_SUPPORT_POSIX_SOCKET
    select COMPILER_SUPPORT_POSIX_FILE
    select COMPILER_SUPPORT_LIBC_TIME
    select COMPILER_SUPPORT_STDIO
    select AW_IO_DIR
    default n
    help
        Version: 1.4.12

        Detail:help

          The wolfSSH library is a lightweight SSHv2 client and server library written

        in ANSI C and targeted for embedded, RTOS, and resource-constrained environments

        - primarily because of its small size, speed, and feature set.

        

        Source Code Version: wolfSSH v1.4.12
```

## .axioenvs/application.modbus_tcp_slave/build/gcc-riscv32.debug/gen/Kconfig/Kconfig.component.wolfssl
```kconfig
menuconfig WOLFSSL
    bool "wolfssl"
    libsafe 
    select COMPILER_SUPPORT_POSIX_SOCKET
    select COMPILER_SUPPORT_POSIX_FILE
    select COMPILER_SUPPORT_LIBC_TIME
    select COMPILER_SUPPORT_STDIO
    select AW_IO_DIR
    default n
    help
        Version: 5.7.0

        Detail:help

          The wolfSSL embedded SSL library (formerly CyaSSL) is a lightweight SSL/TLS 

        library written in ANSI C and targeted for embedded, RTOS, and resource-

        constrained environments - primarily because of its small size, speed, and 

        feature set. It is commonly used in standard operating environments as well 

        because of its royalty-free pricing and excellent cross platform support. 

        wolfSSL supports industry standards up to the current TLS 1.3 and DTLS 1.2, 

        is up to 20 times smaller than OpenSSL, and offers progressive ciphers such 

        as ChaCha20, Curve25519, Blake2b and Post-Quantum TLS 1.3 groups. User bench-

        marking and feedback reports dramatically better performance when using wolf-

        SSL over OpenSSL.

        Source Code Version: wolfSSL V5.6.0
if WOLFSSL

source "D:/aworks_lp_hpm6450_general_sdk-0.9.1/components/wolfssl/Kconfig.opts"

endif #WOLFSSL
```

## .axioenvs/application.modbus_tcp_slave/build/gcc-riscv32.release/gen/Kconfig/Kconfig.component.EPC6450-AWI.device.24cxx_0
```kconfig
menuconfig DEV_DS2460
    bool "ds2460 @ i2c0"
    default n
    visible if y
    select DRV_24CXX
    select DEV_I2C0

    help
      Filename: "/dev/ds2460"

      dts_dev_prop:
          name(unit): "24cxx" (0)
          compatible: ['atmel,24cxx']
          dts_path: /soc/i2c@0xF3020000/atmel_ds2460@40
          binding: D:\aworks_lp_hpm6450_general_sdk-0.9.1\frameworks\64cf32e2-aworks_lp\subsys\awb_common_driver\dts\bindings\atmel_24cxx\atmel,24cxx.yaml


if DEV_DS2460

config DEV_DS2460_DEVICE_TYPE
    string "Capacity Type"
    default "AWBL_EP24CXX_DS2460"
    help 
        Must choice correct device-type, otherwise, device operate will fail.
    enum
        "AWBL_EP24CXX_EP24C01"
        "AWBL_EP24CXX_EP24C02"
        "AWBL_EP24CXX_EP24C04"
        "AWBL_EP24CXX_EP24C08"
        "AWBL_EP24CXX_EP24C16"
        "AWBL_EP24CXX_EP24C32"
        "AWBL_EP24CXX_EP24C64"
        "AWBL_EP24CXX_EP24C128"
        "AWBL_EP24CXX_EP24C256"
        "AWBL_EP24CXX_EP24C512"
        "AWBL_EP24CXX_EP24C1024"
        "AWBL_EP24CXX_DS2460"

endif #DEV_DS2460
```

## .axioenvs/application.modbus_tcp_slave/build/gcc-riscv32.release/gen/Kconfig/Kconfig.component.EPC6450-AWI.device.bu21029muv_0
```kconfig
menuconfig DEV_BU21029MUV
    bool "bu21029muv @ i2c3"
    default n
    visible if y
    select DRV_BU21029MUV
    select DEV_I2C3
    select DEV_PIN_1
    select DEV_PIN_1_PIN_RES_130
    select DEV_PIN_1_AWB_PIN_SERVICE

    help
      Filename: "/dev/bu21029muv"

      dts_dev_prop:
          name(unit): "bu21029muv" (0)
          compatible: ['rohm,bu21029muv']
          dts_path: /soc/i2c@0xF302C000/bu21029muv@0x40
          binding: D:\aworks_lp_hpm6450_general_sdk-0.9.1\frameworks\64cf32e2-aworks_lp\subsys\awb_common_driver\dts\bindings\touchscreen\bu21029muv\rohm,bu21029muv.yaml
```

## .axioenvs/application.modbus_tcp_slave/build/gcc-riscv32.release/gen/Kconfig/Kconfig.component.EPC6450-AWI.device.cyw43438_sdio_0
```kconfig
menuconfig DEV_CYW43438
    bool "cyw43438 @ sdio0"
    default n
    visible if y
    select DRV_CYW43438_SDIO
    select DEV_SDIO0
    select DEV_PIN_1
    select DEV_PIN_1_PIN_RES_121
    select DEV_PIN_1_AWB_PIN_SERVICE
    select DEV_PIN_1_PIN_RES_111

    help
      Filename: "/dev/cyw43438"

      dts_dev_prop:
          name(unit): "cyw43438_sdio" (0)
          compatible: ['cypress,cyw43438_sdio']
          dts_path: /soc/sdio@0xF2030000/cyw43438_sdio
          binding: D:\aworks_lp_hpm6450_general_sdk-0.9.1\frameworks\64cf32e2-aworks_lp\subsys\awb_common_driver\dts\bindings\cyw43xxx\cypress,cyw43438_sdio.yaml


if DEV_CYW43438

config DEV_CYW43438_SDIO_BUS_CLOCK_FREQUENCY
    int "Bus clock frequency"
    default 40000000
    range 100000 50000000


config DEV_CYW43438_WIFI_COUNTRY
    string "Country"
    default "AW_WIFI_COUNTRY_CHINA"
    enum
        "AW_WIFI_COUNTRY_CHINA"
        "AW_WIFI_COUNTRY_HONG_KONG"


config DEV_CYW43438_STA_NETIF_ENABLE
    bool "Enable STA network interface card"
    default y


config DEV_CYW43438_STA_SUPPORT_802_11_N
    bool "STA Interface supports 802.11n"
    default y


config DEV_CYW43438_STA_DHCP_EN
    bool "STA Enable DHCP"
    default n


config DEV_CYW43438_STA_IPADDR
    string "STA IP address"
    default "192.168.137.252"


config DEV_CYW43438_STA_NETMASK
    string "STA Netmask"
    default "255.255.255.0"


config DEV_CYW43438_STA_GATEWAY
    string "STA Gateway"
    default "192.168.137.1"


config DEV_CYW43438_AP_NETIF_ENABLE
    bool "Enable AP network interface card"
    default y


config DEV_CYW43438_AP_SUPPORT_802_11_N
    bool "AP Interface supports 802.11n"
    default y


config DEV_CYW43438_AP_DHCP_EN
    bool "AP Enable DHCP"
    default n


config DEV_CYW43438_AP_IPADDR
    string "AP IP address"
    default "192.168.138.1"


config DEV_CYW43438_AP_NETMASK
    string "AP Netmask"
    default "255.255.255.0"


config DEV_CYW43438_AP_GATEWAY
    string "AP Gateway"
    default "192.168.138.1"

endif #DEV_CYW43438
```

## .axioenvs/application.modbus_tcp_slave/build/gcc-riscv32.release/gen/Kconfig/Kconfig.component.EPC6450-AWI.device.general_zlg7291_0
```kconfig
menuconfig DEV_ZLG7291
    bool "zlg7291 @ i2c0"
    default n
    visible if y
    select DRV_GENERAL_ZLG7291
    select DEV_I2C0
    select DEV_PIN_1
    select DEV_PIN_1_PIN_RES_152
    select DEV_PIN_1_AWB_PIN_SERVICE
    select DEV_PIN_1_PIN_RES_160

    help
      Filename: "/dev/zlg7291"

      dts_dev_prop:
          name(unit): "general,zlg7291" (0)
          compatible: ['zlg,zlg7291']
          dts_path: /soc/i2c@0xF3020000/zlg7291@0x30
          binding: D:\aworks_lp_hpm6450_general_sdk-0.9.1\frameworks\64cf32e2-aworks_lp\subsys\awb_common_driver\dts\bindings\zlg7291\zlg,zlg7291.yaml


if DEV_ZLG7291

config DEV_ZLG7291_IS_INT
    bool "interrupt pin trigger mode"
    default y

endif #DEV_ZLG7291
```

## .axioenvs/application.modbus_tcp_slave/build/gcc-riscv32.release/gen/Kconfig/Kconfig.component.EPC6450-AWI.device.gpio_led_0
```kconfig
menuconfig DEV_GPIO_LEDS
    bool "gpio_leds"
    default n
    visible if y
    select DRV_GPIO_LED

    help
      Filename: "/dev/gpio_leds"

      dts_dev_prop:
          name(unit): "gpio_led" (0)
          compatible: ['general,gpio_led']
          dts_path: /gpio_led
          binding: D:\aworks_lp_hpm6450_general_sdk-0.9.1\frameworks\64cf32e2-aworks_lp\subsys\awb_common_driver\dts\bindings\led\general,gpio_led.yaml


if DEV_GPIO_LEDS
config DEV_GPIO_LEDS_LED_RUN
    bool "led_run"
    default n
    select DEV_PIN_1
    select DEV_PIN_1_PIN_RES_188
    select DEV_PIN_1_AWB_PIN_SERVICE


    help
       Filename:"/dev/led_run"

if DEV_GPIO_LEDS_LED_RUN

endif #DEV_GPIO_LEDS_LED_RUN
endif #DEV_GPIO_LEDS
```

## .axioenvs/application.modbus_tcp_slave/build/gcc-riscv32.release/gen/Kconfig/Kconfig.component.EPC6450-AWI.device.gpio_spi_0
```kconfig
menuconfig DEV_GPIOSPI0
    bool "gpiospi0"
    default n
    visible if y
    select DRV_GPIO_SPI
    select DEV_PIN_1
    select DEV_PIN_1_PIN_RES_198
    select DEV_PIN_1_AWB_PIN_SERVICE
    select DEV_PIN_1_PIN_RES_199
    select DEV_PIN_1_PIN_RES_200
    select DEV_PIN_1_PIN_RES_197

    help
      Filename: "/dev/gpiospi0"

      dts_dev_prop:
          name(unit): "gpio_spi" (0)
          compatible: ['general,gpio_spi']
          dts_path: /gpiospi_0
          binding: D:\aworks_lp_hpm6450_general_sdk-0.9.1\frameworks\64cf32e2-aworks_lp\subsys\awb_common_driver\dts\bindings\gpio_spi\general,gpio_spi.yaml


if DEV_GPIOSPI0

config DEV_GPIOSPI0_BUS_SPEED
    int "Bus Speed"
    default 400000
    range 0 4000000
    help 
        The unit of parameter "bus_speed" is Hz.


config DEV_GPIOSPI0_HIGH_PRECISION
    bool "high_precision"
    default n
    help 
        If "high_precision" is selected, means you can get a more accurate communication clock, however, this will reduce task scheduling.

config DEV_GPIOSPI0_CHIPSELECT_0
    bool "CS 0"
    default n
    help
      gpiospi0 Chip Select 0
endif #DEV_GPIOSPI0
```
