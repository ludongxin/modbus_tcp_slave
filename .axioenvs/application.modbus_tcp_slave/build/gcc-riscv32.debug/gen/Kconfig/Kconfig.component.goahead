## .axioenvs/application.modbus_tcp_slave/build/gcc-riscv32.release/gen/Kconfig/Kconfig.component.EPC6450-AWI.device.hpm_adc12_0
```kconfig
menuconfig DEV_ADC0
    bool "adc0"
    default n
    visible if y
    select DRV_HPM_ADC12
    select DEV_PLIC0
    select DEV_PLIC0_INTERRUPT_RES_19
    select DEV_PLIC0_AWBL_INTCTLR_SERVICE

    help
      Filename: "/dev/adc0"

      dts_dev_prop:
          name(unit): "hpm_adc12" (0)
          compatible: ['riscv,hpm-adc12']
          dts_path: /soc/adc12@0xF0010000
          binding: D:\aworks_lp_hpm6450_general_sdk-0.9.1\platforms\platform-hpm-aworks-lp\components\aw_cpu_driver_hpm\dts\bindings\adc12\riscv,hpm_adc12.yaml


if DEV_ADC0

config DEV_ADC0_BITS
    string "Set adc12 Resolution"
    default "ADC12_SELRES_12"
    enum
        "ADC12_SELRES_12"
        "ADC12_SELRES_10"
        "ADC12_SELRES_8"
        "ADC12_SELRES_6"


config DEV_ADC0_CONV_MODE
    string "Set adc12 conversion modes"
    default "ADC12_CONV_MODE_SEQUENCE"
    enum
        "ADC12_CONV_MODE_ONESHOT"
        "ADC12_CONV_MODE_PERIOD"
        "ADC12_CONV_MODE_SEQUENCE"


config DEV_ADC0_PERIOD_US
    int "the period conversion time (unit:us)"
    default 100


config DEV_ADC0_VREFH
    int "high lever of reference voltage"
    default 3300


config DEV_ADC0_AWB_ADC_SERVICE
    def_bool y

if DEV_ADC0_AWB_ADC_SERVICE
config DEV_ADC0_ADC_RES_0
    bool "adc0_ch0 (0)"
    default n
    select DEV_PIN_1
    select DEV_PIN_1_AWB_PIN_SERVICE
    select DEV_PIN_1_PIN_RES_142

if DEV_ADC0_ADC_RES_0

config DEV_ADC0_ADC0_CH0_IS_DIFF_SEL
    bool "enable differential mode"
    default n

endif #DEV_ADC0_ADC_RES_0
config DEV_ADC0_ADC_RES_1
    bool "adc0_ch1 (1)"
    default n
    select DEV_PIN_1
    select DEV_PIN_1_AWB_PIN_SERVICE
    select DEV_PIN_1_PIN_RES_143

if DEV_ADC0_ADC_RES_1

config DEV_ADC0_ADC0_CH1_IS_DIFF_SEL
    bool "enable differential mode"
    default n

endif #DEV_ADC0_ADC_RES_1
config DEV_ADC0_ADC_RES_2
    bool "adc0_ch2 (2)"
    default n
    select DEV_PIN_1
    select DEV_PIN_1_AWB_PIN_SERVICE
    select DEV_PIN_1_PIN_RES_144

if DEV_ADC0_ADC_RES_2

config DEV_ADC0_ADC0_CH2_IS_DIFF_SEL
    bool "enable differential mode"
    default n

endif #DEV_ADC0_ADC_RES_2
config DEV_ADC0_ADC_RES_3
    bool "adc0_ch3 (3)"
    default n
    select DEV_PIN_1
    select DEV_PIN_1_AWB_PIN_SERVICE
    select DEV_PIN_1_PIN_RES_145

if DEV_ADC0_ADC_RES_3

config DEV_ADC0_ADC0_CH3_IS_DIFF_SEL
    bool "enable differential mode"
    default n

endif #DEV_ADC0_ADC_RES_3
config DEV_ADC0_ADC_RES_4
    bool "adc0_ch4 (4)"
    default n
    select DEV_PIN_1
    select DEV_PIN_1_AWB_PIN_SERVICE
    select DEV_PIN_1_PIN_RES_146

if DEV_ADC0_ADC_RES_4

config DEV_ADC0_ADC0_CH4_IS_DIFF_SEL
    bool "enable differential mode"
    default n

endif #DEV_ADC0_ADC_RES_4
config DEV_ADC0_ADC_RES_5
    bool "adc0_ch5 (5)"
    default n
    select DEV_PIN_1
    select DEV_PIN_1_AWB_PIN_SERVICE
    select DEV_PIN_1_PIN_RES_147

if DEV_ADC0_ADC_RES_5

config DEV_ADC0_ADC0_CH5_IS_DIFF_SEL
    bool "enable differential mode"
    default n

endif #DEV_ADC0_ADC_RES_5
config DEV_ADC0_ADC_RES_6
    bool "adc0_ch6 (6)"
    default n
    select DEV_PIN_1
    select DEV_PIN_1_AWB_PIN_SERVICE
    select DEV_PIN_1_PIN_RES_148

if DEV_ADC0_ADC_RES_6

config DEV_ADC0_ADC0_CH6_IS_DIFF_SEL
    bool "enable differential mode"
    default n

endif #DEV_ADC0_ADC_RES_6
config DEV_ADC0_ADC_RES_7
    bool "adc0_ch7 (7)"
    default n
    select DEV_PIN_1
    select DEV_PIN_1_AWB_PIN_SERVICE
    select DEV_PIN_1_PIN_RES_149

if DEV_ADC0_ADC_RES_7

config DEV_ADC0_ADC0_CH7_IS_DIFF_SEL
    bool "enable differential mode"
    default n

endif #DEV_ADC0_ADC_RES_7
config DEV_ADC0_ADC_RES_8
    bool "adc0_ch8 (8)"
    default n
    select DEV_PIN_1
    select DEV_PIN_1_AWB_PIN_SERVICE
    select DEV_PIN_1_PIN_RES_150

if DEV_ADC0_ADC_RES_8

config DEV_ADC0_ADC0_CH8_IS_DIFF_SEL
    bool "enable differential mode"
    default n

endif #DEV_ADC0_ADC_RES_8
config DEV_ADC0_ADC_RES_9
    bool "adc0_ch9 (9)"
    default n
    select DEV_PIN_1
    select DEV_PIN_1_AWB_PIN_SERVICE
    select DEV_PIN_1_PIN_RES_151

if DEV_ADC0_ADC_RES_9

config DEV_ADC0_ADC0_CH9_IS_DIFF_SEL
    bool "enable differential mode"
    default n

endif #DEV_ADC0_ADC_RES_9
config DEV_ADC0_ADC_RES_10
    bool "adc0_ch10 (10)"
    default n
    select DEV_PIN_1
    select DEV_PIN_1_AWB_PIN_SERVICE
    select DEV_PIN_1_PIN_RES_152

if DEV_ADC0_ADC_RES_10

config DEV_ADC0_ADC0_CH10_IS_DIFF_SEL
    bool "enable differential mode"
    default n

endif #DEV_ADC0_ADC_RES_10
config DEV_ADC0_ADC_RES_11
    bool "adc0_ch11 (11)"
    default n
    select DEV_PIN_1
    select DEV_PIN_1_AWB_PIN_SERVICE
    select DEV_PIN_1_PIN_RES_153

if DEV_ADC0_ADC_RES_11

config DEV_ADC0_ADC0_CH11_IS_DIFF_SEL
    bool "enable differential mode"
    default n

endif #DEV_ADC0_ADC_RES_11
config DEV_ADC0_ADC_RES_12
    bool "adc0_ch12 (12)"
    default n
    select DEV_PIN_1
    select DEV_PIN_1_AWB_PIN_SERVICE
    select DEV_PIN_1_PIN_RES_154

if DEV_ADC0_ADC_RES_12

config DEV_ADC0_ADC0_CH12_IS_DIFF_SEL
    bool "enable differential mode"
    default n

endif #DEV_ADC0_ADC_RES_12
config DEV_ADC0_ADC_RES_13
    bool "adc0_ch13 (13)"
    default n
    select DEV_PIN_1
    select DEV_PIN_1_AWB_PIN_SERVICE
    select DEV_PIN_1_PIN_RES_155

if DEV_ADC0_ADC_RES_13

config DEV_ADC0_ADC0_CH13_IS_DIFF_SEL
    bool "enable differential mode"
    default n

endif #DEV_ADC0_ADC_RES_13
config DEV_ADC0_ADC_RES_14
    bool "adc0_ch14 (14)"
    default n
    select DEV_PIN_1
    select DEV_PIN_1_AWB_PIN_SERVICE
    select DEV_PIN_1_PIN_RES_156

if DEV_ADC0_ADC_RES_14

config DEV_ADC0_ADC0_CH14_IS_DIFF_SEL
    bool "enable differential mode"
    default n

endif #DEV_ADC0_ADC_RES_14
config DEV_ADC0_ADC_RES_15
    bool "adc0_ch15 (15)"
    default n
    select DEV_PIN_1
    select DEV_PIN_1_AWB_PIN_SERVICE
    select DEV_PIN_1_PIN_RES_157

if DEV_ADC0_ADC_RES_15

config DEV_ADC0_ADC0_CH15_IS_DIFF_SEL
    bool "enable differential mode"
    default n

endif #DEV_ADC0_ADC_RES_15
config DEV_ADC0_ADC_RES_16
    bool "adc0_ch16 (16)"
    default n
    select DEV_PIN_1
    select DEV_PIN_1_AWB_PIN_SERVICE
    select DEV_PIN_1_PIN_RES_158

if DEV_ADC0_ADC_RES_16

config DEV_ADC0_ADC0_CH16_IS_DIFF_SEL
    bool "enable differential mode"
    default n

endif #DEV_ADC0_ADC_RES_16
config DEV_ADC0_ADC_RES_17
    bool "adc0_ch17 (17)"
    default n
    select DEV_PIN_1
    select DEV_PIN_1_AWB_PIN_SERVICE
    select DEV_PIN_1_PIN_RES_160

if DEV_ADC0_ADC_RES_17

config DEV_ADC0_ADC0_CH17_IS_DIFF_SEL
    bool "enable differential mode"
    default n

endif #DEV_ADC0_ADC_RES_17
config DEV_ADC0_ADC_RES_18
    bool "adc0_ch18 (18)"
    default n


if DEV_ADC0_ADC_RES_18

config DEV_ADC0_ADC0_CH18_IS_DIFF_SEL
    bool "enable differential mode"
    default n

endif #DEV_ADC0_ADC_RES_18
endif # DEV_ADC0_AWB_ADC_SERVICE

endif #DEV_ADC0
```

## .axioenvs/application.modbus_tcp_slave/build/gcc-riscv32.release/gen/Kconfig/Kconfig.component.EPC6450-AWI.device.hpm_adc12_2
```kconfig
menuconfig DEV_ADC2
    bool "adc2"
    default n
    visible if y
    select DRV_HPM_ADC12
    select DEV_PLIC0
    select DEV_PLIC0_INTERRUPT_RES_21
    select DEV_PLIC0_AWBL_INTCTLR_SERVICE

    help
      Filename: "/dev/adc2"

      dts_dev_prop:
          name(unit): "hpm_adc12" (2)
          compatible: ['riscv,hpm-adc12']
          dts_path: /soc/adc12@0xF0018000
          binding: D:\aworks_lp_hpm6450_general_sdk-0.9.1\platforms\platform-hpm-aworks-lp\components\aw_cpu_driver_hpm\dts\bindings\adc12\riscv,hpm_adc12.yaml


if DEV_ADC2

config DEV_ADC2_BITS
    string "Set adc12 Resolution"
    default "ADC12_SELRES_12"
    enum
        "ADC12_SELRES_12"
        "ADC12_SELRES_10"
        "ADC12_SELRES_8"
        "ADC12_SELRES_6"


config DEV_ADC2_CONV_MODE
    string "Set adc12 conversion modes"
    default "ADC12_CONV_MODE_SEQUENCE"
    enum
        "ADC12_CONV_MODE_ONESHOT"
        "ADC12_CONV_MODE_PERIOD"
        "ADC12_CONV_MODE_SEQUENCE"


config DEV_ADC2_PERIOD_US
    int "the period conversion time (unit:us)"
    default 100


config DEV_ADC2_VREFH
    int "high lever of reference voltage"
    default 3300


config DEV_ADC2_AWB_ADC_SERVICE
    def_bool y

if DEV_ADC2_AWB_ADC_SERVICE
config DEV_ADC2_ADC_RES_0
    bool "adc2_ch0 (38)"
    default n
    select DEV_PIN_1
    select DEV_PIN_1_AWB_PIN_SERVICE
    select DEV_PIN_1_PIN_RES_142

if DEV_ADC2_ADC_RES_0

config DEV_ADC2_ADC2_CH0_IS_DIFF_SEL
    bool "enable differential mode"
    default n

endif #DEV_ADC2_ADC_RES_0
config DEV_ADC2_ADC_RES_1
    bool "adc2_ch1 (39)"
    default n
    select DEV_PIN_1
    select DEV_PIN_1_AWB_PIN_SERVICE
    select DEV_PIN_1_PIN_RES_143

if DEV_ADC2_ADC_RES_1

config DEV_ADC2_ADC2_CH1_IS_DIFF_SEL
    bool "enable differential mode"
    default n

endif #DEV_ADC2_ADC_RES_1
config DEV_ADC2_ADC_RES_2
    bool "adc2_ch2 (40)"
    default n
    select DEV_PIN_1
    select DEV_PIN_1_AWB_PIN_SERVICE
    select DEV_PIN_1_PIN_RES_144

if DEV_ADC2_ADC_RES_2

config DEV_ADC2_ADC2_CH2_IS_DIFF_SEL
    bool "enable differential mode"
    default n

endif #DEV_ADC2_ADC_RES_2
config DEV_ADC2_ADC_RES_3
    bool "adc2_ch3 (41)"
    default n
    select DEV_PIN_1
    select DEV_PIN_1_AWB_PIN_SERVICE
    select DEV_PIN_1_PIN_RES_145

if DEV_ADC2_ADC_RES_3

config DEV_ADC2_ADC2_CH3_IS_DIFF_SEL
    bool "enable differential mode"
    default n

endif #DEV_ADC2_ADC_RES_3
config DEV_ADC2_ADC_RES_4
    bool "adc2_ch4 (42)"
    default n
    select DEV_PIN_1
    select DEV_PIN_1_AWB_PIN_SERVICE
    select DEV_PIN_1_PIN_RES_146

if DEV_ADC2_ADC_RES_4

config DEV_ADC2_ADC2_CH4_IS_DIFF_SEL
    bool "enable differential mode"
    default n

endif #DEV_ADC2_ADC_RES_4
config DEV_ADC2_ADC_RES_5
    bool "adc2_ch5 (43)"
    default n
    select DEV_PIN_1
    select DEV_PIN_1_AWB_PIN_SERVICE
    select DEV_PIN_1_PIN_RES_147

if DEV_ADC2_ADC_RES_5

config DEV_ADC2_ADC2_CH5_IS_DIFF_SEL
    bool "enable differential mode"
    default n

endif #DEV_ADC2_ADC_RES_5
config DEV_ADC2_ADC_RES_6
    bool "adc2_ch6 (44)"
    default n
    select DEV_PIN_1
    select DEV_PIN_1_AWB_PIN_SERVICE
    select DEV_PIN_1_PIN_RES_148

if DEV_ADC2_ADC_RES_6

config DEV_ADC2_ADC2_CH6_IS_DIFF_SEL
    bool "enable differential mode"
    default n

endif #DEV_ADC2_ADC_RES_6
config DEV_ADC2_ADC_RES_7
    bool "adc2_ch7 (45)"
    default n
    select DEV_PIN_1
    select DEV_PIN_1_AWB_PIN_SERVICE
    select DEV_PIN_1_PIN_RES_149

if DEV_ADC2_ADC_RES_7

config DEV_ADC2_ADC2_CH7_IS_DIFF_SEL
    bool "enable differential mode"
    default n

endif #DEV_ADC2_ADC_RES_7
config DEV_ADC2_ADC_RES_8
    bool "adc2_ch8 (46)"
    default n
    select DEV_PIN_1
    select DEV_PIN_1_AWB_PIN_SERVICE
    select DEV_PIN_1_PIN_RES_150

if DEV_ADC2_ADC_RES_8

config DEV_ADC2_ADC2_CH8_IS_DIFF_SEL
    bool "enable differential mode"
    default n

endif #DEV_ADC2_ADC_RES_8
config DEV_ADC2_ADC_RES_9
    bool "adc2_ch9 (47)"
    default n
    select DEV_PIN_1
    select DEV_PIN_1_AWB_PIN_SERVICE
    select DEV_PIN_1_PIN_RES_151

if DEV_ADC2_ADC_RES_9

config DEV_ADC2_ADC2_CH9_IS_DIFF_SEL
    bool "enable differential mode"
    default n

endif #DEV_ADC2_ADC_RES_9
config DEV_ADC2_ADC_RES_10
    bool "adc2_ch10 (48)"
    default n
    select DEV_PIN_1
    select DEV_PIN_1_AWB_PIN_SERVICE
    select DEV_PIN_1_PIN_RES_152

if DEV_ADC2_ADC_RES_10

config DEV_ADC2_ADC2_CH10_IS_DIFF_SEL
    bool "enable differential mode"
    default n

endif #DEV_ADC2_ADC_RES_10
config DEV_ADC2_ADC_RES_11
    bool "adc2_ch11 (49)"
    default n
    select DEV_PIN_1
    select DEV_PIN_1_AWB_PIN_SERVICE
    select DEV_PIN_1_PIN_RES_153

if DEV_ADC2_ADC_RES_11

config DEV_ADC2_ADC2_CH11_IS_DIFF_SEL
    bool "enable differential mode"
    default n

endif #DEV_ADC2_ADC_RES_11
config DEV_ADC2_ADC_RES_12
    bool "adc2_ch12 (50)"
    default n
    select DEV_PIN_1
    select DEV_PIN_1_AWB_PIN_SERVICE
    select DEV_PIN_1_PIN_RES_162

if DEV_ADC2_ADC_RES_12

config DEV_ADC2_ADC2_CH12_IS_DIFF_SEL
    bool "enable differential mode"
    default n

endif #DEV_ADC2_ADC_RES_12
config DEV_ADC2_ADC_RES_13
    bool "adc2_ch13 (51)"
    default n
    select DEV_PIN_1
    select DEV_PIN_1_AWB_PIN_SERVICE
    select DEV_PIN_1_PIN_RES_163

if DEV_ADC2_ADC_RES_13

config DEV_ADC2_ADC2_CH13_IS_DIFF_SEL
    bool "enable differential mode"
    default n

endif #DEV_ADC2_ADC_RES_13
config DEV_ADC2_ADC_RES_14
    bool "adc2_ch14 (52)"
    default n
    select DEV_PIN_1
    select DEV_PIN_1_AWB_PIN_SERVICE
    select DEV_PIN_1_PIN_RES_164

if DEV_ADC2_ADC_RES_14

config DEV_ADC2_ADC2_CH14_IS_DIFF_SEL
    bool "enable differential mode"
    default n

endif #DEV_ADC2_ADC_RES_14
config DEV_ADC2_ADC_RES_15
    bool "adc2_ch15 (53)"
    default n
    select DEV_PIN_1
    select DEV_PIN_1_AWB_PIN_SERVICE
    select DEV_PIN_1_PIN_RES_165

if DEV_ADC2_ADC_RES_15

config DEV_ADC2_ADC2_CH15_IS_DIFF_SEL
    bool "enable differential mode"
    default n

endif #DEV_ADC2_ADC_RES_15
config DEV_ADC2_ADC_RES_16
    bool "adc2_ch16 (54)"
    default n
    select DEV_PIN_1
    select DEV_PIN_1_AWB_PIN_SERVICE
    select DEV_PIN_1_PIN_RES_166

if DEV_ADC2_ADC_RES_16

config DEV_ADC2_ADC2_CH16_IS_DIFF_SEL
    bool "enable differential mode"
    default n

endif #DEV_ADC2_ADC_RES_16
config DEV_ADC2_ADC_RES_17
    bool "adc2_ch17 (55)"
    default n
    select DEV_PIN_1
    select DEV_PIN_1_AWB_PIN_SERVICE
    select DEV_PIN_1_PIN_RES_168

if DEV_ADC2_ADC_RES_17

config DEV_ADC2_ADC2_CH17_IS_DIFF_SEL
    bool "enable differential mode"
    default n

endif #DEV_ADC2_ADC_RES_17
config DEV_ADC2_ADC_RES_18
    bool "adc2_ch18 (56)"
    default n


if DEV_ADC2_ADC_RES_18

config DEV_ADC2_ADC2_CH18_IS_DIFF_SEL
    bool "enable differential mode"
    default n

endif #DEV_ADC2_ADC_RES_18
endif # DEV_ADC2_AWB_ADC_SERVICE

endif #DEV_ADC2
```

## .axioenvs/application.modbus_tcp_slave/build/gcc-riscv32.release/gen/Kconfig/Kconfig.component.EPC6450-AWI.device.hpm_cam_0
```kconfig
menuconfig DEV_CAM0
    bool "cam0"
    default n
    visible if y
    select DRV_HPM_CAM
    select DEV_PLIC0
    select DEV_PIN_1
    select DEV_PLIC0_INTERRUPT_RES_97
    select DEV_PLIC0_AWBL_INTCTLR_SERVICE
    select DEV_PIN_1_PIN_RES_7
    select DEV_PIN_1_AWB_PIN_SERVICE
    select DEV_PIN_1_PIN_RES_3
    select DEV_PIN_1_PIN_RES_8
    select DEV_PIN_1_PIN_RES_9
    select DEV_PIN_1_PIN_RES_0
    select DEV_PIN_1_PIN_RES_4
    select DEV_PIN_1_PIN_RES_1
    select DEV_PIN_1_PIN_RES_2
    select DEV_PIN_1_PIN_RES_11
    select DEV_PIN_1_PIN_RES_10
    select DEV_PIN_1_PIN_RES_6
    select DEV_PIN_1_PIN_RES_5


    help
      DTS_device_prop:
          name(unit): "hpm_cam" (0)
          compatible: ['riscv,hpm-cam']
          dts_path: /soc/camera@0xF1008000
          binding: D:\aworks_lp_hpm6450_general_sdk-0.9.1\platforms\platform-hpm-aworks-lp\components\aw_cpu_driver_hpm\dts\bindings\cam\riscv,hpm-cam.yaml


if DEV_CAM0

config DEV_CAM0_HEIGHT
    int "max resolution height of camera"
    default 480
    range 0 1024


config DEV_CAM0_WIDTH
    int "max resolution width of camera"
    default 640
    range 0 1024

endif #DEV_CAM0
```
