## .axioenvs/application.modbus_tcp_slave/build/gcc-riscv32.debug/gen/Kconfig/Kconfig.component.awb_common_driver.driver.hts221
```kconfig
menuconfig DRV_HTS221
    bool "hts221 ['ST,hts221']"
    select AW_SUBSYS_DRIVER_SENSOR
    select AW_OS_ISR_DEFER
    default n
    help
        Example of adding device to board.dts:

        &i2c1 {
            hts221:hts221@5f {
                compatible = "ST,hts221";
                timeout = <3000>;
                label = "HTS221";
                status = "disabled";
                reg = <0x5f>;
                data-pins = <&pin1 GPIO1_27 GPIO1_27_GPIO (GPIO1_27_GPIO|AW_PIN_CFG_GPIO_INPUT) GPIO1_27_GPIO>;
            };
        };
        

        And also, you can config pin in pins.dts as follow:
        

        &hts221{
            data-pins = <&pin1 GPIO1_27 GPIO1_27_GPIO (GPIO1_27_GPIO|AW_PIN_CFG_GPIO_INPUT) GPIO1_27_GPIO>;
        };
```

## .axioenvs/application.modbus_tcp_slave/build/gcc-riscv32.debug/gen/Kconfig/Kconfig.component.awb_common_driver.driver.ksz9031_phy
```kconfig
menuconfig DRV_KSZ9031_PHY
    bool "ksz9031_phy ['micrel,ksz9031']"
    select AW_SUBSYS_SYSTEM_PM_PIN
    select AW_SUBSYS_DRIVER_PHY_POLL
    default n
    help
        Example of adding device to board.dts:

        &enet1 {
            phy-handle = <&ksz9031_5>;
            ksz9031_5:ksz9031@0x05{
                compatible = "micrel,ksz9031";
                status = "disabled";
                label = "ksz9031_5";
                clk_delay = <0x3ef>;
                reg = <0x05>;
            };
        };

        Parameters:

           dev_clk:  The ref-clk for ksz9031,if ksz9031 has osc ,this must be -1

           clk_delay:  RGMII Clock Pad Skew(clk_delay, MMD Address 2h,Register 8h),  this value is different in different hardware
```

## .axioenvs/application.modbus_tcp_slave/build/gcc-riscv32.debug/gen/Kconfig/Kconfig.component.awb_common_driver.driver.lps22hb
```kconfig
menuconfig DRV_LPS22HB
    bool "lps22hb ['ST,lps22hb']"
    select AW_SUBSYS_DRIVER_SENSOR
    select AW_OS_ISR_DEFER
    default n
    help
        Example of adding device to board.dts:

        &i2c1{
            lps22hb:lps22hb@5c {
                compatible = "ST,lps22hb";
                label = "LPS22HB";
                status = "disabled";
                reg = <0x5c>;
                data-pins = <&pin1 GPIO1_24 GPIO1_24_GPIO (GPIO1_24_GPIO|AW_PIN_CFG_GPIO_INPUT) GPIO1_24_GPIO>;
            };
        };
        

        And also, you can config pin in pins.dts as follow:
        

        &lps22hb{
            data-pins = <&pin1 GPIO1_24 GPIO1_24_GPIO (GPIO1_24_GPIO|AW_PIN_CFG_GPIO_INPUT) GPIO1_24_GPIO>;
        };
```

## .axioenvs/application.modbus_tcp_slave/build/gcc-riscv32.debug/gen/Kconfig/Kconfig.component.awb_common_driver.driver.ltr553
```kconfig
menuconfig DRV_LTR553
    bool "ltr553 ['LITEON,ltr553']"
    select AW_SUBSYS_DRIVER_SENSOR
    default n
    help
        Example of adding device to board.dts:

        &i2c1{
            ltr553:ltr553@23 {
                compatible = "LITEON,ltr553";
                label = "LTR553";
                status = "disabled";
                reg = <0x23>;
            };
        };
```

## .axioenvs/application.modbus_tcp_slave/build/gcc-riscv32.debug/gen/Kconfig/Kconfig.component.awb_common_driver.driver.mmc5883ma
```kconfig
menuconfig DRV_MMC5883MA
    bool "mmc5883ma ['MEMSIC,mmc5883ma']"
    select AW_SUBSYS_DRIVER_SENSOR
    select AW_OS_ISR_DEFER
    default n
    help
        Example of adding device to board.dts:

        &i2c1{
            mmc5883ma:mmc5883ma@30 {
                compatible = "MEMSIC,mmc5883ma";
                label = "MMC5883MA";
                status = "disabled";
                reg = <0x30>;
                data-pins = <&pin1 GPIO1_29 GPIO1_29_GPIO (GPIO1_29_GPIO|AW_PIN_CFG_GPIO_INPUT) GPIO1_29_GPIO>;
            };
        };
        

        And also, you can config pin in pins.dts as follow:
        

        &mmc5883ma{
            data-pins = <&pin1 GPIO1_29 GPIO1_29_GPIO (GPIO1_29_GPIO|AW_PIN_CFG_GPIO_INPUT) GPIO1_29_GPIO>;
        };
```

## .axioenvs/application.modbus_tcp_slave/build/gcc-riscv32.debug/gen/Kconfig/Kconfig.component.awb_common_driver.driver.nxp_tja1027_lin
```kconfig
menuconfig DRV_NXP_TJA1027_LIN
    bool "nxp,tja1027-lin ['nxp,tja1027-lin']"
    select AWBUS
    default n
    help
        Example of adding device to board.dts:

           / {
              lin_0:lin0{
                  compatible = "nxp,tja1027-lin";
                  label = "lin0";
                  uart_id = <&uart8>;
                  status = "disabled";
                  /**
                   * enable pin
                   * If the hardware pulls the NSLP pin by default,TJA1027 is always enabled,
                   * so you can omit this pin configuration.
                   */
                  pins = <&pin1 PIN_PD17 (IOC_PD17_FUNC_CTL_GPIO_D_17|AW_PIN_CFG_GPIO_OUTPUT_LOW)
                                         (IOC_PD17_FUNC_CTL_GPIO_D_17|AW_PIN_CFG_GPIO_OUTPUT_LOW)
                                         (IOC_PD17_FUNC_CTL_GPIO_D_17|AW_PIN_CFG_GPIO_OUTPUT_LOW)>;
              };
          };
        

        And also, you can config pin in pins.dts as follow:
        

        &lin_0{  
             /* enable pin */
             pins = <&pin1 PIN_PD17 (IOC_PD17_FUNC_CTL_GPIO_D_17|AW_PIN_CFG_GPIO_OUTPUT_LOW)
                                    (IOC_PD17_FUNC_CTL_GPIO_D_17|AW_PIN_CFG_GPIO_OUTPUT_LOW)
                                    (IOC_PD17_FUNC_CTL_GPIO_D_17|AW_PIN_CFG_GPIO_OUTPUT_LOW)>;
        };

        Parameters:

           uart_id:  Must be bound to the serial port, otherwise, device operate will fail.
```

## .axioenvs/application.modbus_tcp_slave/build/gcc-riscv32.debug/gen/Kconfig/Kconfig.component.awb_common_driver.driver.ov7725_camera
```kconfig
menuconfig DRV_OV7725_CAMERA
    bool "ov7725,camera ['OV,7725']"
    select AW_SUBSYS_SYSTEM_PM_PIN
    select AW_SUBSYS_DRIVER_I2C
    select AW_DEV_API
    default n
```

## .axioenvs/application.modbus_tcp_slave/build/gcc-riscv32.debug/gen/Kconfig/Kconfig.component.awb_common_driver.driver.s34ml0xg2
```kconfig
menuconfig DRV_S34ML0XG2
    bool "s34ml0xg2 ['spansion,s34ml0xg2']"
    select AW_SUBSYS_DRIVER_MTD
    select AW_ONFI
    select AW_MATH
    default n
    help
        Example of adding device to board.dts:

        &semc {
            s34ml01g2:s34ml01g2@0 {
                compatible = "spansion,s34ml0xg2";
                label  = "s34ml01g2";
                reg    = <0x00>;
                status = "disabled";
        
                /*
                 * If the typical value is set to 0, the ONFI driver will use the
                 * maximum value.
                 */
                typical_time_ns_page_read    = <0>;
                typical_time_ns_page_program = <(300*1000)>;
                typical_time_ns_block_erase  = <(3*1000*1000)>;
        
                /* ECC */
                ecc_mode      = "AWB_ONFI_ECC_MODE_CONTROLLER";
                ecc_algorithm = "AWB_RAWNAND_CTRL_ECC_ALGO_BCH";
        
                partition_0 {
                    label        = "s34_nand0";
                    block_start  = <0>;
                    block_number = <1024>;
                };
                partition_1 {
                    label        = "s34_nand1";
                    block_start  = <512>;
                    block_number = <500>;
                };
                partition_2 {
                    label        = "s34_nand2";
                    block_start  = <1012>;
                    block_number = <12>;
                };
            };
        };
        

        And also, you can config pin in pins.dts as follow:
        

        &s34ml01g2{  
            /*
             * The index of the device's  selection pin in the controller.
             * format:
             * cs_pin_index = < CS index of target 0
             *                  CS index of target 1
             *                  CS index of target 2>;
             */
            cs_pin_index = <__CS_PIN_INDEX_SEMC_CSX0>;
        };

        Subnode parameters:

           block_start:  The block number at the beginning of a partition

           block_number:  Number of blocks occupied by a partition
```

## .axioenvs/application.modbus_tcp_slave/build/gcc-riscv32.debug/gen/Kconfig/Kconfig.component.awb_common_driver.driver.virtual_nvram
```kconfig
menuconfig DRV_VIRTUAL_NVRAM
    bool "virtual_nvram ['virtual,nvram']"
    default n
```

## .axioenvs/application.modbus_tcp_slave/build/gcc-riscv32.debug/gen/Kconfig/Kconfig.component.awb_common_driver.driver.winbond
```kconfig
menuconfig DRV_WINBOND
    bool "winbond ['winbond,winbond']"
    select AW_SUBSYS_DRIVER_MTD
    select AW_MATH
    default n
    help
        Example of adding device to board.dts:

        &spi0 {
            w25n01gv:w25n01gv@0{
                compatible = "gd,winbond";
                label = "w25n01gv";
                reg = <0>; /* cs index, chipselects from the spi host */
                status = "disabled";
         
                partition_0 {
                label        = "w25n01gv_partition_0";
                block_start  = <0>;
                block_number = <512>;
                };
                partition_1 {
                label        = "w25n01gv_partition_1";
                block_start  = <512>;
                block_number = <500>;
                };
                partition_2 {
                label        = "w25n01gv_partition_2";
                block_start  = <1012>;
                block_number = <12>;
                };
            };
        };

        Subnode parameters:

           block_start:  The block number at the beginning of a partition

           block_number:  Number of blocks occupied by a partition
```

## .axioenvs/application.modbus_tcp_slave/build/gcc-riscv32.debug/gen/Kconfig/Kconfig.component.awb_common_driver.driver.wm8731
```kconfig
menuconfig DRV_WM8731
    bool "wm8731 ['wolfson,wm8731']"
    select AW_SUBSYS_SYSTEM_PM_PIN
    select AW_SUBSYS_DRIVER_I2C
    select AWSA_FRAMEWORK
    select AW_DEV_API
    default n
    help
        Example of adding device to board.dts:

        To use wm8731,need to invoke the open interface to open the wm8731 character device before using the awsa interface.
        make sure that after awsa platform registration,invoke the wm8731 interface to register the decoder and sound card.
        the value of i2s-handle is determined by the selected platform i2s dev. 
        &i2c1{
            wm8731:wm8731@0x34 {
                i2s-handle = <&i2s1>;
                compatible = "wolfson,wm8731";
                status = "disabled";
                label = "wm8731";
                reg = <0x34>;
                ck-pins    = <&pin1 GPIOF_6 GPIO_FUNC_54_G3_I2S1_CK GPIO_FUNC_54_G3_I2S1_CK GPIO_FUNC_54_G3_I2S1_CK>;
                sd-pins    = <&pin1 GPIOF_7 GPIO_FUNC_56_G3_I2S1_SD GPIO_FUNC_56_G3_I2S1_SD GPIO_FUNC_56_G3_I2S1_SD>;
                ws-pins    = <&pin1 GPIOF_8 GPIO_FUNC_55_G3_I2S1_WS GPIO_FUNC_55_G3_I2S1_WS GPIO_FUNC_55_G3_I2S1_WS>;
                mck-pins   = <&pin1 GPIOA_5 GPIOA_5_FUNC_17_I2S1_MCK GPIOA_5_FUNC_17_I2S1_MCK GPIOA_5_FUNC_17_I2S1_MCK>;
                exck-pins  = <&pin1 GPIOG_7 GPIOG_7_FUNC_17_I2S1_EXCK GPIOG_7_FUNC_17_I2S1_EXCK GPIOG_7_FUNC_17_I2S1_EXCK>;
                sdin-pins  = <&pin1 GPIOI_2 GPIOI_2_FUNC_17_I2S1_SDIN GPIOI_2_FUNC_17_I2S1_SDIN GPIOI_2_FUNC_17_I2S1_SDIN>;
            };
        };
        

        And also, you can config pin in pins.dts as follow:
        

        &wm8731{
            ck-pins    = <&pin1 GPIOF_6 GPIO_FUNC_54_G3_I2S1_CK GPIO_FUNC_54_G3_I2S1_CK GPIO_FUNC_54_G3_I2S1_CK>;
            sd-pins    = <&pin1 GPIOF_7 GPIO_FUNC_56_G3_I2S1_SD GPIO_FUNC_56_G3_I2S1_SD GPIO_FUNC_56_G3_I2S1_SD>;
            ws-pins    = <&pin1 GPIOF_8 GPIO_FUNC_55_G3_I2S1_WS GPIO_FUNC_55_G3_I2S1_WS GPIO_FUNC_55_G3_I2S1_WS>;
            mck-pins   = <&pin1 GPIOA_5 GPIOA_5_FUNC_17_I2S1_MCK GPIOA_5_FUNC_17_I2S1_MCK GPIOA_5_FUNC_17_I2S1_MCK>;
            exck-pins  = <&pin1 GPIOG_7 GPIOG_7_FUNC_17_I2S1_EXCK GPIOG_7_FUNC_17_I2S1_EXCK GPIOG_7_FUNC_17_I2S1_EXCK>;
            sdin-pins  = <&pin1 GPIOI_2 GPIOI_2_FUNC_17_I2S1_SDIN GPIOI_2_FUNC_17_I2S1_SDIN GPIOI_2_FUNC_17_I2S1_SDIN>;
        };

        Parameters:

           i2s-handle:  select platform i2s dev
```

## .axioenvs/application.modbus_tcp_slave/build/gcc-riscv32.debug/gen/Kconfig/Kconfig.component.awb_common_driver.driver.yt8531s_phy
```kconfig
menuconfig DRV_YT8531S_PHY
    bool "yt8531s_phy ['motorcomm,yt8531s']"
    select AW_SUBSYS_SYSTEM_PM_PIN
    select AW_SUBSYS_DRIVER_PHY_POLL
    default n
    help
        Example of adding device to board.dts:

         &eth1 { 
            phy-handle = <&yt8531s_0>;
            yt8531s_0:yt8531s_phy@0x02{
                compatible = "motorcomm,yt8531s";
                status = "disabled";
                dev_clk = <HPM_CLK_ETH1>;
                label = "yt8531s_0";
                reg = <0x02>;
                rst-pins = <&pin1 PIN_PZ10   (IOC_PZ10_FUNC_CTL_GPIO_Z_10|AW_PIN_CFG_GPIO_OUTPUT_HIGH)
                                             (IOC_PZ10_FUNC_CTL_GPIO_Z_10|AW_PIN_CFG_GPIO_OUTPUT_HIGH)
                                             (IOC_PZ10_FUNC_CTL_GPIO_Z_10|AW_PIN_CFG_GPIO_OUTPUT_HIGH)>;
        };
        

        And also, you can config pin in pins.dts as follow:
        

        &yt8531s_0{  
            rst-pins = <&pin1 PIN_PZ10   (IOC_PZ10_FUNC_CTL_GPIO_Z_10|AW_PIN_CFG_GPIO_OUTPUT_HIGH)
                                         (IOC_PZ10_FUNC_CTL_GPIO_Z_10|AW_PIN_CFG_GPIO_OUTPUT_HIGH)
                                         (IOC_PZ10_FUNC_CTL_GPIO_Z_10|AW_PIN_CFG_GPIO_OUTPUT_HIGH)>;
        };

        Parameters:

           dev_clk:  the ref pll clk for yt8531s,if yt8531s has osc ,this must be -1
```
