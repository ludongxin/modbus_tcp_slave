## .axioenvs/application.modbus_tcp_slave/build/gcc-riscv32.debug/gen/Kconfig/Kconfig.component.awb_common_driver.driver.zlg_tft_monitor
```kconfig
menuconfig DRV_ZLG_TFT_MONITOR
    bool "zlg_tft_monitor ['zlg_tft,monitor']"
    select AW_SUBSYS_DRIVER_DISPLAY
    select AW_SUBSYS_DRIVER_PWM
    default n
    help
        "zlg_tft,monitor" is common LCD driver which drive by LCDif, backlight be controled by PWM.

        Example of adding device to board.dts:

        &lcdif {
            monitor_zlg_480_272:monitor_zlg_480_272{
                compatible = "zlg_tft,monitor";
                label      = "zlg_480_272";
                status     = "disabled";
        
                info_manufacturer = "ZLG";
                info_x_res        = <480>;
                info_y_res        = <272>;
                info_bpp          = <16>;
        
                cfg_type = "AWB_DISPLAY_MONITOR_CFG_TYPE_DOTCLK";
                dotclk_dclk_f         = <12000000>;
                dotclk_h_pulse_width  = <1>;
                dotclk_h_active       = <480>;
                dotclk_h_bporch       = <42>;
                dotclk_h_fporch       = <5>;
                dotclk_v_pulse_width  = <1>;
                dotclk_v_active       = <272>;
                dotclk_v_bporch       = <11>;
                dotclk_v_fporch       = <8>;
                dotclk_enable_present = <1>;
                dotclk_enable_pol     = <1>;
                dotclk_v_pol          = <1>;
                dotclk_h_pol          = <0>;
                dotclk_dotclk_pol     = <1>;
        
                /* if exist GPIO to reset LCD, rst pin is optional */
                reset_delay_ms  = <10>;
                rst-pins = <&pin1 GPIO1_8 (AW_PIN_CFG_GPIO_OUTPUT_HIGH|GPIO1_8_GPIO)
                                          (AW_PIN_CFG_GPIO_OUTPUT_HIGH|GPIO1_8_GPIO)
                                          (AW_PIN_CFG_GPIO_OUTPUT_HIGH|GPIO1_8_GPIO)>;
            };
        };
        And also, you can config pin in pins.dts as follow:
        

        &monitor_zlg_480_272{  
                /* if exist GPIO to reset LCD */
                rst-pins = <&pin1 GPIO1_8 (AW_PIN_CFG_GPIO_OUTPUT_HIGH|GPIO1_8_GPIO)
                                          (AW_PIN_CFG_GPIO_OUTPUT_HIGH|GPIO1_8_GPIO)
                                          (AW_PIN_CFG_GPIO_OUTPUT_HIGH|GPIO1_8_GPIO)>;
        };

        Parameters:

           info_manufacturer:  Equipment manufacturer

           info_x_res:  Screen resolution x

           info_y_res:  Screen resolution y

           info_bpp:  Bits Per Pixel

           reset_delay_ms:  Length of time the Monitor is reset,units ms

           bl_pwm_freq:  PWM freq, units HZ

           bl_pwm_zero_offset:  Duty Cycle of PWM when backlight is extinguished

           cfg_type:  Interface timing type

           dotclk_dclk_f:  Dotclk clock(unit: Hz).

           dotclk_h_pulse_width:  HSYNC pulse width(unit: pixels).

           dotclk_h_active:  Horizontal valid data count(unit: pixels)

           dotclk_h_bporch:  Horizontal back porch(unit: pixels)

           dotclk_h_fporch:  Horizontal front porch(unit: pixels)

           dotclk_v_pulse_width:  VSYNC pulse width(unit: pixels)

           dotclk_v_active:  Vertical valid data count(unit: row)

           dotclk_v_bporch:  Vertical back porch(unit: row)

           dotclk_v_fporch:  Vertical front porch(unit: row)

           dotclk_enable_present:  Whether output enable-signal

           dotclk_enable_pol:  Transmit data at the high level of the enable-signal

           dotclk_v_pol:  VSYNC pulse is high level

           dotclk_h_pol:  HSYNC pulse is high level

           dotclk_dotclk_pol:  Capture at negative edge
```

## .axioenvs/application.modbus_tcp_slave/build/gcc-riscv32.debug/gen/Kconfig/Kconfig.component.awb_common_driver.driver.zlg_tft_monitor_gpio
```kconfig
menuconfig DRV_ZLG_TFT_MONITOR_GPIO
    bool "zlg_tft_monitor_gpio ['zlg_tft,monitor-gpio']"
    select AW_SUBSYS_DRIVER_DISPLAY
    select AW_SUBSYS_DRIVER_PWM
    default n
    help
        "zlg_tft,monitor-gpio" is common LCD driver which drive by LCDif, backlight be controled by GPIO.

        Example of adding device to board.dts:

        &lcdif {
            monitor_zlg_480_272:monitor_zlg_480_272{
                compatible = "zlg_tft,monitor-gpio";
                label      = "zlg_480_272";
                status     = "disabled";
           
                info_manufacturer = "ZLG";
                info_x_res        = <480>;
                info_y_res        = <272>;
                info_bpp          = <16>;
         
                cfg_type = "AWB_DISPLAY_MONITOR_CFG_TYPE_DOTCLK";
                dotclk_dclk_f         = <12000000>;
                dotclk_h_pulse_width  = <1>;
                dotclk_h_active       = <480>;
                dotclk_h_bporch       = <42>;
                dotclk_h_fporch       = <5>;
                dotclk_v_pulse_width  = <1>;
                dotclk_v_active       = <272>;
                dotclk_v_bporch       = <11>;
                dotclk_v_fporch       = <8>;
                dotclk_enable_present = <1>;
                dotclk_enable_pol     = <1>;
                dotclk_v_pol          = <1>;
                dotclk_h_pol          = <0>;
                dotclk_dotclk_pol     = <1>;
          
                /* if exist GPIO to reset LCD, rst pin is optional */
                reset_delay_ms  = <10>;
                rst-pins = <&pin1 GPIO1_8 (AW_PIN_CFG_GPIO_OUTPUT_HIGH|GPIO1_8_GPIO)
                                          (AW_PIN_CFG_GPIO_OUTPUT_HIGH|GPIO1_8_GPIO)
                                          (AW_PIN_CFG_GPIO_OUTPUT_HIGH|GPIO1_8_GPIO)>;
                bl-pins = <&pin1 GPIO1_10 (GPIO1_10_GPIO|AW_PIN_CFG_GPIO_OUTPUT_LOW|AW_PIN_CFG_PULL_UP)
                                          (GPIO1_10_GPIO|AW_PIN_CFG_GPIO_OUTPUT_HIGH|AW_PIN_CFG_PULL_UP)
                                          (GPIO1_10_GPIO|AW_PIN_CFG_GPIO_OUTPUT_HIGH|AW_PIN_CFG_PULL_UP)
            };
        };
        

        And also, you can config pin in pins.dts as follow:
        

        &monitor_zlg_480_272{  
                /* if exist GPIO to reset LCD */
                rst-pins = <&pin1 GPIO1_8 (AW_PIN_CFG_GPIO_OUTPUT_HIGH|GPIO1_8_GPIO)
                                          (AW_PIN_CFG_GPIO_OUTPUT_HIGH|GPIO1_8_GPIO)
                                          (AW_PIN_CFG_GPIO_OUTPUT_HIGH|GPIO1_8_GPIO)>;
                bl-pins = <&pin1 GPIO1_10 (GPIO1_10_GPIO|AW_PIN_CFG_GPIO_OUTPUT_LOW|AW_PIN_CFG_PULL_UP)
                                          (GPIO1_10_GPIO|AW_PIN_CFG_GPIO_OUTPUT_HIGH|AW_PIN_CFG_PULL_UP)
                                          (GPIO1_10_GPIO|AW_PIN_CFG_GPIO_OUTPUT_HIGH|AW_PIN_CFG_PULL_UP)
        };

        Parameters:

           info_manufacturer:  Equipment manufacturer

           info_x_res:  Screen resolution x

           info_y_res:  Screen resolution y

           info_bpp:  Bits Per Pixel

           reset_delay_ms:  Length of time the Monitor is reset,units ms

           cfg_type:  Interface timing type

           dotclk_dclk_f:  Dotclk clock(unit: Hz).

           dotclk_h_pulse_width:  HSYNC pulse width(unit: pixels).

           dotclk_h_active:  Horizontal valid data count(unit: pixels)

           dotclk_h_bporch:  Horizontal back porch(unit: pixels)

           dotclk_h_fporch:  Horizontal front porch(unit: pixels)

           dotclk_v_pulse_width:  VSYNC pulse width(unit: pixels)

           dotclk_v_active:  Vertical valid data count(unit: row)

           dotclk_v_bporch:  Vertical back porch(unit: row)

           dotclk_v_fporch:  Vertical front porch(unit: row)

           dotclk_enable_present:  Whether output enable-signal

           dotclk_enable_pol:  Transmit data at the high level of the enable-signal

           dotclk_v_pol:  VSYNC pulse is high level

           dotclk_h_pol:  HSYNC pulse is high level

           dotclk_dotclk_pol:  Capture at negative edge
```

## .axioenvs/application.modbus_tcp_slave/build/gcc-riscv32.debug/gen/Kconfig/Kconfig.component.awb_inet_socket
```kconfig
menuconfig AWB_INET_SOCKET
    bool "AWorks implementation for internet socket"
    libsafe 
    select AW_MEM_MANAGE_MEM_POOL
    select AW_COMMON_IOCTL_CODE
    select AW_CTYPE
    select AW_STDLIB
    select AW_SOCKET_IODEV
    default n
    help
        Version: 0.0.0

        
if AWB_INET_SOCKET

source "D:/aworks_lp_hpm6450_general_sdk-0.9.1/frameworks/64cf32e2-aworks_lp/net/awb_inet_socket/Kconfig.opts"

endif #AWB_INET_SOCKET
```

## .axioenvs/application.modbus_tcp_slave/build/gcc-riscv32.debug/gen/Kconfig/Kconfig.component.awb_socket_filter
```kconfig
menuconfig AWB_SOCKET_FILTER
    bool "AWorks socket filter"
    libsafe 
    select AW_STDLIB
    default n
    help
        Version: 0.0.0

        
if AWB_SOCKET_FILTER

source "D:/aworks_lp_hpm6450_general_sdk-0.9.1/frameworks/64cf32e2-aworks_lp/net/awb_socket_filter/Kconfig.opts"

endif #AWB_SOCKET_FILTER
```

## .axioenvs/application.modbus_tcp_slave/build/gcc-riscv32.debug/gen/Kconfig/Kconfig.component.awbus
```kconfig
menuconfig AWBUS
    bool "AWbus"
    libsafe 
    default n
    help
        Version: 1.0.0

        
if AWBUS

source "D:/aworks_lp_hpm6450_general_sdk-0.9.1/frameworks/64cf32e2-aworks_lp/components/kernel/awbus/Kconfig.opts"

endif #AWBUS
```

## .axioenvs/application.modbus_tcp_slave/build/gcc-riscv32.debug/gen/Kconfig/Kconfig.component.aworks_cip_ethercat
```kconfig
menuconfig AWORKS_CIP_ETHERCAT
    bool "EtherCAT Slave Stack Component"
    libsafe 
    select AW_DEV_API
    default n
    help
        Version: 0.3.1

        
```

## .axioenvs/application.modbus_tcp_slave/build/gcc-riscv32.debug/gen/Kconfig/Kconfig.component.awsa_framework
```kconfig
menuconfig AWSA_FRAMEWORK
    bool "AWorks Audio Framework"
    libsafe 
    select AW_STDIO
    select AW_API_TIME
    select AW_SUBSYS_AWSA_PCM
    default n
    help
        Version: 0.0.0

        
```

## .axioenvs/application.modbus_tcp_slave/build/gcc-riscv32.debug/gen/Kconfig/Kconfig.component.awtk
```kconfig
menuconfig AWTK
    bool "awtk framework"
    libsafe 
    select TKC
    select AW_IO_BASE
    select AW_API_TIME
    select AW_IO_DIR
    default n
    help
        Version: 0.1.12

        
if AWTK

source "D:/aworks_lp_hpm6450_general_sdk-0.9.1/components/awtk/Kconfig.opts"

endif #AWTK
```

## .axioenvs/application.modbus_tcp_slave/build/gcc-riscv32.debug/gen/Kconfig/Kconfig.component.bsp_hpm
```kconfig
menuconfig BSP_HPM
    bool "HPM Common Board Support"
    libsafe 
    default n
    help
        Version: 1.0.0

        
```

## .axioenvs/application.modbus_tcp_slave/build/gcc-riscv32.debug/gen/Kconfig/Kconfig.component.cjson
```kconfig
menuconfig CJSON
    bool "cJSON"
    libsafe 
    default n
    help
        Version: 2.0.3

        
```

## .axioenvs/application.modbus_tcp_slave/build/gcc-riscv32.debug/gen/Kconfig/Kconfig.component.ffmpeg
```kconfig
menuconfig FFMPEG
    bool "ffmpeg"
    libsafe 
    select COMPILER_SUPPORT_POSIX_SOCKET
    select COMPILER_SUPPORT_POSIX_FILE
    select COMPILER_SUPPORT_LIBC_TIME
    select COMPILER_SUPPORT_STDIO
    select AW_IO_DIR
    default n
    help
        Version: 6.0.2

        Detail:help

        FFmpeg is a collection of libraries and tools to process multimedia 

        content such as audio, video, subtitles and related metadata.

        

         Source Code Version: FFmpeg 5.1
if FFMPEG

source "D:/aworks_lp_hpm6450_general_sdk-0.9.1/components/ffmpeg/Kconfig.opts"

endif #FFMPEG
```
