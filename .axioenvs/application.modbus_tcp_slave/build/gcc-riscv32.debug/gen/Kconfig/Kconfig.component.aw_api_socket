## .axioenvs/application.modbus_tcp_slave/build/gcc-riscv32.debug/gen/Kconfig/Kconfig.component.aw_api_socket
```kconfig
menuconfig AW_API_SOCKET
    bool "AWorks API of sockets"
    libsafe 
    select AW_IO_BASE
    select AW_COMMON_IOCTL_CODE
    select AW_API_INET_HEADER
    select AW_API_INET_LOCAL
    select AW_SOCKET_IODEV
    select AW_IO_BASE_SUPPORT_SOCKET
    default n
    help
        Version: 0.0.0

        
```

## .axioenvs/application.modbus_tcp_slave/build/gcc-riscv32.debug/gen/Kconfig/Kconfig.component.aw_api_timetrans
```kconfig
menuconfig AW_API_TIMETRANS
    bool "AWorks API of time trans"
    libsafe 
    select AW_INTERFACE
    default n
    help
        Version: 0.0.0

        
```

## .axioenvs/application.modbus_tcp_slave/build/gcc-riscv32.debug/gen/Kconfig/Kconfig.component.aw_api_timetrans_local
```kconfig
menuconfig AW_API_TIMETRANS_LOCAL
    bool "AWorks API of local time trans"
    libsafe 
    select AW_API_TIMETRANS
    select AW_API_TIMEZONE
    default n
    help
        Version: 0.0.0

        
```

## .axioenvs/application.modbus_tcp_slave/build/gcc-riscv32.debug/gen/Kconfig/Kconfig.component.aw_app_aw_shell_awterminal
```kconfig
menuconfig AW_APP_AW_SHELL_AWTERMINAL
    bool "AWorks Shell supports awterminal commands"
    libsafe 
    select AW_APP_SHELL
    default n
    help
        Version: 0.0.0

        
```

## .axioenvs/application.modbus_tcp_slave/build/gcc-riscv32.debug/gen/Kconfig/Kconfig.component.aw_app_aw_shell_coremark
```kconfig
menuconfig AW_APP_AW_SHELL_COREMARK
    bool "AWorks Shell supports coremark commands"
    libsafe 
    select AW_APP_SHELL
    select RTK_OBJECT_CREATE_EN
    default n
    help
        Version: 0.1.0

        
if AW_APP_AW_SHELL_COREMARK

source "D:/aworks_lp_hpm6450_general_sdk-0.9.1/frameworks/64cf32e2-aworks_lp/app/applications/aw_shell_coremark/Kconfig.opts"

endif #AW_APP_AW_SHELL_COREMARK
```

## .axioenvs/application.modbus_tcp_slave/build/gcc-riscv32.debug/gen/Kconfig/Kconfig.component.aw_app_aw_shell_cpuload
```kconfig
menuconfig AW_APP_AW_SHELL_CPULOAD
    bool "AWorks Shell supports cpuload commands"
    libsafe 
    select AW_APP_SHELL
    select AW_API_TIMETRANS_LOCAL
    select AW_STDIO
    select AW_STDIO_PRINTF_TYPES_FLOAT_EN
    select AW_STDIO_PRINTF_PRECISION_POINTER_EN
    select AW_STDIO_PRINTF_WIDTH_POINTER_EN
    select RTK_PERFORMANCE_STATISTIC_EN
    default n
    help
        Version: 0.0.0

        Detail:CPU usage statistics function; You can input 'cpuload' to shell for show it. 

if AW_APP_AW_SHELL_CPULOAD

source "D:/aworks_lp_hpm6450_general_sdk-0.9.1/frameworks/64cf32e2-aworks_lp/app/applications/aw_shell_cpuload/Kconfig.opts"

endif #AW_APP_AW_SHELL_CPULOAD
```

## .axioenvs/application.modbus_tcp_slave/build/gcc-riscv32.debug/gen/Kconfig/Kconfig.component.aw_app_aw_shell_dhcps
```kconfig
menuconfig AW_APP_AW_SHELL_DHCPS
    bool "AWorks Shell supports DHCP server commands"
    libsafe 
    select AW_API_INET_LOCAL
    select AW_APP_SHELL
    select DHCP_SERVER
    default n
    help
        Version: 0.0.0

        
```

## .axioenvs/application.modbus_tcp_slave/build/gcc-riscv32.debug/gen/Kconfig/Kconfig.component.aw_app_aw_shell_dns_lookup
```kconfig
menuconfig AW_APP_AW_SHELL_DNS_LOOKUP
    bool "AWorks Shell supports dns lookup"
    libsafe 
    select AW_APP_SHELL
    select AW_STDLIB
    select COMPILER_SUPPORT_POSIX_SOCKET
    default n
    help
        Version: 0.0.0

        
```

## .axioenvs/application.modbus_tcp_slave/build/gcc-riscv32.debug/gen/Kconfig/Kconfig.component.aw_app_aw_shell_ip
```kconfig
menuconfig AW_APP_AW_SHELL_IP
    bool "AWorks Shell supports ip commands"
    libsafe 
    select AW_APP_SHELL
    select AW_API_INET_LOCAL
    select AWB_INET_NETDB
    select AWB_SUBSYS_NETIF
    select AWB_NETIF_USER_INTERFACE
    default n
    help
        Version: 0.0.0

        
```

## .axioenvs/application.modbus_tcp_slave/build/gcc-riscv32.debug/gen/Kconfig/Kconfig.component.aw_app_aw_shell_ping6
```kconfig
menuconfig AW_APP_AW_SHELL_PING6
    bool "AWorks Shell supports ping6 commands"
    libsafe 
    select AW_APP_SHELL
    select COMPILER_SUPPORT_POSIX_SOCKET
    default n
    help
        Version: 0.0.0

        
```

## .axioenvs/application.modbus_tcp_slave/build/gcc-riscv32.debug/gen/Kconfig/Kconfig.component.aw_app_aw_shell_sftp
```kconfig
menuconfig AW_APP_AW_SHELL_SFTP
    bool "AWorks Shell supports sftp commands"
    libsafe 
    select AW_APP_SHELL
    select WOLFSSH
    select AW_APP_AW_SHELL_IO
    default n
    help
        Version: 0.0.0

        
```

## .axioenvs/application.modbus_tcp_slave/build/gcc-riscv32.debug/gen/Kconfig/Kconfig.component.aw_app_aw_shell_stack
```kconfig
menuconfig AW_APP_AW_SHELL_STACK
    bool "AWorks Shell supports stack commands"
    libsafe 
    select AW_APP_SHELL
    default n
    help
        Version: 0.0.0

        Detail:AWorks task stack display function; User can input 'stack' to shell for show task information.
```

## .axioenvs/application.modbus_tcp_slave/build/gcc-riscv32.debug/gen/Kconfig/Kconfig.component.aw_app_shell
```kconfig
menuconfig AW_APP_SHELL
    bool "AWorks Shell Terminals"
    libsafe 
    select AW_STDIO
    select AW_STDLIB
    select AW_DEV_API
    select AW_IO_DIR
    default n
    help
        Version: 0.0.0

        
if AW_APP_SHELL

source "D:/aworks_lp_hpm6450_general_sdk-0.9.1/frameworks/64cf32e2-aworks_lp/app/applications/aw_shell/Kconfig.opts"

endif #AW_APP_SHELL
```

## .axioenvs/application.modbus_tcp_slave/build/gcc-riscv32.debug/gen/Kconfig/Kconfig.component.aw_ch_encoding_convert
```kconfig
menuconfig AW_CH_ENCODING_CONVERT
    bool "AWorks Chinese Converter"
    libsafe 
    select AW_INTERFACE
    default n
    help
        Version: 0.0.0

        Detail:This component provides mutual conversion between different Chinese encoding formats(such as,GBK,UTF-8,UTF-16,UTF-32,etc..).
if AW_CH_ENCODING_CONVERT

source "D:/aworks_lp_hpm6450_general_sdk-0.9.1/frameworks/64cf32e2-aworks_lp/components/kernel_user_common/aw_ch_encoding_convert/Kconfig.opts"

endif #AW_CH_ENCODING_CONVERT
```

## .axioenvs/application.modbus_tcp_slave/build/gcc-riscv32.debug/gen/Kconfig/Kconfig.component.aw_common_ioctl_code
```kconfig
menuconfig AW_COMMON_IOCTL_CODE
    bool "AWorks Common ioctrl Code"
    libsafe 
    select AW_INTERFACE
    default n
    help
        Version: 0.0.0

        Detail:This component provide common device IO ctrl code in AWorks.
```

## .axioenvs/application.modbus_tcp_slave/build/gcc-riscv32.debug/gen/Kconfig/Kconfig.component.aw_compiler_cpp11_std_thread_gcc
```kconfig
menuconfig AW_COMPILER_CPP11_STD_THREAD_GCC
    bool "AWorks C++11 std thread for GCC"
    libsafe 
    select COMPILER_SUPPORT_LIBC_TIME
    select COMPILER_SUPPORT_CPLUSCPLUS
    select RTK_OBJECT_CREATE_EN
    select TLS_THREAD_KEY_SUPPORT
    default n
    help
        Version: 0.1.0

        Detail:help

        AWorks C++11 GCC thread adapte.

        Note: The use of `thread_local` is not supported at present.
if AW_COMPILER_CPP11_STD_THREAD_GCC

source "D:/aworks_lp_hpm6450_general_sdk-0.9.1/frameworks/64cf32e2-aworks_lp/components/kernel_user_common/aw_compiler_cpp11_std_thread-gcc/Kconfig.opts"

endif #AW_COMPILER_CPP11_STD_THREAD_GCC
```

## .axioenvs/application.modbus_tcp_slave/build/gcc-riscv32.debug/gen/Kconfig/Kconfig.component.aw_cpu_driver_hpm
```kconfig
menuconfig AW_CPU_DRIVER_HPM
    bool "HPM Drivers"
    libsafe 
    default n
    help
        Version: 0.0.0

        
```

## .axioenvs/application.modbus_tcp_slave/build/gcc-riscv32.debug/gen/Kconfig/Kconfig.component.aw_cpu_driver_hpm.driver.hpm_adc16
```kconfig
menuconfig DRV_HPM_ADC16
    bool "hpm_adc16 ['riscv,hpm-adc16']"
    select AWB_ADC_SERVICE
    select AW_SUBSYS_DRIVER_ADC
    select AW_SUBSYS_SYSTEM_PM_PIN
    default n
```

## .axioenvs/application.modbus_tcp_slave/build/gcc-riscv32.debug/gen/Kconfig/Kconfig.component.aw_cpu_driver_hpm.driver.hpm_can_fast
```kconfig
menuconfig DRV_HPM_CAN_FAST
    bool "hpm_can_fast ['riscv,hpm_can,fast']"
    select AW_SUBSYS_DRIVER_CAN
    select AW_SUBSYS_SYSTEM_PM_PIN
    default n
```

## .axioenvs/application.modbus_tcp_slave/build/gcc-riscv32.debug/gen/Kconfig/Kconfig.component.aw_cpu_driver_hpm.driver.hpm_dma
```kconfig
menuconfig DRV_HPM_DMA
    bool "hpm_dma ['riscv,hpm-dma']"
    select AW_SUBSYS_DRIVER_DMA
    default n
```

## .axioenvs/application.modbus_tcp_slave/build/gcc-riscv32.debug/gen/Kconfig/Kconfig.component.aw_cpu_driver_hpm.driver.hpm_enet
```kconfig
menuconfig DRV_HPM_ENET
    bool "hpm_enet ['riscv,hpm_ethernet']"
    select AW_SUBSYS_SYSTEM_PM_PIN
    select AW_SUBSYS_DRIVER_MII
    select AWB_SUBSYS_NETIF
    default n

if DRV_HPM_ENET

source "D:/aworks_lp_hpm6450_general_sdk-0.9.1/platforms/platform-hpm-aworks-lp/components/aw_cpu_driver_hpm/dts/bindings/enet/riscv,hpm_ethernet.Kconfig.opts"

endif #DRV_HPM_ENET
```

## .axioenvs/application.modbus_tcp_slave/build/gcc-riscv32.debug/gen/Kconfig/Kconfig.component.aw_cpu_driver_hpm.driver.hpm_gpio
```kconfig
menuconfig DRV_HPM_GPIO
    bool "hpm_gpio ['riscv,hpm-gpio']"
    select AWB_PIN_SERVICE
    select AW_SUBSYS_SYSTEM_PIN
    select AW_SUBSYS_SYSTEM_PM_PIN
    default n
```

## .axioenvs/application.modbus_tcp_slave/build/gcc-riscv32.debug/gen/Kconfig/Kconfig.component.aw_cpu_driver_hpm.driver.hpm_lin
```kconfig
menuconfig DRV_HPM_LIN
    bool "hpm_lin ['riscv,hpm-lin']"
    select AW_CLK_FRAMEWORK
    select AW_SUBSYS_SYSTEM_PM_PIN
    default n
```

## .axioenvs/application.modbus_tcp_slave/build/gcc-riscv32.debug/gen/Kconfig/Kconfig.component.aw_cpu_driver_hpm.driver.hpm_mcan
```kconfig
menuconfig DRV_HPM_MCAN
    bool "hpm_mcan ['riscv,hpm_mcan']"
    select AW_SUBSYS_DRIVER_CAN
    select AW_SUBSYS_SYSTEM_PM_PIN
    default n
```

## .axioenvs/application.modbus_tcp_slave/build/gcc-riscv32.debug/gen/Kconfig/Kconfig.component.aw_cpu_driver_hpm.driver.hpm_pwm_timer
```kconfig
menuconfig DRV_HPM_PWM_TIMER
    bool "hpm_pwm_timer ['riscv,hpm-pwm-ctrl']"
    select AW_MATH
    select AW_SUBSYS_DRIVER_HWTIMER
    select AW_SUBSYS_DRIVER_PWM
    select AW_SUBSYS_SYSTEM_PM_PIN
    select AWBUS_DEV_SHUTDOWN_EN
    default n
```
