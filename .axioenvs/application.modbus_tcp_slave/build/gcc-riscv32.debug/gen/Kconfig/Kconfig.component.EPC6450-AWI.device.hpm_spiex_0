## .axioenvs/application.modbus_tcp_slave/build/gcc-riscv32.debug/gen/Kconfig/Kconfig.component.EPC6450-AWI.device.hpm_spiex_0
```kconfig
menuconfig DEV_SPIEX2
    bool "spiex2"
    default n
    visible if y
    select DRV_HPM_SPIEX
    select DEV_PLIC0
    select DEV_PLIC0_INTERRUPT_RES_29
    select DEV_PLIC0_AWBL_INTCTLR_SERVICE

    help
      Filename: "/dev/spiex2"

      dts_dev_prop:
          name(unit): "hpm_spiex" (0)
          compatible: ['riscv,hpm-spiex']
          dts_path: /soc/spiex@0xF0038000
          binding: D:\aworks_lp_hpm6450_general_sdk-0.9.1\platforms\platform-hpm-aworks-lp\components\aw_cpu_driver_hpm\dts\bindings\spiex\riscv,hpm-spiex.yaml


if DEV_SPIEX2

config DEV_SPIEX2_CSHT
    string "The minimum time that cs should stay high"
    default "spiex_cs2sclk_half_sclk_4"
    enum
        "spiex_cs2sclk_half_sclk_1"
        "spiex_cs2sclk_half_sclk_2"
        "spiex_cs2sclk_half_sclk_3"
        "spiex_cs2sclk_half_sclk_4"


config DEV_SPIEX2_CS2SCLK
    string "The time from cs becoming valid to the first sck edge"
    default "spiex_csht_half_sclk_12"
    enum
        "spiex_csht_half_sclk_1"
        "spiex_csht_half_sclk_2"
        "spiex_csht_half_sclk_3"
        "spiex_csht_half_sclk_4"
        "spiex_csht_half_sclk_5"
        "spiex_csht_half_sclk_6"
        "spiex_csht_half_sclk_7"
        "spiex_csht_half_sclk_8"
        "spiex_csht_half_sclk_9"
        "spiex_csht_half_sclk_10"
        "spiex_csht_half_sclk_11"
        "spiex_csht_half_sclk_12"
        "spiex_csht_half_sclk_13"
        "spiex_csht_half_sclk_14"
        "spiex_csht_half_sclk_15"
        "spiex_csht_half_sclk_16"


config DEV_SPIEX2_TABLE_SIZE
    int "Spiex master instruct table size"
    default 15
    range 0 30

endif #DEV_SPIEX2
```

## .axioenvs/application.modbus_tcp_slave/build/gcc-riscv32.debug/gen/Kconfig/Kconfig.component.EPC6450-AWI.device.hpm_timer_0
```kconfig
menuconfig DEV_TIMER0
    bool "timer0"
    default n
    visible if y
    select DRV_HPM_TIMER
    select DEV_PLIC0
    select DEV_PLIC0_INTERRUPT_RES_60
    select DEV_PLIC0_AWBL_INTCTLR_SERVICE

    help
      Filename: "/dev/timer0"

      dts_dev_prop:
          name(unit): "hpm_timer" (0)
          compatible: ['riscv,hpm-timer']
          dts_path: /soc/timer@0xF3000000
          binding: D:\aworks_lp_hpm6450_general_sdk-0.9.1\platforms\platform-hpm-aworks-lp\components\aw_cpu_driver_hpm\dts\bindings\timer\riscv,hpm-timer.yaml




if DEV_TIMER0
osource "D:/aworks_lp_hpm6450_general_sdk-0.9.1/demos/component/modbus/modbus_tcp_slave/.axioenvs/application.modbus_tcp_slave/build/gcc-riscv32.debug/gen/Kconfig/Kconfig.component.EPC6450-AWI.device.hpm_timer_chan_0"
osource "D:/aworks_lp_hpm6450_general_sdk-0.9.1/demos/component/modbus/modbus_tcp_slave/.axioenvs/application.modbus_tcp_slave/build/gcc-riscv32.debug/gen/Kconfig/Kconfig.component.EPC6450-AWI.device.hpm_timer_chan_1"
osource "D:/aworks_lp_hpm6450_general_sdk-0.9.1/demos/component/modbus/modbus_tcp_slave/.axioenvs/application.modbus_tcp_slave/build/gcc-riscv32.debug/gen/Kconfig/Kconfig.component.EPC6450-AWI.device.hpm_timer_chan_2"
osource "D:/aworks_lp_hpm6450_general_sdk-0.9.1/demos/component/modbus/modbus_tcp_slave/.axioenvs/application.modbus_tcp_slave/build/gcc-riscv32.debug/gen/Kconfig/Kconfig.component.EPC6450-AWI.device.hpm_timer_chan_3"

endif #DEV_TIMER0
```

## .axioenvs/application.modbus_tcp_slave/build/gcc-riscv32.debug/gen/Kconfig/Kconfig.component.EPC6450-AWI.device.hpm_timer_3
```kconfig
menuconfig DEV_TIMER4
    bool "timer4"
    default n
    visible if y
    select DRV_HPM_TIMER
    select DEV_PLIC0
    select DEV_PLIC0_INTERRUPT_RES_64
    select DEV_PLIC0_AWBL_INTCTLR_SERVICE

    help
      Filename: "/dev/timer4"

      dts_dev_prop:
          name(unit): "hpm_timer" (3)
          compatible: ['riscv,hpm-timer']
          dts_path: /soc/timer@0xF3010000
          binding: D:\aworks_lp_hpm6450_general_sdk-0.9.1\platforms\platform-hpm-aworks-lp\components\aw_cpu_driver_hpm\dts\bindings\timer\riscv,hpm-timer.yaml




if DEV_TIMER4
osource "D:/aworks_lp_hpm6450_general_sdk-0.9.1/demos/component/modbus/modbus_tcp_slave/.axioenvs/application.modbus_tcp_slave/build/gcc-riscv32.debug/gen/Kconfig/Kconfig.component.EPC6450-AWI.device.hpm_timer_chan_12"
osource "D:/aworks_lp_hpm6450_general_sdk-0.9.1/demos/component/modbus/modbus_tcp_slave/.axioenvs/application.modbus_tcp_slave/build/gcc-riscv32.debug/gen/Kconfig/Kconfig.component.EPC6450-AWI.device.hpm_timer_chan_13"
osource "D:/aworks_lp_hpm6450_general_sdk-0.9.1/demos/component/modbus/modbus_tcp_slave/.axioenvs/application.modbus_tcp_slave/build/gcc-riscv32.debug/gen/Kconfig/Kconfig.component.EPC6450-AWI.device.hpm_timer_chan_14"
osource "D:/aworks_lp_hpm6450_general_sdk-0.9.1/demos/component/modbus/modbus_tcp_slave/.axioenvs/application.modbus_tcp_slave/build/gcc-riscv32.debug/gen/Kconfig/Kconfig.component.EPC6450-AWI.device.hpm_timer_chan_15"

endif #DEV_TIMER4
```

## .axioenvs/application.modbus_tcp_slave/build/gcc-riscv32.debug/gen/Kconfig/Kconfig.component.EPC6450-AWI.device.hpm_timer_5
```kconfig
menuconfig DEV_TIMER6
    bool "timer6"
    default n
    visible if y
    select DRV_HPM_TIMER
    select DEV_PLIC0
    select DEV_PLIC0_INTERRUPT_RES_66
    select DEV_PLIC0_AWBL_INTCTLR_SERVICE

    help
      Filename: "/dev/timer6"

      dts_dev_prop:
          name(unit): "hpm_timer" (5)
          compatible: ['riscv,hpm-timer']
          dts_path: /soc/timer@0xF3018000
          binding: D:\aworks_lp_hpm6450_general_sdk-0.9.1\platforms\platform-hpm-aworks-lp\components\aw_cpu_driver_hpm\dts\bindings\timer\riscv,hpm-timer.yaml




if DEV_TIMER6
osource "D:/aworks_lp_hpm6450_general_sdk-0.9.1/demos/component/modbus/modbus_tcp_slave/.axioenvs/application.modbus_tcp_slave/build/gcc-riscv32.debug/gen/Kconfig/Kconfig.component.EPC6450-AWI.device.hpm_timer_chan_20"
osource "D:/aworks_lp_hpm6450_general_sdk-0.9.1/demos/component/modbus/modbus_tcp_slave/.axioenvs/application.modbus_tcp_slave/build/gcc-riscv32.debug/gen/Kconfig/Kconfig.component.EPC6450-AWI.device.hpm_timer_chan_21"
osource "D:/aworks_lp_hpm6450_general_sdk-0.9.1/demos/component/modbus/modbus_tcp_slave/.axioenvs/application.modbus_tcp_slave/build/gcc-riscv32.debug/gen/Kconfig/Kconfig.component.EPC6450-AWI.device.hpm_timer_chan_22"
osource "D:/aworks_lp_hpm6450_general_sdk-0.9.1/demos/component/modbus/modbus_tcp_slave/.axioenvs/application.modbus_tcp_slave/build/gcc-riscv32.debug/gen/Kconfig/Kconfig.component.EPC6450-AWI.device.hpm_timer_chan_23"

endif #DEV_TIMER6
```

## .axioenvs/application.modbus_tcp_slave/build/gcc-riscv32.debug/gen/Kconfig/Kconfig.component.EPC6450-AWI.device.hpm_timer_6
```kconfig
menuconfig DEV_TIMER7
    bool "timer7"
    default n
    visible if y
    select DRV_HPM_TIMER
    select DEV_PLIC0
    select DEV_PLIC0_INTERRUPT_RES_67
    select DEV_PLIC0_AWBL_INTCTLR_SERVICE

    help
      Filename: "/dev/timer7"

      dts_dev_prop:
          name(unit): "hpm_timer" (6)
          compatible: ['riscv,hpm-timer']
          dts_path: /soc/timer@0xF301C000
          binding: D:\aworks_lp_hpm6450_general_sdk-0.9.1\platforms\platform-hpm-aworks-lp\components\aw_cpu_driver_hpm\dts\bindings\timer\riscv,hpm-timer.yaml




if DEV_TIMER7
osource "D:/aworks_lp_hpm6450_general_sdk-0.9.1/demos/component/modbus/modbus_tcp_slave/.axioenvs/application.modbus_tcp_slave/build/gcc-riscv32.debug/gen/Kconfig/Kconfig.component.EPC6450-AWI.device.hpm_timer_chan_24"
osource "D:/aworks_lp_hpm6450_general_sdk-0.9.1/demos/component/modbus/modbus_tcp_slave/.axioenvs/application.modbus_tcp_slave/build/gcc-riscv32.debug/gen/Kconfig/Kconfig.component.EPC6450-AWI.device.hpm_timer_chan_25"
osource "D:/aworks_lp_hpm6450_general_sdk-0.9.1/demos/component/modbus/modbus_tcp_slave/.axioenvs/application.modbus_tcp_slave/build/gcc-riscv32.debug/gen/Kconfig/Kconfig.component.EPC6450-AWI.device.hpm_timer_chan_26"
osource "D:/aworks_lp_hpm6450_general_sdk-0.9.1/demos/component/modbus/modbus_tcp_slave/.axioenvs/application.modbus_tcp_slave/build/gcc-riscv32.debug/gen/Kconfig/Kconfig.component.EPC6450-AWI.device.hpm_timer_chan_27"

endif #DEV_TIMER7
```

## .axioenvs/application.modbus_tcp_slave/build/gcc-riscv32.debug/gen/Kconfig/Kconfig.component.EPC6450-AWI.device.hpm_timer_chan_9
```kconfig
menuconfig DEV_TIMER3_CHAN1
    bool "timer3_chan1 @ timer3"
    default n
    visible if y
    select DRV_HPM_TIMER_CHAN
    select DEV_PIN_1
    select DEV_PIN_1_PIN_RES_145
    select DEV_PIN_1_AWB_PIN_SERVICE

    help
      Filename: "/dev/timer3_chan1"

      dts_dev_prop:
          name(unit): "hpm_timer_chan" (9)
          compatible: ['riscv,hpm-timer-chan']
          dts_path: /soc/timer@0xF300C000/timer_chan@0xF300C040
          binding: D:\aworks_lp_hpm6450_general_sdk-0.9.1\platforms\platform-hpm-aworks-lp\components\aw_cpu_driver_hpm\dts\bindings\timer\riscv,hpm-timer-chan.yaml


if DEV_TIMER3_CHAN1

config DEV_TIMER3_CHAN1_HWTIMER_DELAY_ENABLE
    bool "Enable support for hwtimer delay"
    default n
    select DRV_TIMER_CHAN_HWTIMER_DELAY_EN 


config DEV_TIMER3_CHAN1_HWTIMER_COUNTER_ENABLE
    bool "Enable support for hwtimer count"
    default n
    select DRV_TIMER_CHAN_HWTIMER_COUNT_EN 


if DEV_TIMER3_CHAN1_HWTIMER_COUNTER_ENABLE

config DEV_TIMER3_CHAN1_HWTIMER_COUNTER_DEFAULT_PRESCALER
    int "Default counter prescaler"
    default 1
    range 1 256

endif #DEV_TIMER3_CHAN1_HWTIMER_COUNTER_ENABLE


config DEV_TIMER3_CHAN1_HWTIMER_PERIOD_ENABLE
    bool "Enable support for hwtimer period"
    default n
    select DRV_TIMER_CHAN_HWTIMER_PERIOD_EN 


config DEV_TIMER3_CHAN1_HWTIMER_CAP_ENABLE
    bool "Enable support for input capture"
    default n
    select DRV_TIMER_CHAN_HWTIMER_CAP_EN 


if DEV_TIMER3_CHAN1_HWTIMER_CAP_ENABLE

config DEV_TIMER3_CHAN1_DEFAULT_CAP_EDGE_FLAG
    string "Default capture edge flags"
    default "AW_CAPTURE_RISING_EDGE"
    enum
        "AW_CAPTURE_RISING_EDGE"
        "AW_CAPTURE_FALLING_EDGE"
        "AW_CAPTURE_DOUBLE_EDGE"

endif #DEV_TIMER3_CHAN1_HWTIMER_CAP_ENABLE


config DEV_TIMER3_CHAN1_PWM_ENABLE
    bool "Enable support for pwm"
    default n
    select DRV_TIMER_CHAN_HWTIMER_PWM_EN 


if DEV_TIMER3_CHAN1_PWM_ENABLE

config DEV_TIMER3_CHAN1_PWM_DEFAULT_PERIOD_NS
    int "Default PWM period (ns)"
    default 2000000


config DEV_TIMER3_CHAN1_PWM_DEFAULT_DUTY_NS
    int "Default PWM duty (ns)"
    default 1000000


config DEV_TIMER3_CHAN1_PWM_DEFAULT_POLARITY
    bool "Default PWM polarity"
    default n

endif #DEV_TIMER3_CHAN1_PWM_ENABLE

endif #DEV_TIMER3_CHAN1
```

## .axioenvs/application.modbus_tcp_slave/build/gcc-riscv32.debug/gen/Kconfig/Kconfig.component.EPC6450-AWI.device.hpm_uart_0
```kconfig
menuconfig DEV_UART1
    bool "uart1"
    default n
    visible if y
    select DRV_HPM_UART
    select DEV_PLIC0
    select DEV_PLIC0_INTERRUPT_RES_32
    select DEV_PLIC0_AWBL_INTCTLR_SERVICE

    help
      Filename: "/dev/uart1"

      dts_dev_prop:
          name(unit): "hpm_uart" (0)
          compatible: ['riscv,hpm_uart']
          dts_path: /soc/uart@F0044000
          binding: D:\aworks_lp_hpm6450_general_sdk-0.9.1\platforms\platform-hpm-aworks-lp\components\aw_cpu_driver_hpm\dts\bindings\uart\riscv,hpm_uart.yaml


if DEV_UART1

config DEV_UART1_DEFAULT_BAUDRATE
    int "the default Baudrate for uart"
    default 115200


config DEV_UART1_RX_BUF_SIZE
    int "Size of receive buffer"
    default 128


config DEV_UART1_TX_BUF_SIZE
    int "Size of transmit buffer"
    default 0


config DEV_UART1_EN_RS485
    bool "Enable RS-485 or not"
    default n


if DEV_UART1_EN_RS485

config DEV_UART1_RS485_TX_LEVEL_HIGH
    bool "If Enable, Pin is high when RS-485 is in TX mode"
    default n
    help 
        Default: Pin is low when RS-485 is in TX mode. If Enable, Pin is high when RS-485 is in TX mode


config DEV_UART1_RS485_CUT_TIME
    int "Delay time for switching to receive mode after transmit in ms"
    default 1
    range 0 5000
    help 
        Delay time for switching to receive mode after transmit, Uint: ms. It takes effect after rs485 is enabled

endif #DEV_UART1_EN_RS485

endif #DEV_UART1
```

## .axioenvs/application.modbus_tcp_slave/build/gcc-riscv32.debug/gen/Kconfig/Kconfig.component.EPC6450-AWI.device.hpm_uart_15
```kconfig
menuconfig DEV_PUART
    bool "puart"
    default n
    visible if y
    select DRV_HPM_UART
    select DEV_PLIC0
    select DEV_PIN_1
    select DEV_PLIC0_INTERRUPT_RES_116
    select DEV_PLIC0_AWBL_INTCTLR_SERVICE
    select DEV_PIN_1_PIN_RES_190
    select DEV_PIN_1_AWB_PIN_SERVICE
    select DEV_PIN_1_PIN_RES_189

    help
      Filename: "/dev/puart"

      dts_dev_prop:
          name(unit): "hpm_uart" (15)
          compatible: ['riscv,hpm_uart']
          dts_path: /soc/uart@F40E4000
          binding: D:\aworks_lp_hpm6450_general_sdk-0.9.1\platforms\platform-hpm-aworks-lp\components\aw_cpu_driver_hpm\dts\bindings\uart\riscv,hpm_uart.yaml


if DEV_PUART

config DEV_PUART_DEFAULT_BAUDRATE
    int "the default Baudrate for uart"
    default 115200


config DEV_PUART_RX_BUF_SIZE
    int "Size of receive buffer"
    default 128


config DEV_PUART_TX_BUF_SIZE
    int "Size of transmit buffer"
    default 0


config DEV_PUART_EN_RS485
    bool "Enable RS-485 or not"
    default n


if DEV_PUART_EN_RS485

config DEV_PUART_RS485_TX_LEVEL_HIGH
    bool "If Enable, Pin is high when RS-485 is in TX mode"
    default n
    help 
        Default: Pin is low when RS-485 is in TX mode. If Enable, Pin is high when RS-485 is in TX mode


config DEV_PUART_RS485_CUT_TIME
    int "Delay time for switching to receive mode after transmit in ms"
    default 1
    range 0 5000
    help 
        Delay time for switching to receive mode after transmit, Uint: ms. It takes effect after rs485 is enabled

endif #DEV_PUART_EN_RS485

endif #DEV_PUART
```

## .axioenvs/application.modbus_tcp_slave/build/gcc-riscv32.debug/gen/Kconfig/Kconfig.component.EPC6450-AWI.device.hpm_uart_4
```kconfig
menuconfig DEV_UART5
    bool "uart5"
    default n
    visible if y
    select DRV_HPM_UART
    select DEV_PLIC0
    select DEV_PIN_1
    select DEV_PLIC0_INTERRUPT_RES_36
    select DEV_PLIC0_AWBL_INTCTLR_SERVICE
    select DEV_PIN_1_PIN_RES_152
    select DEV_PIN_1_AWB_PIN_SERVICE
    select DEV_PIN_1_PIN_RES_153

    help
      Filename: "/dev/uart5"

      dts_dev_prop:
          name(unit): "hpm_uart" (4)
          compatible: ['riscv,hpm_uart']
          dts_path: /soc/uart@F0054000
          binding: D:\aworks_lp_hpm6450_general_sdk-0.9.1\platforms\platform-hpm-aworks-lp\components\aw_cpu_driver_hpm\dts\bindings\uart\riscv,hpm_uart.yaml


if DEV_UART5

config DEV_UART5_DEFAULT_BAUDRATE
    int "the default Baudrate for uart"
    default 115200


config DEV_UART5_RX_BUF_SIZE
    int "Size of receive buffer"
    default 128


config DEV_UART5_TX_BUF_SIZE
    int "Size of transmit buffer"
    default 0


config DEV_UART5_EN_RS485
    bool "Enable RS-485 or not"
    default n


if DEV_UART5_EN_RS485

config DEV_UART5_RS485_TX_LEVEL_HIGH
    bool "If Enable, Pin is high when RS-485 is in TX mode"
    default n
    help 
        Default: Pin is low when RS-485 is in TX mode. If Enable, Pin is high when RS-485 is in TX mode


config DEV_UART5_RS485_CUT_TIME
    int "Delay time for switching to receive mode after transmit in ms"
    default 1
    range 0 5000
    help 
        Delay time for switching to receive mode after transmit, Uint: ms. It takes effect after rs485 is enabled

endif #DEV_UART5_EN_RS485

endif #DEV_UART5
```
